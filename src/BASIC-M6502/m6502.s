; BASIC M6502 8K VER 1.1 BY MICRO-SOFT
; Generated from ms_basic_1978.asm by convert.py. See BUILDING.md.
.setcpu "6502"
.segment "LOWRAM"
.org 0

; DC marks the final character; DT does not add a terminator.
.macro DC text
    .repeat .strlen(text) - 1, char_index
        .byte .strat(text, char_index)
    .endrepeat
    .byte .strat(text, .strlen(text) - 1) | $80
.endmacro
;THROUGHOUT ALL BUT MATH-PAK.

;STARTING POINT FOR M6502 SIMULATOR
SIMBASE:
;START OFF AT LOCATION ZERO.
    .res (0) - *, 0
; SWITCHES,MACROS.

;5=STM
.ifndef REALIO
REALIO = 4
.endif
; REALIO=6 selects IMNOTWOPR.
;4=APPLE.
;3=COMMODORE.
;2=OSI
;1=MOS TECH,KIM
;0=PDP-10 SIMULATING 6502
;INTEGER ARRAYS.
INTPRC .set 1
;FOR ADDITIONAL PRECISION.
ADDPRC .set 1
;LONG ERROR MESSAGES.
LNGERR .set 0
;CAPABILITY TO SET AND READ A CLK.
TIME .set 0
;EXTERNAL I/O.
EXTIO .set 0
;SAVE AND LOAD COMMANDS
DISKO .set 0
;FOR THE "NULL" COMMAND
NULCMD .set 1
GETCMD .set 1
RORSW .set 1
;TELLS IF THIS IS ON ROM.
ROMSW .set 1
CLMWID .set 14
;LONG INITIALIZATION SWITCH.
LONGI .set 1
STKEND .set 511
BUFPAG .set 0
;TERMINAL LINE LENGTH.
LINLEN .set 72
;INPUT BUFFER SIZE.
BUFLEN .set 72
;ADDRESS OF START OF PURE SEGMENT.
ROMLOC .set 8192
KIMROM .set 1
.if (ROMSW) = 0
KIMROM .set 0
.endif
.if (REALIO-1) <> 0
KIMROM .set 0
.endif
.if (ROMSW) <> 0
;USED ONLY IF ROMSW=1
RAMLOC .set 16384
;START AT 8K.
.if (REALIO) = 0
ROMLOC .set 8192
RAMLOC .set 768
.endif
.endif
.if (REALIO-3) = 0
DISKO .set 1
RAMLOC .set 1024
ROMLOC .set 49152
NULCMD .set 0
GETCMD .set 1
LINLEN .set 40
BUFLEN .set 81
CQOPEN .set 65472
CQCLOS .set 65475
;OPEN CHANNEL FOR INPUT
CQOIN .set 65478
;FILL FOR COMMO.
CQOOUT .set 65481
CQCCHN .set 65484
;INCHR'S CALL TO GET A CHARACTER
CQINCH .set 65487
OUTCH .set 65490
CQLOAD .set 65493
CQSAVE .set 65496
CQVERF .set 65499
CQSYS .set 65502
ISCNTC .set 65505
;CALL POINT FOR "GET"
CZGETL .set 65508
;CLOSE ALL CHANNELS
CQCALL .set 65511
CQTIMR .set 141
BUFPAG .set 2
BUF .set 256*BUFPAG
STKEND .set 507
CQSTAT .set 150
CQHTIM .set 59460
EXTIO .set 1
TIME .set 1
GETCMD .set 1
CLMWID .set 10
;VALUE OF PI CHARACTER FOR COMMODORE.
PI .set 255
ROMSW .set 1
RORSW .set 1
TRMPOS .set 198
.endif
.if (REALIO-1) = 0
GETCMD .set 1
DISKO .set 1
;1EA0
OUTCH .set 7840
ROMLOC .set 8192
RORSW .set 0
CZGETL .set 7770
.endif
.if (REALIO-2) = 0
RORSW .set 0
RAMLOC .set 512
.if (ROMSW) <> 0
RORSW .set 0
RAMLOC .set 32768
.endif
OUTCH .set 65035
.endif
.if (REALIO-4) = 0
RORSW .set 1
NULCMD .set 0
GETCMD .set 1
CQINLN .set 64871
CQPRMP .set 51
CQINCH .set 64780
CQCOUT .set 65229
CQCSIN .set 65277
BUFPAG .set 2
BUF .set BUFPAG*256
ROMLOC .set 2048
;PAGE 2A
RAMLOC .set 10752
OUTCH .set 65005
CZGETL .set 64780
LINLEN .set 40
BUFLEN .set 240
RORSW .set 1
STKEND .set 507
.endif
.if REALIO = 6
.include "imnotwopr_config.inc"
.endif

.if RORSW
.macro BASIC_ROR operand
    ror operand
.endmacro
.endif
.if (RORSW) = 0
.macro BASIC_ROR WD
    lda #.lobyte(0)
    bcc *+4
    lda #.lobyte(128)
    lsr WD
    ora WD
    sta WD
.endmacro
.endif

.macro ACRLF
    .byte 13
    .byte 10
.endmacro
.macro SYNCHK Q
    lda #.lobyte((Q))
    jsr SYNCHR
.endmacro
.macro DT text
    .byte text
.endmacro
.macro LDWD WD
    lda WD
    ldy 0+(WD)+1
.endmacro
.macro LDWDI WD
    lda #.lobyte(((WD)&255))
    ldy #.lobyte(((WD)/256))
.endmacro
.macro LDWX WD
    lda WD
    ldx 0+(WD)+1
.endmacro
.macro LDWXI WD
    lda #.lobyte(((WD)&255))
    ldx #.lobyte(((WD)/256))
.endmacro
.macro LDXY WD
    ldx WD
    ldy 0+(WD)+1
.endmacro
.macro LDXYI WD
    ldx #.lobyte(((WD)&255))
    ldy #.lobyte(((WD)/256))
.endmacro
.macro STWD WD
    sta WD
    sty 0+(WD)+1
.endmacro
.macro STWX WD
    sta WD
    stx 0+(WD)+1
.endmacro
.macro STXY WD
    stx WD
    sty 0+(WD)+1
.endmacro
.macro CLR WD
    lda #.lobyte(0)
    sta WD
.endmacro
.macro COM WD
    lda WD
    eor #.lobyte(255)
    sta WD
.endmacro
.macro PULWD WD
    pla
    sta WD
    pla
    sta 0+(WD)+1
.endmacro
.macro PSHWD WD
    lda 0+(WD)+1
    pha
    lda WD
    pha
.endmacro
.macro JEQ WD
    bne *+5
    jmp WD
.endmacro
.macro JNE WD
    beq *+5
    jmp WD
.endmacro
;BRANCHES THAT ALWAYS BRANCH
.macro BCCA Q
    bcc Q
.endmacro
;THESE ARE USED ON THE 6502 BECAUSE
.macro BCSA Q
    bcs Q
.endmacro
;THERE IS NO UNCONDITIONAL BRANCH
.macro BEQA Q
    beq Q
.endmacro
.macro BNEA Q
    bne Q
.endmacro
.macro BMIA Q
    bmi Q
.endmacro
.macro BPLA Q
    bpl Q
.endmacro
.macro BVCA Q
    bvc Q
.endmacro
.macro BVSA Q
    bvs Q
.endmacro
.macro INCW R
    .local macro_done
    inc R
    bne macro_done
    inc R+1
macro_done:
.endmacro
;BIT ZERO PAGE TRICK.
.macro SKIP1
    .byte 36
.endmacro
;BIT ABS TRICK.
.macro SKIP2
    .byte 44
.endmacro
.if 0
.if (REALIO) = 0
; Original assembly notice: /SIMULATE/
.endif
.if (REALIO-1) = 0
; Original assembly notice: KIM
.endif
.if (REALIO-2) = 0
; Original assembly notice: OSI
.endif
.if (REALIO-3) = 0
; Original assembly notice: COMMODORE
.endif
.if (REALIO-4) = 0
; Original assembly notice: APPLE
.endif
.if (REALIO-5) = 0
; Original assembly notice: STM
.endif
.if (ADDPRC) <> 0
; Original assembly notice: ADDITIONAL PRECISION
.endif
.if (INTPRC) <> 0
; Original assembly notice: INTEGER ARRAYS
.endif
.if (LNGERR) <> 0
; Original assembly notice: LONG ERRORS
.endif
.if (DISKO) <> 0
; Original assembly notice: SAVE AND LOAD
.endif
.if (ROMSW) = 0
; Original assembly notice: RAM
.endif
.if (ROMSW) <> 0
; Original assembly notice: ROM
.endif
.if (RORSW) = 0
; Original assembly notice: NO ROR
.endif
.if (RORSW) <> 0
; Original assembly notice: ROR ASSUMED
.endif
.endif
; INTRODUCTION AND COMPILATION PARAMETERS.
; Original documentation:
; 
; --------- ---- -- ---------
; COPYRIGHT 1976 BY MICROSOFT
; --------- ---- -- ---------
; 7/27/78 FIXED BUG WHERE FOR VARIABLE AT BYTE FF MATCHED RETURN SEARCHING
; 	FOR GOSUB ENTRY ON STACK IN FNDFOR CALL BY CHANGING STA FORPNT
; 	TO STA FORPNT+1. THIS IS A SERIOUS BUG IN ALL VERSIONS.
; 7/27/78 FIXED BUG AT NEWSTT UNDER IFN BUFPAG WHEN CHECK OF CURLIN
; 	WAS DONE BEFORE CURLIN SET UP SO INPUT RETRIES OF FIRST STATEMENT
; 	WAS GIVING SYNTAX ERROR INSTEAD OF REDO FROM START (CODE WAS 12/1/77 FIX)
; 7/1/78	SAVED A FEW BYTES IN INIT FOR COMMODORE (14)
; 7/1/78 FIXED BUG WHERE REPLACING A LINE OVERFLOWING MEMORY LEFT LINKS
; 	IN A BAD STATE. (CODE AT NODEL AND FINI) BUG#4
; 7/1/78 FIXED BUG WHERE GARBAGE COLLECTION NEVER(!) COLLECTS TEMPS
; 	(STY GRBPNT  AT FNDVAR, LDA GRBPNT ORA GRBPNT+1 AT GRBPAS)
; 	THIS WAS COMMODORE BUG #2
; 7/1/78 FIXED BUG WHERE DELETE/INSERT OF LINE COULD CAUSE A GARBAGE COLLECTION WITH BAD VARTAB IF OUT OF MEMORY
; 	 (LDWD MEMSIZ STWD FRETOP=JSR RUNC CLC ALSO AT NODEL)
; 3/9/78 EDIT TO FIX COMMO TRMPOS AND CHANGE LEFT$ AND RIGHT$ TO ALLOW A SECOND ARGUMENT OF 0 AND RETURN A NULL STRING
; 2/25/78 FIXED BUG THAT INPFLG WAS SET WRONG WHEN BUFPAG.NE.0
; 	INCREASED NUMLEV FROM 19 TO 23
; 2/11/78 DISALLOWED SPACES IN RESERVED WORDS. PUT IN SPECIAL CHECK FOR "GO TO"
; 2/11/78 FIXED BUG WHERE ROUNDING OF THE FAC BEFORE PUSHING COULD CAUSE A STRING POINTER
; 	IN THE FAC TO BE INCREMENTED
; 1/24/78 fixed problem where user defined function undefined check fix was smashing error number in [x]
; 12/1/77 FIXED PROBLEM WHERE PEEK WAS SMASHING (POKER) CAUSING POKE OF PEEK TO FAIL
; 12/1/77 FIXED PROBLEM WHERE PROBLEM WITH VARTXT=LINNUM=BUF-2 CAUSING BUF-1 COMMA TO DISAPPEAR
; 12/1/77 FIXED BUFPAG.NE.0 PROBLEM AT NEWSTT AND STOP : CODE WAS STILL
; 	ASSUMING TXTPTR+1.EQ.0 IFF STATEMENT WAS DIRECT
; *
;NUMBER OF STACK LEVELS RESERVED
NUMLEV = 23
;BY AN EXPLICIT CALL TO "GETSTK".
;# OF LOCS PER STRING DESCRIPTOR.
STRSIZ = 3
;NUMBER OF STRING TEMPORARIES.
NUMTMP = 3
;CHARACTER TO SUPPRESS OUTPUT.
CONTW = 15

; SOME EXPLANATION.
; Original documentation:
; 
; M6502 BASIC CONFIGURES BASIC AS FOLLOWS
; 
; LOW LOCATIONS
; 	PAGE	ZERO
; 
; 		STARTUP:
; 		INITIALLY A JMP TO INITIALIZATION CODE BUT
; 		CHANGED TO A JMP TO "READY".
; 		RESTARTING THE MACHINE AT LOC 0 DURING PROGRAM
; 		EXECUTION CAN LEAVE THINGS MESSED UP.
; 
; 		LOC OF FAC TO INTEGER AND INTEGER TO FAC 
; 		ROUTINES.
; 
; 		"DIRECT" MEMORY:
; 		THESE ARE THE MOST COMMONLY USED LOCATIONS.
; 		THEY HOLD BOOKKEEPING INFO AND ALL OTHER
; 		FREQUENTLY USED INFORMATION.
; 		ALL TEMPORARIES, FLAGS, POINTERS, THE BUFFER AREA,
; 		THE FLOATING ACCUMULATOR, AND ANYTHING ELSE THAT
; 		IS USED TO STORE A CHANGING VALUE SHOULD BE LOCATED
; 		IN THIS AREA. CARE MUST BE MADE IN MOVING LOCATIONS
; 		IN THIS AREA SINCE THE JUXTAPOSITION OF TWO LOCATIONS
; 		IS OFTEN DEPENDED UPON.
; 
; 		STILL IN RAM WE HAVE THE BEGINNING OF THE "CHRGET"
; 		SUBROUTINE. IT IS HERE SO [TXTPTR] CAN BE THE
; 		EXTENDED ADDRESS OF A LOAD INSTRUCTION.
; 		THIS SAVES HAVING TO BOTHER ANY REGISTERS.
; 
; 	PAGE	ONE
; 		THE STACK.
; 
; 	STORAGE PAGE TWO AND ON
; 		IN RAM VERSIONS THESE DATA STRUCTURES COME AT THE
; 		END OF BASIC. IN ROM VERSON THEY ARE AT RAMLOC WHICH
; 		CAN EITHER BE ABOVE OR BELOW ROMLOC, WHICH IS WHERE
; 		BASIC ITSELF RESIDES.
; 
; 				A ZERO.
; 		[TXTTAB]	POINTER TO NEXT LINE'S POINTER.
; 				LINE # OF THIS LINE (2 BYTES).
; 				CHARACTERS ON THIS LINE.
; 				ZERO.
; 				POINTER AT NEXT LINE'S POINTER
; 					(POINTED TO BY THE ABOVE POINTER).
; 				... REPEATS ...
; 		LAST LINE:	POINTER AT ZERO POINTER.
; 				LINE # OF THIS LINE.
; 				CHARACTERS ON THIS LINE.
; 				ZERO.
; 				DOUBLE ZERO (POINTED TO BY THE ABOVE POINTER).
; 		[VARTAB]	SIMPLE VARIABLES. 6 BYTES PER VALUE.
; 				2 BYTES GIVE THE NAME, 4 BYTES THE VALUE.
; 				... REPEATS ...
; 		[ARYTAB]	ARRAY VARIABLES. 2 BYTES NAME, 2 BYTE
; 				LENGTH, NUMBER OF DIMENSIONS , EXTENT OF
; 				EACH DIMENSION (2BYTES/), VALUES
; 				... REPEATS ...
; 		[STREND]	FREE SPACE.
; 				... REPEATS ...
; 		[FRETOP]	STRING SPACE IN USE.
; 				... REPEATS ...
; 		[MEMSIZ]	HIGHEST MACHINE LOCATION.
; 				UNUSED EXCEPT BY THE VAL FUNCTION.
; 
; 		ROM -- CONSTANTS AND CODE.
; 
; 	FUNCTION DISPATCH ADDRESSES (AT ROMLOC)
; 		"FUNDSP" CONTAINS THE ADDRESSES OF THE
; 		FUNCTION ROUTINES IN THE ORDER OF THE
; 		FUNCTION NAMES IN THE CRUNCH LIST.
; 		THE FUNCTIONS THAT TAKE MORE THAN ONE ARGUMENT
; 		ARE AT THE END. SEE THE EXPLANATION AT "ISFUN".
; 
; 	THE OPERATOR LIST
; 		THE "OPTAB" LIST CONTAINS AN OPERATOR'S PRECEDENCE
; 		FOLLOWED BY THE ADDRESS OF THE ROUTINE TO PERFORM
; 		THE OPERATION. THE INDEX INTO THE
; 		OPERATOR LIST IS MADE BY SUBTRACTING OFF THE CRUNCH VALUE
; 		OF THE LOWEST NUMBERED OPERATOR. THE ORDER
; 		OF OPERATORS IN THE CRUNCH LIST AND IN "OPTAB" IS IDENTICAL.
; 		THE PRECEDENCES ARE ARBITRARY EXCEPT FOR THEIR
; 		COMPARATIVE SIZES. NOTE THAT THE PRECEDENCE FOR
; 		UNARY OPERATORS SUCH AS "NOT" AND NEGATION ARE
; 		SETUP SPECIALLY WITHOUT USING THE LIST.
; 
; 	THE RESERVED WORD OR CRUNCH LIST
; 		WHEN A COMMAND OR PROGRAM LINE IS TYPED IN
; 		IT IS STORED IN "BUF". AS SOON AS THE WHOLE LINE
; 		HAS BEEN TYPED IN ("INLIN" RETURNS) "CRUNCH" IS
; 		CALLED TO CONVERT ALL RESERVED WORDS TO THEIR
; 		CRUNCHED VALUES. THIS REDUCES THE SIZE OF THE 
; 		PROGRAM AND SPEEDS UP EXECUTION BY ALLOWING
; 		LIST DISPATCHES TO PERFORM FUNCTIONS, STATEMENTS,
; 		AND OPERATIONS. THIS IS BECAUSE ALL THE STATEMENT
; 		NAMES ARE STORED CONSECUTIVELY IN THE CRUNCH LIST.
; 		WHEN A MATCH IS FOUND BETWEEN A STRING
; 		OF CHARACTERS AND A WORD IN THE CRUNCH LIST
; 		THE ENTIRE TEXT OF THE MATCHED WORD IS TAKEN OUT OF
; 		THE INPUT LINE AND A RESERVED WORD TOKEN IS PUT
; 		IN ITS PLACE. A RESERVED WORD TOKEN IS ALWAYS EQUAL
; 		TO OCTAL 200 PLUS THE POSITION OF THE MATCHED WORD
; 		IN THE CRUNCH LIST.
; 
; 	STATEMENT DISPATCH ADDRESSES
; 		WHEN A STATEMENT IS TO BE EXECUTED, THE FIRST
; 		CHARACTER OF THE STATEMENT IS EXAMINED
; 		TO SEE IF IT IS LESS THAN THE RESERVED
; 		WORD TOKEN FOR THE LOWEST NUMBERED STATEMENT NAME.
; 		IF SO, THE "LET" CODE IS CALLED TO
; 		TREAT THE STATEMENT AS AN ASSIGNMENT STATEMENT.
; 		OTHERWISE A CHECK IS MADE TO MAKE SURE THE
; 		RESERVED WORD NUMBER IS NOT TOO LARGE TO BE A
; 		STATEMENT TYPE NUMBER. IF NOT THE ADDRESS
; 		TO DISPATCH TO IS FETCHED FROM "STMDSP" (THE STATEMENT
; 		DISPATCH LIST) USING THE RESERVED WORD
; 		NUMBER FOR THE STATEMENT TO CALCULATE AN INDEX INTO
; 		THE LIST.
; 
; 	ERROR MESSAGES
; 		WHEN AN ERROR CONDITION IS DETECTED,
; 		[ACCX] MUST BE SET UP TO INDICATE WHICH ERROR
; 		MESSAGE IS APPROPRIATE AND A BRANCH MUST BE MADE
; 		TO "ERROR". THE STACK WILL BE RESET AND ALL
; 		PROGRAM CONTEXT WILL BE LOST. VARIABLES
; 		VALUES AND THE ACTUAL PROGRAM REMAIN INTACT.
; 		ONLY THE VALUE OF [ACCX] IS IMPORTANT WHEN
; 		THE BRANCH IS MADE TO ERROR. [ACCX] IS USED AS AN
; 		INDEX INTO "ERRTAB" WHICH GIVES THE TWO
; 		CHARACTER ERROR MESSAGE THAT WILL BE PRINTED ON THE
; 		USER'S TERMINAL.
; 
; 
; 	TEXTUAL MESSAGES
; 		CONSTANT MESSAGES ARE STORED HERE. UNLESS
; 		THE CODE TO CHECK IF A STRING MUST BE COPIED
; 		IS CHANGED THESE STRINGS MUST BE STORED ABOVE
; 		PAGE ZERO, OR ELSE THEY WILL BE COPIED BEFORE
; 		THEY ARE PRINTED.
; 
; 	FNDFOR	
; 		MOST SMALL ROUTINES ARE FAIRLY SIMPLE
; 		AND ARE DOCUMENTED IN PLACE. "FNDFOR" IS
; 		USED FOR FINDING "FOR" ENTRIES ON
; 		THE STACK. WHENEVER A "FOR" IS EXECUTED, A
; 		16-BYTE ENTRY IS PUSHED ONTO THE STACK.
; 		BEFORE THIS IS DONE, HOWEVER, A CHECK
; 		MUST BE MADE TO SEE IF THERE
; 		ARE ANY "FOR" ENTRIES ALREADY ON THE STACK
; 		FOR THE SAME LOOP VARIABLE. IF SO, THAT "FOR" ENTRY
; 		AND ALL OTHER "FOR" ENTRIES THAT WERE MADE AFTER IT
; 		ARE ELIMINATED FROM THE STACK. THIS IS SO A
; 		PROGRAM THAT JUMPS OUT OF THE MIDDLE
; 		OF A "FOR" LOOP AND THEN RESTARTS THE LOOP AGAIN
; 		AND AGAIN WON'T USE UP 18 BYTES OF STACK
; 		SPACE EVERY TIME. THE "NEXT" CODE ALSO
; 		CALLS "FNDFOR" TO SEARCH FOR A "FOR" ENTRY WITH
; 		THE LOOP VARIABLE IN
; 		THE "NEXT". AT WHATEVER POINT A MATCH IS FOUND
; 		THE STACK IS RESET. IF NO MATCH IS FOUND A
; 		"NEXT WITHOUT FOR"  ERROR OCCURS. GOSUB EXECUTION
; 		ALSO PUTS A 5-BYTE ENTRY ON STACK.
; 		WHEN A RETURN IS EXECUTED "FNDFOR" IS
; 		CALLED WITH A VARIABLE POINTER THAT CAN'T
; 		BE MATCHED. WHEN "FNDFOR" HAS RUN
; 		THROUGH ALL THE "FOR" ENTRIES ON THE STACK  
; 		IT RETURNS AND THE RETURN CODE MAKES
; 		SURE THE ENTRY THAT WAS STOPPED
; 		ON IS A GOSUB ENTRY. THIS ASSURES THAT
; 		IF YOU GOSUB TO A SECTION OF CODE
; 		IN WHICH A FOR LOOP IS ENTERED BUT NEVER
; 		EXITED THE RETURN WILL STILL BE
; 		ABLE TO FIND THE MOST RECENT
; 		GOSUB ENTRY. THE "RETURN" CODE ELIMINATES THE
; 		"GOSUB" ENTRY AND ALL "FOR" ENTRIES MADE AFTER
; 		THE GOSUB ENTRY.
; 
; 	NON-RUNTIME STUFF
; 		THE CODE TO INPUT A LINE, CRUNCH IT, GIVE ERRORS,
; 		FIND A SPECIFIC LINE IN THE PROGRAM,
; 		PERFORM A "NEW", "CLEAR", AND "LIST" ARE
; 		ALL IN THIS AREA. GIVEN THE EXPLANATION OF
; 		PROGRAM STORAGE SET FORTH ABOVE, THESE ARE
; 		ALL STRAIGHTFORWARD.
; 
; 	NEWSTT
; 		WHENEVER A STATEMENT FINISHES EXECUTION IT
; 		DOES A "RTS" WHICH TAKES
; 		EXECUTION BACK TO "NEWSTT". STATEMENTS THAT
; 		CREATE OR LOOK AT SEMI-PERMANENT STACK ENTRIES
; 		MUST GET RID OF THE RETURN ADDRESS OF "NEWSTT" AND
; 		JMP TO "NEWSTT" WHEN DONE. "NEWSTT" ALWAYS
; 		CHRGETS THE FIRST CHARACTER AFTER THE STATEMENT
; 		NAME BEFORE DISPATCHING. WHEN RETURNING
; 		BACK TO "NEWSTT" THE ONLY THING THAT
; 		MUST BE SET UP IS THE TEXT POINTER IN
; 		"TXTPTR". "NEWSTT" WILL CHECK TO MAKE SURE
; 		"TXTPTR" IS POINTING TO A STATEMENT TERMINATOR.
; 		IF A STATEMENT SHOULDN'T BE PERFORMED UNLESS
; 		IT IS PROPERLY FORMATTED (I.E. "NEW") IT CAN
; 		SIMPLY DO A RETURN AFTER READING ALL OF
; 		ITS ARGUMENTS. SINCE THE ZERO FLAG
; 		BEING OFF INDICATES THERE IS NOT
; 		A STATEMENT TERMINATOR "NEWSTT" WILL
; 		DO THE JMP TO THE "SYNTAX ERROR"
; 		ROUTINE. IF A STATEMENT SHOULD BE STARTED
; 		OVER IT CAN DO LDWD OLDTXT, STWD TXTPTR RTS SINCE THE TEXT PNTR
; 		AT "NEWSTT" IS ALWAYS STORED IN "OLDTXT".
; 		THE ^C CODE STORES [CURLIN] (THE
; 		CURRENT LINE NUMBER) IN "OLDLIN" SINCE THE ^C CHECK
; 		IS MADE BEFORE THE STATEMENT POINTED TO IS
; 		EXECUTED. "STOP" AND "END" STORE THE TEXT POINTER
; 		FROM "TXTPTR", WHICH POINTS AT THEIR TERMINATING
; 		CHARACTER, IN "OLDTXT".
; 
; 	STATEMENT CODE
; 		THE INDIVIDUAL STATEMENT CODE COMES
; 		NEXT. THE APPROACH USED IN EXECUTING EACH
; 		STATEMENT IS DOCUMENTED IN THE STATEMENT CODE
; 		ITSELF.
; 
; 	FRMEVL, THE FORMULA EVALUATOR
; 		GIVEN A TEXT POINTER POINTING TO THE STARTING
; 		CHARACTER OF A FORMULA, "FRMEVL"
; 		EVALUATES THE FORMULA AND LEAVES
; 		THE VALUE IN THE FLOATING ACCUMULATOR (FAC).
; 		"TXTPTR" IS RETURNED POINTING TO THE FIRST CHARACTER
; 		THAT COULD NOT BE INTERPRETED AS PART OF THE
; 		FORMULA. THE ALGORITHM USES THE STACK
; 		TO STORE TEMPORARY RESULTS:
; 
; 			0. PUT A DUMMY PRECEDENCE OF ZERO ON
; 				THE STACK.
; 			1. READ LEXEME (CONSTANT,FUNCTION,
; 				VARIABLE,FORMULA IN PARENS)
; 				AND TAKE THE LAST PRECEDENCE VALUE
; 				OFF THE STACK.
; 			2. SEE IF THE NEXT CHARACTER IS AN OPERATOR.
; 				IF NOT, CHECK PREVIOUS ONE. THIS MAY CAUSE
; 				OPERATOR APPLICATION OR AN ACTUAL
; 				RETURN FROM "FRMEVL".
; 			3. IF IT IS, SEE WHAT PRECEDENCE IT HAS
; 				AND COMPARE IT TO THE PRECEDENCE
; 				OF THE LAST OPERATOR ON THE STACK.
; 			4. IF = OR LESS REMEMBER THE OPERATOR
; 				POINTER OF THIS OPERATOR
; 				AND BRANCH TO "QCHNUM" TO CAUSE
; 				APPLICATION OF THE LAST OPERATOR.
; 				EVENTUALLY RETURN TO STEP 2
; 				BY RETURNING TO JUST AFTER "DOPREC".
; 			5. IF GREATER PUT THE LAST PRECEDENCE
; 				BACK ON, SAVE THE OPERATOR ADDRESS,
; 				CURRENT TEMPORARY RESULT,
; 				AND PRECEDENCE AND RETURN TO STEP 1.
; 
; 		RELATIONAL OPERATORS ARE ALL HANDLED THROUGH
; 		A COMMON ROUTINE. SPECIAL
; 		CARE IS TAKEN TO DETECT TYPE MISMATCHES SUCH AS 3+"F".
; 
; 	EVAL -- THE ROUTINE TO READ A LEXEME
; 		"EVAL" CHECKS FOR THE DIFFERENT TYPES OF
; 		ENTITIES IT IS SUPPOSED TO DETECT.
; 		LEADING PLUSES ARE IGNORED,
; 		DIGITS AND "." CAUSE "FIN" (FLOATING INPUT)
; 		TO BE CALLED. FUNCTION NAMES CAUSE THE
; 		FORMULA INSIDE THE PARENTHESES TO BE EVALUATED
; 		AND THE FUNCTION ROUTINE TO BE CALLED. VARIABLE
; 		NAMES CAUSE "PTRGET" TO BE CALLED TO GET A POINTER
; 		TO THE VALUE, AND THEN THE VALUE IS PUT INTO
; 		THE FAC. AN OPEN PARENTHESIS CAUSES "FRMEVL"
; 		TO BE CALLED (RECURSIVELY), AND THE ")" TO
; 		BE CHECKED FOR. UNARY OPERATORS (NOT AND
; 		NEGATION)  PUT THEIR PRECEDENCE ON THE STACK
; 		AND ENTER FORMULA EVALUATION AT STEP 1, SO
; 		THAT EVERYTHING UP TO AN OPERATOR GREATER THAN
; 		THEIR PRECEDENCE OR THE END OF THE FORMULA
; 		WILL BE EVALUATED.
; 
; 	DIMENSION AND VARIABLE SEARCHING
; 		SPACE IS ALLOCATED FOR VARIABLES AS THEY ARE
; 		ENCOUNTERED. THUS "DIM" STATEMENTS MUST BE
; 		EXECUTED TO HAVE EFFECT. 6 BYTES ARE ALLOCATED
; 		FOR EACH SIMPLE VARIABLE, WHETHER IT IS A STRING,
; 		NUMBER OR USER DEFINED FUNCTION. THE FIRST TWO
; 		BYTES GIVE THE NAME OF THE VARIABLE AND THE LAST FOUR
; 		GIVE ITS VALUE. [VARTAB] GIVES THE FIRST LOCATION
; 		WHERE A SIMPLE VARIABLE NAME IS FOUND AND [ARYTAB]
; 		GIVES THE LOCATION TO STOP SEARCHING FOR SIMPLE
; 		VARIABLES. A "FOR" ENTRY HAS A TEXT POINTER
; 		AND A POINTER TO A VARIABLE VALUE SO NEITHER
; 		THE PROGRAM OR THE SIMPLE VARIABLES CAN BE
; 		MOVED WHILE THERE ARE ACTIVE "FOR" ENTRIES ON THE STACK.
; 		USER DEFINED FUNCTION VALUES ALSO CONTAIN
; 		POINTERS INTO SIMPLE VARIABLE SPACE SO NO USER-DEFINED
; 		FUNCTION VALUES CAN BE RETAINED IF SIMPLE VARIABLES
; 		ARE MOVED. ADDING A SIMPLE VARIABLE IS JUST
; 		ADDING SIX TO [ARYTAB] AND [STREND], BLOCK TRANSFERING
; 		THE ARRAY VARIABLES UP BY SIX AND MAKING SURE THE
; 		NEW [STREND] IS NOT TOO CLOSE TO THE STRINGS.
; 		THIS MOVEMENT OF ARRAY VARIABLES MEANS
; 		THAT NO POINTER TO AN ARRAY WILL STAY VALID WHEN
; 		NEW SIMPLE VARIABLES CAN BE ENCOUNTERED. THIS IS
; 		WHY ARRAY VARIABLES ARE NOT ALLOWED FOR "FOR"
; 		LOOP VARIABLES. SETTING UP A NEW ARRAY VARIABLE
; 		MERELY INVOLVES BUILDING THE DESCRIPTOR,
; 		UPDATING [STREND], AND MAKING SURE THERE IS
; 		STILL ENOUGH ROOM BETWEEN [STREND] AND STRING SPACE.
; 		"PTRGET", THE ROUTINE WHICH RETURNS A POINTER
; 		TO A VARIABLE VALUE, HAS TWO IMPORTANT FLAGS. ONE IS
; 		"DIMFLG" WHICH INDICATES WHETHER "DIM" CALLED "PTRGET"
; 		OR NOT. IF SO, NO PRIOR ENTRY FOR THE VARIABLE IN
; 		QUESTION SHOULD BE FOUND, AND THE INDEX INDICATES
; 		HOW MUCH SPACE TO SET ASIDE. SIMPLE VARIABLES CAN
; 		BE "DIMENSIONED", BUT THE ONLY EFFECT WILL BE TO
; 		SET ASIDE SPACE FOR THE VARIABLE IF IT HASN'T BEEN
; 		ENCOUNTERED YET. THE OTHER IMPORTANT FLAG IS "SUBFLG"
; 		WHICH INDICATES WHETHER A SUBSCRIPTED VARIABLE SHOULD BE
; 		ALLOWED IN THE CURRENT CONTEXT. IF [SUBFLG] IS NON-ZERO
; 		THE OPEN PARENTHESIS FOR A SUBSCRIPTED VARIABLE
; 		WILL NOT BE SCANNED BY "PTRGET", AND "PTRGET" WILL RETURN
; 		WITH A TEXT POINTER POINTING TO THE "(", IF
; 		THERE WAS ONE.
; 	STRINGS
; 		IN THE VARIABLE TABLES STRINGS ARE STORED JUST LIKE
; 		NUMERIC VARIABLES. SIMPLE STRINGS HAVE THREE VALUE
; 		BYTES WHICH ARE INITIALIZED TO ALL ZEROS (WHICH
; 		REPRESENTS THE NULL STRING). THE ONLY DIFFERENCE
; 		IN HANDLING IS THAT WHEN "PTRGET" SEES A "$" AFTER THE
; 		NAME OF A VARIABLE, "PTRGET" SETS [VALTYP]
; 		TO NEGATIVE ONE AND TURNS
; 		ON THE MSB (MOST-SIGNIFIGANT-BIT) OF THE VALUE OF
; 		THE FIRST CHARACTER OF THE VARIABLE NAME.
; 		HAVING THIS BIT ON IN THE NAME OF THE VARIABLE ENSURES
; 		THAT THE SEARCH ROUTINE WILL NOT MATCH
; 		'A' WITH 'A$' OR 'A$' WITH 'A'. THE MEANING OF
; 		THE THREE VALUE BYTES ARE:
; 			LOW
; 				LENGTH OF THE STRING
; 				LOW 8 BITS
; 				HIGH 8 BITS  OF THE ADDRESS
; 					OF THE CHARACTERS IN THE
; 					STRING IF LENGTH.NE.0.
; 					MEANINGLESS OTHERWISE.
; 			HIGH
; 		THE VALUE OF A STRING VARIABLE (THESE 3 BYTES)
; 		IS CALLED THE STRING DESCRIPTOR TO DISTINGUISH
; 		IT FROM THE ACTUAL STRING DATA. WHENEVER A
; 		STRING CONSTANT IS ENCOUNTERED IN A FORMULA OR AS
; 		PART OF AN INPUT STRING, OR AS PART OF DATA, "STRLIT"
; 		IS CALLED, CAUSING A DESCRIPTOR TO BE BUILT FOR
; 		THE STRING. WHEN ASSIGNMENT IS MADE TO A STRING POINTING INTO
; 		"BUF" THE VALUE IS COPIED INTO STRING SPACE SINCE [BUF]
; 		IS ALWAYS CHANGING.
; 
; 		STRING FUNCTIONS AND THE ONE STRING OPERATOR "+"
; 		ALWAYS RETURN THEIR VALUES IN STRING SPACE.
; 		ASSIGNING A STRING A CONSTANT VALUE IN A PROGRAM
; 		THROUGH A "READ" OR ASSIGNMENT STATEMENT
; 		WILL NOT USE ANY STRING SPACE SINCE
; 		THE STRING DESCRIPTOR  WILL POINT INTO THE
; 		PROGRAM ITSELF. IN GENERAL, COPYING IS DONE
; 		WHEN A STRING VALUE IS IN "BUF", OR IT IS IN STRING
; 		SPACE AND THERE IS AN ACTIVE POINTER TO IT.
; 		THUS F$=G$ WILL CAUSE COPYING IF G$ HAS ITS
; 		STRING DATA IN STRING SPACE. F$=CHR$(7)
; 		WILL USE ONE BYTE OF STRING SPACE TO STORE THE
; 		NEW ONE CHARACTER STRING CREATED BY "CHR$", BUT
; 		THE ASSIGNMENT ITSELF WILL CAUSE NO COPYING SINCE
; 		THE ONLY POINTER AT THE NEW STRING IS A
; 		TEMPORARY DESCRIPTOR CREATED BY "FRMEVL" WHICH WILL
; 		GO AWAY AS SOON AS THE ASSIGNMENT IS DONE.
; 		IT IS THE NATURE OF GARBAGE COLLECTION THAT
; 		DISALLOWS HAVING TWO STRING DESCRIPTORS POINT TO THE SAME
; 		AREA IN STRING SPACE. STRING FUNCTIONS AND OPERATORS
; 		MUST PROCEED AS FOLLOWS:
; 			1) FIGURE OUT THE LENGTH OF THEIR RESULT.
; 
; 			2) CALL "GETSPA" TO FIND SPACE FOR THEIR
; 			RESULT. THE ARGUMENTS TO THE FUNCTION
; 			OR OPERATOR MAY CHANGE SINCE GARBAGE COLLECTION
; 			MAY BE INVOKED. THE ONLY THING THAT CAN
; 			BE SAVED DURING THE CALL TO "GETSPA" IS A POINTER
; 			TO THE DESCRIPTORS OF THE ARGUMENTS.
; 			3) CONSTRUCT THE RESULT DESCRIPTOR IN "DSCTMP".
; 			"GETSPA" RETURNS THE LOCATION OF THE AVAILABLE
; 			SPACE.
; 			4) CREATE THE NEW VALUE BY COPYING PARTS
; 			OF THE ARGUMENTS OR WHATEVER.
; 			5) FREE UP THE ARGUMENTS BY CALLING "FRETMP".
; 			6) JUMP TO "PUTNEW" TO GET THE DESCRIPTOR IN
; 			"DSCTMP" TRANSFERRED INTO A NEW STRING TEMPORARY.
; 
; 		THE REASON FOR STRING TEMPORARIES IS THAT GARBAGE
; 		COLLECTION HAS TO KNOW ABOUT ALL ACTIVE STRING DESCRIPTORS
; 		SO IT KNOWS WHAT IS AND ISN'T IN USE. STRING TEMPORARIES ARE
; 		USED TO STORE THE DESCRIPTORS OF STRING EXPRESSIONS.
; 		
; 		INSTEAD OF HAVING AN ACTUAL VALUE STORED IN THE
; 		FAC, AND HAVING THE VALUE OF A TEMPORARY RESULT
; 		BEING SAVED ON THE STACK, AS HAPPENS WITH NUMERIC
; 		VARIABLES, STRINGS HAVE THE POINTER TO A STRING DESCRIPTOR
; 		STORED IN THE FAC, AND IT IS THIS POINTER
; 		THAT GETS SAVED ON THE STACK BY FORMULA EVALUATION.
; 		STRING FUNCTIONS CANNOT FREE THEIR ARGUMENTS UP RIGHT
; 		AWAY SINCE "GETSPA" MAY FORCE
; 		GARBAGE COLLECTION AND THE ARGUMENT STRINGS
; 		MAY BE OVER-WRITTEN SINCE GARBAGE COLLECTION
; 		WILL NOT BE ABLE TO FIND AN ACTIVE POINTER TO
; 		THEM. FUNCTION AND OPERATOR RESULTS ARE BUILT IN
; 		"DSCTMP" SINCE STRING TEMPORARIES ARE ALLOCATED
; 		(PUTNEW) AND DEALLOCATED (FRETMP) IN A FIFO ORDERING
; 		(I.E. A STACK) SO THE NEW TEMPORARY CANNOT
; 		BE SET UP UNTIL THE OLD ONE(S) ARE FREED. TRYING
; 		TO BUILD A RESULT IN A TEMPORARY AFTER
; 		FREEING UP THE ARGUMENT TEMPORARIES COULD RESULT
; 		IN ONE OF THE ARGUMENT TEMPORARIES BEING OVERWRITTEN
; 		TOO SOON BY THE NEW RESULT.
; 
; 		STRING SPACE IS ALLOCATED AT THE VERY TOP
; 		OF MEMORY. "MEMSIZ" POINTS BEYOND THE LAST LOCATION OF
; 		STRING SPACE. STRINGS ARE STORED IN HIGH LOCATIONS
; 		FIRST. WHENEVER STRING SPACE IS ALLOCATED (GETSPA).
; 		[FRETOP], WHICH IS INITIALIZED TO [MEMSIZ], IS UPDATED
; 		TO GIVE THE HIGHEST LOCATION IN STRING SPACE
; 		THAT IS NOT IN USE. THE RESULT IS THAT
; 		[FRETOP] GETS SMALLER AND SMALLER, UNTIL SOME
; 		ALLOCATION WOULD MAKE [FRETOP] LESS THAN OR EQUAL TO
; 		[STREND]. THIS MEANS STRING SPACE HAS RUN INTO THE
; 		THE ARRAYS AND THAT GARBAGE COLLECTION MUST BE CALLED.
; 
; 		GARBAGE COLLECTION:
; 			0. [MINPTR]=[STREND] [FRETOP]=[MEMSIZ]
; 			1. [REMMIN]=0
; 			2. FOR EACH STRING DESCRIPTOR
; 			(TEMPORARIES, SIMPLE STRINGS, STRING ARRAYS)
; 			IF THE STRING IS NOT NULL AND ITS POINTER IS
; 			.GT.MINPTR AND .LT.FRETOP,
; 			[MINPTR]=THIS STRING DESCRIPTOR'S POINTER,
; 			[REMMIN]=POINTER AT THIS STRING DESCRIPTOR.
; 			END.
; 			3. IF REMMIN.NE.0 (WE FOUND AN UNCOLLECTED STRING),
; 			BLOCK TRANSFER THE STRING DATA POINTED
; 			TO IN THE STRING DESCRIPTOR POINTED TO BY "REMMIN"
; 			SO THAT THE LAST BYTE OF STRING DATA IS AT
; 			[FRETOP]. UPDATE [FRETOP] SO THAT IT
; 			POINTS TO THE LOCATION JUST BELOW THE ONE
; 			THE STRING DATA WAS MOVED INTO. UPDATE
; 			THE POINTER IN THE DESCRIPTOR SO IT POINTS
; 			TO THE NEW LOCATION OF THE STRING DATA.
; 			GO TO STEP 1.
; 
; 		AFTER CALLING GARBAGE COLLECTION "GETSPA" AGAIN CHECKS
; 		TO SEE IF [ACCA] CHARACTERS ARE AVAILABLE BETWEEN
; 		[STREND] AND [FRETOP]; IF NOT, AN "OUT OF STRING"
; 		ERROR IS INVOKED.
; 
; 	MATH PACKAGE
; 		THE MATH PACKAGE CONTAINS FLOATING INPUT (FIN),
; 		FLOATING OUTPUT (FOUT), FLOATING COMPARE (FCOMP)
; 		... AND ALL THE NUMERIC OPERATORS AND FUNCTIONS.
; 		THE FORMATS, CONVENTIONS AND ENTRY POINTS ARE ALL
; 		DESCRIBED IN THE MATH PACKAGE ITSELF.
; 
; 	INIT -- THE INITIALIZATION ROUTINE
; 		THE AMOUNT OF MEMORY,
; 		TERMINAL WIDTH, AND WHICH FUNCTIONS TO BE RETAINED
; 		ARE ASCERTAINED FROM THE USER. A ZERO IS PUT DOWN
; 		AT THE FIRST LOCATION NOT USED BY THE MATH-PACKAGE
; 		AND [TXTTAB] IS SET UP TO POINT AT THE NEXT LOCATION.
; 		THIS DETERMINES WHERE PROGRAM STORAGE WILL START.
; 		SPECIAL CHECKS ARE MADE TO MAKE SURE
; 		ALL QUESTIONS IN "INIT" ARE ANSWERED REASONABLY, SINCE
; 		ONCE "INIT" FINISHES, THE LOCATIONS IT USES ARE
; 		USED FOR PROGRAM STORAGE. THE LAST THING "INIT" DOES IS
; 		CHANGE LOCATION ZERO TO BE A JUMP TO "READY" INSTEAD
; 		OF "INIT". ONCE THIS IS DONE THERE IS NO WAY TO RESTART
; 		"INIT".
; HIGH LOCATIONS
; 
; *
; PAGE ZERO.
.if (REALIO-3) <> 0
;INITIALIZE - SETUP CERTAIN LOCATIONS
START:
    jmp INIT
;AND DELETE FUNCTIONS IF NOT NEEDED,
;AND CHANGE THIS TO "JMP READY"
;IN CASE USER RESTARTS AT LOC ZERO.
;CHANGED TO "JMP STROUT" BY "INIT"
RDYJSR:
    jmp INIT
;TO HANDLE ERRORS.
;STORE HERE THE ADDR OF THE
ADRAYI:
    .word (AYINT)
;ROUTINE TO TURN THE FAC INTO A 
;TWO BYTE SIGNED INTEGER IN [Y,A]
;STORE HERE THE ADDR OF THE
ADRGAY:
    .word (GIVAYF)
.endif
;ROUTINE TO CONVERT [Y,A] TO A FLOATING
;POINT NUMBER IN THE FAC.
.if (ROMSW) <> 0
;SET UP ORIG BY INIT.
USRPOK:
    jmp FCERR
.endif
;
; THIS IS THE "VOLATILE" STORAGE AREA AND NONE OF IT
; CAN BE KEPT IN ROM. ANY CONSTANTS IN THIS AREA CANNOT
; BE KEPT IN A ROM, BUT MUST BE LOADED IN BY THE 
; PROGRAM INSTRUCTIONS IN ROM.
;
; --- GENERAL RAM ---:
;A DELIMITING CHARACTER.
CHARAC:
    .res 1, 0
;A ONE-BYTE INTEGER FROM "QINT".
INTEGR = CHARAC
;THE OTHER DELIMITING CHARACTER.
ENDCHR:
    .res 1, 0
;A GENERAL COUNTER.
COUNT:
    .res 1, 0

; --- FLAGS ---:
;IN GETTING A POINTER TO A VARIABLE
DIMFLG:
    .res 1, 0
;IT IS IMPORTANT TO REMEMBER WHETHER IT
;IS BEING DONE FOR "DIM" OR NOT.
;DIMFLG AND VALTYP MUST BE
;CONSECUTIVE LOCATIONS.
;PLACE TO PRESERVE Y DURING OUT.
KIMY = DIMFLG
;THE TYPE INDICATOR.
VALTYP:
    .res 1, 0
;0=NUMERIC 1=STRING.
.if (INTPRC) <> 0
;TELLS IF INTEGER.
INTFLG:
    .res 1, 0
.endif
;WHETHER CAN OR CAN'T CRUNCH RES'D WORDS.
DORES:
    .res 1, 0
;TURNED ON WHEN "DATA"
;BEING SCANNED BY CRUNCH SO UNQUOTED
;STRINGS WON'T BE CRUNCHED.
;WHETHER TO DO GARBAGE COLLECTION.
GARBFL = DORES
;FLAG WHETHER SUB'D VARIABLE ALLOWED.
SUBFLG:
    .res 1, 0
;"FOR" AND USER-DEFINED FUNCTION
;POINTER FETCHING TURN
;THIS ON BEFORE CALLING "PTRGET"
;SO ARRAYS WON'T BE DETECTED.
;"STKINI" AND "PTRGET" CLEAR IT.
;ALSO DISALLOWS INTEGERS THERE.
;FLAGS WHETHER WE ARE DOING "INPUT"
INPFLG:
    .res 1, 0
;OR "READ".
;USED IN DETERMINING SIGN OF TANGENT.
TANSGN:
    .res 1, 0
.if (REALIO) <> 0
;SUPPRESS OUTPUT FLAG.
CNTWFL:
    .res 1, 0
.endif
;NON-ZERO MEANS SUPPRESS.
;RESET BY "INPUT", READY AND ERRORS.
;COMPLEMENTED BY INPUT OF ^O.

;ROOM FOR APPLE PAGE 0 STUFF.
.if (REALIO-4) = 0
    .res (80) - *, 0
.endif
; --- RAM DEALING WITH TERMINAL HANDLING ---:
.if (EXTIO) <> 0
;HOLDS CHANNEL NUMBER.
CHANNL:
    .res 1, 0
.endif
.if (NULCMD) <> 0
;NUMBER OF NULLS TO PRINT.
NULCNT:
    .byte 0
.endif
.if (REALIO-3) <> 0
;POSITION OF TERMINAL CARRIAGE.
TRMPOS:
    .res 1, 0
.endif
;LENGTH OF LINE (WIDTH).
LINWID:
    .byte LINLEN
;POSITION BEYOND WHICH THERE ARE
NCMWID:
    .byte NCMPOS
;NO MORE FIELDS.
;LOCATION TO STORE LINE NUMBER BEFORE BUF
LINNUM:
    .byte 0
;SO THAT "BLTUC" CAN STORE IT ALL AWAY AT ONCE.
;A COMMA (PRELOAD OR FROM ROM)
    .byte 44
;USED BY INPUT STATEMENT SINCE THE
;DATA POINTER ALWAYS STARTS ON A
;COMMA OR TERMINATOR.
.if (BUFPAG) = 0
;TYPE IN STORED HERE.
BUF:
    .res BUFLEN, 0
.endif
;DIRECT STATEMENTS EXECUTE OUT OF
;HERE. REMEMBER "INPUT" SMASHES BUF.
;MUST BE ON PAGE ZERO
;OR ASSIGNMENT OF STRING
;VALUES IN DIRECT STATEMENTS WON'T COPY
;INTO STRING SPACE -- WHICH IT MUST.
;N.B. TWO NONZERO BYTES MUST PRECEDE "BUFLNM".

; --- STORAGE FOR TEMPORARY THINGS ---:
;POINTER AT FIRST FREE TEMP DESCRIPTOR.
TEMPPT:
    .res 1, 0
;INITIALIZED TO POINT TO TEMPST.
;POINTER TO LAST-USED STRING TEMPORARY.
LASTPT:
    .res 2, 0
;STORAGE FOR NUMTMP TEMP DESCRIPTORS.
TEMPST:
    .res STRSIZ*NUMTMP, 0
;INDEXES.
INDEX1:
    .res 2, 0
INDEX = INDEX1
INDEX2:
    .res 2, 0
;RESULT OF MULTIPLIER AND DIVIDER.
RESHO:
    .res 1, 0
.if (ADDPRC) <> 0
;ONE MORE BYTE.
RESMOH:
    .res 1, 0
.endif
RESMO:
    .res 1, 0
RESLO:
    .res 1, 0
;TEMPORARY USED BY "UMULT".
ADDEND = RESMO
;OVERFLOW FOR RES.
    .byte 0

; --- POINTERS INTO DYNAMIC DATA STRUCTURES ---;
;POINTER TO BEGINNING OF TEXT.
TXTTAB:
    .res 2, 0
;DOESN'T CHANGE AFTER BEING
;SETUP BY "INIT".
;POINTER TO START OF SIMPLE
VARTAB:
    .res 2, 0
;VARIABLE SPACE.
;UPDATED WHENEVER THE SIZE OF THE
;PROGRAM CHANGES, SET TO [TXTTAB]
;BY "SCRATCH" ("NEW").
;POINTER TO BEGINNING OF ARRAY
ARYTAB:
    .res 2, 0
;TABLE.
;INCREMENTED BY 6 WHENEVER
;A NEW SIMPLE VARIABLE IS FOUND, AND
;SET TO [VARTAB] BY "CLEARC".
;END OF STORAGE IN USE.
STREND:
    .res 2, 0
;INCREASED WHENEVER A NEW ARRAY
;OR SIMPLE VARIABLE IS ENCOUNTERED.
;SET TO [VARTAB] BY "CLEARC".
;TOP OF STRING FREE SPACE.
FRETOP:
    .res 2, 0
;POINTER TO NEW STRING.
FRESPC:
    .res 2, 0
;HIGHEST LOCATION IN MEMORY.
MEMSIZ:
    .res 2, 0

; --- LINE NUMBERS AND TEXTUAL POINTERS ---:
;CURRENT LINE #.
CURLIN:
    .res 2, 0
;SET TO 0,255 FOR DIRECT STATEMENTS.
;OLD LINE NUMBER (SETUP BY ^C,"STOP"
OLDLIN:
    .res 2, 0
;OR "END" IN A PROGRAM).
;SET UP LOCATION USED BY POKE.
POKER = LINNUM
;TEMPORARY FOR INPUT AND READ CODE
;OLD TEXT POINTER.
OLDTXT:
    .res 2, 0
;POINTS AT STATEMENT TO BE EXEC'D NEXT.
;DATA LINE # -- REMEMBER FOR ERRORS.
DATLIN:
    .res 2, 0
;POINTER TO DATA. INITIALIZED TO POINT
DATPTR:
    .res 2, 0
;AT THE ZERO IN FRONT OF [TXTTAB]
;BY "RESTORE" WHICH IS CALLED BY "CLEARC".
;UPDATED BY EXECUTION OF A "READ".
;THIS REMEMBERS WHERE INPUT IS COMING FROM.
INPPTR:
    .res 2, 0

; --- STUFF USED IN EVALUATIONS ---:
;VARIABLE'S NAME IS STORED HERE.
VARNAM:
    .res 2, 0
;POINTER TO VARIABLE IN MEMORY.
VARPNT:
    .res 2, 0
;POINTER INTO POWER OF TENS OF "FOUT".
FDECPT = VARPNT
;A VARIABLE'S POINTER FOR "FOR" LOOPS
FORPNT:
    .res 2, 0
;AND "LET" STATEMENTS.
;PNTR TO LIST STRING.
LSTPNT = FORPNT
;THE MASK USED BY WAIT FOR ANDING.
ANDMSK = FORPNT
;THE MASK FOR EORING IN WAIT.
EORMSK = FORPNT+1
;POINTER TO CURRENT OP'S ENTRY IN "OPTAB".
OPPTR:
    .res 2, 0
;POINTER INTO LIST OF VARIABLES.
VARTXT = OPPTR
;MASK CREATED BY CURRENT OPERATOR.
OPMASK:
    .res 1, 0
;MASK IN USE BY RELATION OPERATIONS.
DOMASK = TANSGN
;POINTER USED IN FUNCTION DEFINITION.
DEFPNT:
    .res 2, 0
;ANOTHER USED IN GARBAGE COLLECTION.
GRBPNT = DEFPNT
;POINTER TO A STRING DESCRIPTOR.
DSCPNT:
    .res 2, 0
;FOR TEMPF3.
.if (ADDPRC) <> 0
    .res 1, 0
.endif
;VARIABLE CONSTANT USED BY GARB COLLECT.
FOUR6:
    .byte STRSIZ

; --- ET CETERA ---:
JMPER:
    jmp 60000
SIZE = JMPER+1
;THE OLD OVERFLOW.
OLDOV = JMPER+2
;A THIRD FAC TEMPORARY (4 BYTES).
TEMPF3 = DEFPNT
TEMPF1:
;FOR TEMPF1S EXTRA BYTE.
.if (ADDPRC) <> 0
    .byte 0
.endif
;DESINATION OF HIGHEST ELEMENT IN BLT.
HIGHDS:
    .res 2, 0
;SOURCE OF HIGHEST ELEMENT TO MOVE.
HIGHTR:
    .res 2, 0
TEMPF2:
;FOR TEMPF2S EXTRA BYTE.
.if (ADDPRC) <> 0
    .byte 0
.endif
;LOCATION OF LAST BYTE TRANSFERRED INTO.
LOWDS:
    .res 2, 0
;LAST THING TO MOVE IN BLT.
LOWTR:
    .res 2, 0
;A POINTER USED IN ARRAY BUILDING.
ARYPNT = HIGHDS
;A POINTER USED IN GARBAGE COLLECTION.
GRBTOP = LOWTR
;NUMBER OF PLACES BEFORE DECIMAL POINT.
DECCNT = LOWDS
;HAS A DPT BEEN INPUT?
TENEXP = LOWDS+1
;BASE TEN EXPONENT.
DPTFLG = LOWTR
;SIGN OF BASE TEN EXPONENT.
EXPSGN = LOWTR+1

; --- THE FLOATING ACCUMULATOR ---:
FAC:
FACEXP:
    .byte 0
;MOST SIGNIFICANT BYTE OF MANTISSA.
FACHO:
    .byte 0
.if (ADDPRC) <> 0
;ONE MORE.
FACMOH:
    .byte 0
.endif
;MIDDLE ORDER OF MANTISSA.
FACMO:
    .byte 0
;LEAST SIG BYTE OF MANTISSA.
FACLO:
    .byte 0
;SIGN OF FAC (0 OR -1) WHEN UNPACKED.
FACSGN:
    .byte 0
;SIGN OF FAC IS PRESERVED BERE BY "FIN".
SGNFLG:
    .byte 0
;A COUNT USED BY POLYNOMIALS.
DEGREE = SGNFLG
;THIS IS WHERE TEMP DESCS ARE BUILT.
DSCTMP = FAC
;INDICE IS SET UP HERE BY "QINT".
INDICE = FACMO
;SOMETHING FOR "SHIFTR" TO USE.
BITS:
    .byte 0

; --- THE FLOATING ARGUMENT (UNPACKED) ---:
ARGEXP:
    .byte 0
ARGHO:
    .byte 0
.if (ADDPRC) <> 0
ARGMOH:
    .byte 0
.endif
ARGMO:
    .byte 0
ARGLO:
    .byte 0
ARGSGN:
    .byte 0

;A SIGN REFLECTING THE RESULT.
ARISGN:
    .byte 0
;OVERFLOW BYTE OF THE FAC.
FACOV:
    .byte 0
;POINTER TO A STRING OR DESCRIPTOR.
STRNG1 = ARISGN

;POINTER INTO FBUFFR USED BY FOUT.
FBUFPT:
    .res 2, 0
;POINTER TO BUF USED BY "CRUNCH".
BUFPTR = FBUFPT
;POINTER TO STRING OR DESC.
STRNG2 = FBUFPT
;POINTER INTO POLYNOMIAL COEFFICIENTS.
POLYPT = FBUFPT
;ABSOLUTE LINEAR INDEX IS FORMED HERE.
CURTOL = FBUFPT
; RAM CODE.
; THIS CODE GETS CHANGED THROUGHOUT EXECUTION.
; IT IS MADE TO BE FAST THIS WAY.
; ALSO, [X] AND [Y] ARE NOT DISTURBED
;
; "CHRGET" USING [TXTPTR] AS THE CURRENT TEXT PNTR
; FETCHES A NEW CHARACTER INTO ACCA AFTER INCREMENTING [TXTPTR]
; AND SETS CONDITION CODES ACCORDING TO WHAT'S IN ACCA.
;	NOT C=	NUMERIC	  ("0" THRU "9")
;	Z=	":" OR END-OF-LINE (A NULL)
;
; [ACCA] = NEW CHAR.
; [TXTPTR]=[TXTPTR]+1
;
; THE FOLLOWING EXISTS IN ROM IF ROM EXISTS AND IS LOADED
; DOWN HERE BY INIT. OTHERWISE IT IS JUST LOADED INTO THIS
; RAM LIKE ALL THE REST OF RAM IS LOADED.
;
;INCREMENT THE WHOLE TXTPTR.
CHRGET:
    inc CHRGET+7
    bne CHRGOT
    inc CHRGET+8
;A LOAD WITH AN EXT ADDR.
CHRGOT:
    lda 60000
TXTPTR = CHRGOT+1
;SKIP SPACES.
    cmp #.lobyte(32)
    beq CHRGET
;IS IT A ":"?
QNUM:
    cmp #.lobyte(58)
;IT IS .GE. ":"
    bcs CHRRTS
    sec
;ALL CHARS .GT. "9" HAVE RET'D SO
    sbc #.lobyte(48)
    sec
;SEE IF NUMERIC.
    sbc #.lobyte(256-48)
;TURN CARRY ON IF NUMERIC.
;ALSO, SETZ IF NULL.
;RETURN TO CALLER.
CHRRTS:
    rts

;LOADED OR FROM ROM.
RNDX:
    .byte 128
;THE INITIAL RANDOM NUMBER.
    .byte 79
    .byte 199
    .byte 82
;ONE MORE BYTE.
.if (ADDPRC) <> 0
    .byte 89
.endif

;PAGE 1 STUFF COMING UP.
    .res (255) - *, 0
;THE LOW FAC BUFFER. COPYABLE.
LOFBUF:
    .res 1, 0
;---  PAGE ZERO/ONE BOUNDARY ---.
;MUST HAVE 13 CONTIGUOUS BYTES.
;BUFFER FOR "FOUT".
FBUFFR:
    .res 3*ADDPRC+13, 0
;ON PAGE 1 SO THAT STRING IS NOT COPIED.

;STACK IS LOCATED HERE. IE FROM THE END OF FBUFFR TO STKEND.
; DISPATCH TABLES, RESERVED WORDS, AND ERROR TEXTS.

.segment "BASIC"
.org ROMLOC
.if REALIO = 6
.assert * = $C000, error, "IMNOTWOPR ROM must start at $C000"
.else
.assert * = $0800, error, "Apple ROM must start at $0800"
.endif

STMDSP:
    .word (END-1)
    .word (FOR-1)
    .word (NEXT-1)
    .word (DATA-1)
.if (EXTIO) <> 0
    .word (INPUTN-1)
.endif
    .word (INPUT-1)
    .word (DIM-1)
    .word (READ-1)
    .word (LET-1)
    .word (GOTO-1)
    .word (RUN-1)
    .word (IF-1)
    .word (RESTOR-1)
    .word (GOSUB-1)
    .word (RETURN-1)
    .word (REM-1)
    .word (STOP-1)
    .word (ONGOTO-1)
.if (NULCMD) <> 0
    .word (NULL-1)
.endif
    .word (FNWAIT-1)
.if (DISKO) <> 0
.if (REALIO-3) = 0
    .word (CQLOAD-1)
    .word (CQSAVE-1)
    .word (CQVERF-1)
.endif
.if (REALIO) <> 0
.if (REALIO-2) <> 0
.if (REALIO-3) <> 0
.if (REALIO-5) <> 0
    .word (LOAD-1)
    .word (SAVE-1)
.endif
.endif
.endif
.endif
.if (REALIO-1) <> 0
.if (REALIO-3) <> 0
.if (REALIO-4) <> 0
;ADDRESS OF LOAD
    .word (511)
;ADDRESS OF SAVE
    .word (511)
.endif
.endif
.endif
.endif
    .word (DEF-1)
    .word (POKE-1)
.if (EXTIO) <> 0
    .word (PRINTN-1)
.endif
    .word (PRINT-1)
    .word (CONT-1)
.if (REALIO) = 0
    .word (DDT-1)
.endif
    .word (LIST-1)
    .word (CLEAR-1)
.if (EXTIO) <> 0
    .word (CMD-1)
    .word (CQSYS-1)
    .word (CQOPEN-1)
    .word (CQCLOS-1)
.endif
.if (GETCMD) <> 0
;FILL W/ GET ADDR.
    .word (GET-1)
.endif
    .word (SCRATH-1)

FUNDSP:
    .word (SGN)
    .word (INT)
    .word (ABS)
.if (ROMSW) = 0
;INITIALLY NO USER ROUTINE.
USRLOC:
    .word (FCERR)
.endif
.if (ROMSW) <> 0
USRLOC:
    .word (USRPOK)
.endif
    .word (FRE)
    .word (POS)
    .word (SQR)
    .word (RND)
    .word (LOG)
    .word (EXP)
.if (KIMROM) <> 0
.repeat 4
    .word (FCERR)
.endrepeat
.endif
.if (KIMROM) = 0
COSFIX:
    .word (COS)
SINFIX:
    .word (SIN)
TANFIX:
    .word (TAN)
ATNFIX:
    .word (ATN)
.endif
    .word (PEEK)
    .word (LEN)
    .word (STR)
    .word (VAL)
    .word (ASC)
    .word (CHR)
    .word (LEFT)
    .word (RIGHT)
    .word (MID)
OPTAB:
    .byte 121
    .word (FADDT-1)
    .byte 121
    .word (FSUBT-1)
    .byte 123
    .word (FMULTT-1)
    .byte 123
    .word (FDIVT-1)
    .byte 127
    .word (FPWRT-1)
    .byte 80
    .word (ANDOP-1)
    .byte 70
    .word (OROP-1)
NEGTAB:
    .byte 125
    .word (NEGOP-1)
NOTTAB:
    .byte 90
    .word (NOTOP-1)
;PRECEDENCE.
PTDORL:
    .byte 100
;OPERATOR ADDRESS.
    .word (DOREL-1)
;
; TOKENS FOR RESERVED WORDS ALWAYS HAVE THE MOST
; SIGNIFICANT BIT ON.
; THE LIST OF RESERVED WORDS:
;
Q .set 128-1
.macro DCI text
Q .set Q+1
    DC text
.endmacro
RESLST:
    DCI "END"
ENDTK = Q
    DCI "FOR"
FORTK = Q
    DCI "NEXT"
    DCI "DATA"
DATATK = Q
.if (EXTIO) <> 0
    DCI "INPUT#"
.endif
    DCI "INPUT"
    DCI "DIM"
    DCI "READ"
    DCI "LET"
    DCI "GOTO"
GOTOTK = Q
    DCI "RUN"
    DCI "IF"
    DCI "RESTORE"
    DCI "GOSUB"
GOSUTK = Q
    DCI "RETURN"
    DCI "REM"
REMTK = Q
    DCI "STOP"
    DCI "ON"
.if (NULCMD) <> 0
    DCI "NULL"
.endif
    DCI "WAIT"
.if (DISKO) <> 0
    DCI "LOAD"
    DCI "SAVE"
.if (REALIO-3) = 0
    DCI "VERIFY"
.endif
.endif
    DCI "DEF"
    DCI "POKE"
.if (EXTIO) <> 0
    DCI "PRINT#"
.endif
    DCI "PRINT"
PRINTK = Q
    DCI "CONT"
.if (REALIO) = 0
    DCI "DDT"
.endif
    DCI "LIST"
.if (REALIO-3) <> 0
    DCI "CLEAR"
.endif
.if (REALIO-3) = 0
    DCI "CLR"
.endif
.if (EXTIO) <> 0
    DCI "CMD"
    DCI "SYS"
    DCI "OPEN"
    DCI "CLOSE"
.endif
.if (GETCMD) <> 0
    DCI "GET"
.endif
    DCI "NEW"
SCRATK = Q
; END OF COMMAND LIST.
    .byte 84
    .byte 65
    .byte 66
    .byte 40+128
Q .set Q+1
TABTK = Q
    DCI "TO"
TOTK = Q
    DCI "FN"
FNTK = Q
    .byte 83
    .byte 80
    .byte 67
;MACRO DOESNT LIKE ('S IN ARGUMENTS.
    .byte 40+128
Q .set Q+1
SPCTK = Q
    DCI "THEN"
THENTK = Q
    DCI "NOT"
NOTTK = Q
    DCI "STEP"
STEPTK = Q
    DCI "+"
PLUSTK = Q
    DCI "-"
MINUTK = Q
    DCI "*"
    DCI "/"
    DCI "^"
    DCI "AND"
    DCI "OR"
;A GREATER THAN SIGN
    .byte 190
Q .set Q+1
GREATK = Q
    DCI "="
EQULTK = Q
    .byte 188
;A LESS THAN SIGN
Q .set Q+1
LESSTK = Q
;
; NOTE DANGER OF ONE RESERVED WORD BEING A PART
; OF ANOTHER:
; IE . . IF 2 GREATER THAN F OR T=5 THEN...
; WILL NOT WORK!!! SINCE "FOR" WILL BE CRUNCHED!!
; IN ANY CASE MAKE SURE THE SMALLER WORD APPEARS
; SECOND IN THE RESERVED WORD TABLE ("INP" AND "INPUT")
; ANOTHER EXAMPLE: IF T OR Q THEN ... "TO" IS CRUNCHED
;
    DCI "SGN"
ONEFUN = Q
    DCI "INT"
    DCI "ABS"
    DCI "USR"
    DCI "FRE"
    DCI "POS"
    DCI "SQR"
    DCI "RND"
    DCI "LOG"
    DCI "EXP"
    DCI "COS"
    DCI "SIN"
    DCI "TAN"
    DCI "ATN"
    DCI "PEEK"
    DCI "LEN"
    DCI "STR$"
    DCI "VAL"
    DCI "ASC"
    DCI "CHR$"
;NUMBER OF LAST FUNCTION
LASNUM = Q
;THAT TAKES ONE ARG
    DCI "LEFT$"
    DCI "RIGHT$"
    DCI "MID$"
    DCI "GO"
GOTK = Q
;MARKS END OF RESERVED WORD LIST
    .byte 0

.if (LNGERR) = 0
Q .set 0-2
.macro DCE text
Q .set Q+2
    DC text
.endmacro
ERRTAB:
    DCE "NF"
;NEXT WITHOUT FOR.
ERRNF = Q
    DCE "SN"
;SYNTAX
ERRSN = Q
    DCE "RG"
;RETURN WITHOUT GOSUB.
ERRRG = Q
    DCE "OD"
;OUT OF DATA.
ERROD = Q
    DCE "FC"
;ILLEGAL QUANTITY.
ERRFC = Q
    DCE "OV"
;OVERFLOW.
ERROV = Q
    DCE "OM"
;OUT OF MEMORY.
ERROM = Q
    DCE "US"
;UNDEFINED STATEMENT.
ERRUS = Q
    DCE "BS"
;BAD SUBSCRIPT.
ERRBS = Q
    DCE "DD"
;REDIMENSIONED ARRAY.
ERRDD = Q
    DCE "/0"
;DIVISION BY ZERO.
ERRDV0 = Q
    DCE "ID"
;ILLEGAL DIRECT.
ERRID = Q
    DCE "TM"
;TYPE MISMATCH.
ERRTM = Q
    DCE "LS"
;STRING TOO LONG.
ERRLS = Q
.if (EXTIO) <> 0
;FILE DATA.
    DCE "FD"
ERRBD = Q
.endif
    DCE "ST"
;STRING FORMULA TOO COMPLEX.
ERRST = Q
    DCE "CN"
;CAN'T CONTINUE.
ERRCN = Q
    DCE "UF"
;UNDEFINED FUNCTION.
ERRUF = Q
.endif

.if (LNGERR) <> 0
Q .set 0
; NOTE: THIS ERROR COUNT TECHNIQUE WILL NOT WORK IF THERE ARE MORE
; THAN 256 CHARACTERS OF ERROR MESSAGES
ERRTAB:
    DC "NEXT WITHOUT FOR"
ERRNF = Q
Q .set Q+16
    DC "SYNTAX"
ERRSN = Q
Q .set Q+6
    DC "RETURN WITHOUT GOSUB"
ERRRG = Q
Q .set Q+20
    DC "OUT OF DATA"
ERROD = Q
Q .set Q+11
    DC "ILLEGAL QUANTITY"
ERRFC = Q
Q .set Q+16
    DC "OVERFLOW"
ERROV = Q
Q .set Q+8
    DC "OUT OF MEMORY"
ERROM = Q
Q .set Q+13
    DC "UNDEF'D STATEMENT"
ERRUS = Q
Q .set Q+17
    DC "BAD SUBSCRIPT"
ERRBS = Q
Q .set Q+13
    DC "REDIM'D ARRAY"
ERRDD = Q
Q .set Q+13
    DC "DIVISION BY ZERO"
ERRDV0 = Q
Q .set Q+16
    DC "ILLEGAL DIRECT"
ERRID = Q
Q .set Q+14
    DC "TYPE MISMATCH"
ERRTM = Q
Q .set Q+13
    DC "STRING TOO LONG"
ERRLS = Q
Q .set Q+15
.if (EXTIO) <> 0
    DC "FILE DATA"
ERRBD = Q
Q .set Q+9
.endif
    DC "FORMULA TOO COMPLEX"
ERRST = Q
Q .set Q+19
    DC "CAN'T CONTINUE"
ERRCN = Q
Q .set Q+14
    DC "UNDEF'D FUNCTION"
ERRUF = Q
.endif

;
; NEEDED FOR MESSAGES IN ALL VERSIONS.
;
ERR:
    DT " ERROR"
    .byte 0
INTXT:
    DT " IN "
    .byte 0
REDDY:
    ACRLF
.if (REALIO-3) = 0
    DT "READY."
.endif
.if (REALIO-3) <> 0
    DT "OK"
.endif
    ACRLF
    .byte 0
BRKTXT:
    ACRLF
    DT "BREAK"
    .byte 0
; GENERAL STORAGE MANAGEMENT ROUTINES.
;
; FIND A "FOR" ENTRY ON THE STACK VIA "VARPNT".
;
FORSIZ = 2*ADDPRC+16
;LOAD XREG WITH STK PNTR.
FNDFOR:
    tsx
;IGNORE ADR(NEWSTT) AND RTS ADDR.
.repeat 4
    inx
.endrepeat
;GET STACK ENTRY.
FFLOOP:
    lda 257,X
;IS IT A "FOR" TOKEN?
    cmp #.lobyte(FORTK)
;NO, NO "FOR" LOOPS WITH THIS PNTR.
    bne FFRTS
;GET HIGH.
    lda FORPNT+1
    bne CMPFOR
;PNTR IS ZERO, SO ASSUME THIS ONE.
    lda 258,X
    sta FORPNT
    lda 259,X
    sta FORPNT+1
CMPFOR:
    cmp 259,X
;NOT THIS ONE.
    bne ADDFRS
;GET DOWN.
    lda FORPNT
    cmp 258,X
;WE GOT IT! WE GOT IT!
    beq FFRTS
ADDFRS:
    txa
;ADD 16 TO X.
    clc
    adc #.lobyte(FORSIZ)
;RESULT BACK INTO X.
    tax
    bne FFLOOP
;RETURN TO CALLER.
FFRTS:
    rts

;
; THIS IS THE BLOCK TRANSFER ROUTINE.
; IT MAKES SPACE BY SHOVING EVERYTHING FORWARD.
;
; ON ENTRY:
; [Y,A]=[HIGHDS]    (FOR REASON).
; [HIGHDS]= DESTINATION OF [HIGH ADDRESS].
; [LOWTR]= LOWEST ADDR TO BE TRANSFERRED.
; [HIGHTR]= HIGHEST ADDR TO BE TRANSFERRED.
;
; A CHECK IS MADE TO ASCERTAIN THAT A REASONABLE
; AMOUNT OF SPACE REMAINS BETWEEN THE BOTTOM
; OF THE STRINGS AND THE HIGHEST LOCATION TRANSFERRED INTO.
;
; ON EXIT:
; [LOWTR] ARE UNCHANGED.
; [HIGHTR]=[LOWTR]-200 OCTAL.
; [HIGHDS]=LOWEST ADDR TRANSFERRED INTO MINUS 200 OCTAL.
;
;ASCERTAIN THAT STRING SPACE WON'T
BLTU:
    jsr REASON
;BE OVERRUN.
    STWD STREND
;PREPARE TO SUBTRACT.
BLTUC:
    sec
    lda HIGHTR
;COMPUTE NUMBER OF THINGS TO MOVE.
    sbc LOWTR
;SAVE FOR LATER.
    sta INDEX
    tay
    lda HIGHTR+1
    sbc LOWTR+1
;PUT IT IN A COUNTER REGISTER.
    tax
;SO THAT COUNTER ALGORITHM WORKS.
    inx
;SEE IF LOW PART OF COUNT IS ZERO.
    tya
;YES, GO START MOVING BLOCKS.
    beq DECBLT
;NO, MUST MODIFY BASE ADDR.
    lda HIGHTR
    sec
;BORROW IS OFF SINCE [HIGHTR].GT.[LOWTR].
    sbc INDEX
;SAVE MODIFIED BASE ADDR.
    sta HIGHTR
;IF NO BORROW, GO SHOVE IT.
    bcs BLT1
;BORROW IMPLIES SUB 1 FROM HIGH ORDER.
    dec HIGHTR+1
    sec
;MOD BASE OF DEST ADDR.
BLT1:
    lda HIGHDS
    sbc INDEX
    sta HIGHDS
;NO BORROW.
    bcs MOREN1
;DECREMENT HIGH ORDER BYTE.
    dec HIGHDS+1
;ALWAYS SKIP.
    bcc MOREN1
;FETCH BYTE TO MOVE
BLTLP:
    lda (HIGHTR),y
;MOVE IT IN, MOVE IT OUT.
    sta (HIGHDS),y
MOREN1:
    dey
    bne BLTLP
;MOVE LAST OF THE BLOCK.
    lda (HIGHTR),y
    sta (HIGHDS),y
DECBLT:
    dec HIGHTR+1
;START ON NEW BLOCKS.
    dec HIGHDS+1
    dex
    bne MOREN1
;RETURN TO CALLER.
    rts

;
; THIS ROUTINE IS USED TO ASCERTAIN THAT A GIVEN
; NUMBER OF LOCS REMAIN AVAILABLE FOR THE STACK.
;    THE CALL IS:
;	LDAI	NUMBER OF 2-BYTE ENTRIES NEEDED.
;	JSR	GETSTK
;
; THIS ROUTINE MUST BE CALLED BY ANY ROUTINE WHICH PUTS
; AN ARBITRARY AMOUNT OF STUFF ON THE STACK,
; I.E., ANY RECURSIVE ROUTINE LIKE "FRMEVL".
; IT IS ALSO CALLED BY ROUTINES SUCH AS "GOSUB" AND "FOR"
; WHICH MAKE PERMANENT ENTRIES ON THE STACK.
;
; ROUTINES WHICH MERELY USE AND FREE UP THE GUARANTEED
; NUMLEV LOCATIONS NEED NOT CALL THIS.
;
;
; ON EXIT:
;    [A] AND [X] HAVE BEEN MODIFIED.
;
;MULT [A] BY 2. NB, CLEARS C BIT.
GETSTK:
    asl A
;MAKE SURE 2*NUMLEV+13 LOCS
    adc #.lobyte(2*NUMLEV+(3*ADDPRC)+13)
;(13 BECAUSE OF FBUFFR)
;WILL REMAIN IN STACK.
    bcs OMERR
    sta INDEX
;GET STACKED.
    tsx
;COMPARE.
    cpx INDEX
;IF STACK.LE.INDEX1, OM.
    bcc OMERR
    rts

;
; [Y,A] IS A CERTAIN ADDRESS. "REASON" MAKES SURE
; IT IS LESS THAN [FRETOP].
;
REASON:
    cpy FRETOP+1
    bcc REARTS
;GO GARB COLLECT.
    bne TRYMOR
    cmp FRETOP
    bcc REARTS
TRYMOR:
    pha
;IF TEMPF2 HAS ZERO IN BETWEEN.
    ldx #.lobyte(8+ADDPRC)
    tya
REASAV:
    pha
;SAVE HIGHDS ON STACK.
    lda HIGHDS-1,X
    dex
;PUT 8 OF THEM ON STK.
    bpl REASAV
;GO GARB COLLECT.
    jsr GARBA2
    ldx #.lobyte(256-8-ADDPRC)
REASTO:
    pla
;RESTORE AFTER GARB COLLECT.
    sta HIGHDS+8+ADDPRC,X
    inx
    bmi REASTO
    pla
    tay
;RESTORE A AND Y.
    pla
;COMPARE HIGHS
    cpy FRETOP+1
    bcc REARTS
;HIGHER IS BAD.
    bne OMERR
;AND THE LOWS.
    cmp FRETOP
    bcs OMERR
REARTS:
    rts

; ERROR HANDLER, READY, TERMINAL INPUT, COMPACTIFY, NEW, REINIT.
OMERR:
    ldx #.lobyte(ERROM)
ERROR:
.if (REALIO) <> 0
;FORCE OUTPUT.
    lsr CNTWFL
.endif
.if (EXTIO) <> 0
;CLOSE NON-TERMINAL CHANNEL.
    lda CHANNL
    beq ERRCRD
;CLOSE IT.
    jsr CQCCHN
    lda #.lobyte(0)
    sta CHANNL
.endif
;OUTPUT CRLF.
ERRCRD:
    jsr CRDO
;PRINT A QUESTION MARK
    jsr OUTQST
.if (LNGERR) = 0
;GET FIRST CHR OF ERR MSG.
    lda ERRTAB,X
;OUTPUT IT.
    jsr OUTDO
;GET SECOND CHR.
    lda ERRTAB+1,X
;OUTPUT IT.
    jsr OUTDO
.endif
.if (LNGERR) <> 0
GETERR:
    lda ERRTAB,X
    pha
;GET RID OF HIGH BIT.
    and #.lobyte(127)
;OUTPUT IT.
    jsr OUTDO
    inx
;LAST CHAR OF MESSAGE?
    pla
;NO. GO GET NEXT AND OUTPUT IT.
    bpl GETERR
.endif
;RESET THE STACK AND FLAGS.
TYPERR:
    jsr STKINI
;GET PNTR TO " ERROR".
    LDWDI ERR
;OUTPUT IT.
ERRFIN:
    jsr STROUT
    ldy CURLIN+1
;WAS NUMBER 64000?
    iny
;YES, DON'T TYPE LINE NUMBER.
    beq READY
    jsr INPRT
READY:
.if (REALIO) <> 0
;TURN OUTPUT BACK ON IF SUPRESSED
    lsr CNTWFL
.endif
;SAY "OK".
    LDWDI REDDY
.if (REALIO-3) <> 0
;OR GO TO INIT IF INIT ERROR.
    jsr RDYJSR
.endif
.if (REALIO-3) = 0
;NO INIT ERRORS POSSIBLE.
    jsr STROUT
.endif
;GET A LINE FROM TERMINAL.
MAIN:
    jsr INLIN
    STXY TXTPTR
    jsr CHRGET
;SET ZERO FLAG BASED ON [A]
    tax
;THIS DISTINGUISHES ":" AND 0
;IF BLANK LINE, GET ANOTHER.
    beq MAIN
;SET DIRECT LINE NUMBER.
    ldx #.lobyte(255)
    stx CURLIN+1
;IS A LINE NUMBER. NOT DIRECT.
    bcc MAIN1
;COMPACTIFY.
    jsr CRUNCH
;EXECUTE IT.
    jmp GONE
;READ LINE NUMBER INTO "LINNUM".
MAIN1:
    jsr LINGET
    jsr CRUNCH
;RETAIN CHARACTER COUNT.
    sty COUNT
    jsr FNDLIN
;NO MATCH, SO DON'T DELETE.
    bcc NODEL
    ldy #.lobyte(1)
    lda (LOWTR),y
    sta INDEX1+1
    lda VARTAB
    sta INDEX1
;SET TRANSFER TO.
    lda LOWTR+1
    sta INDEX2+1
    lda LOWTR
    dey
;COMPUTE NEGATIVE LENGTH.
    sbc (LOWTR),y
    clc
;COMPUTE NEW VARTAB.
    adc VARTAB
    sta VARTAB
;SET LOW OF TRANS TO.
    sta INDEX2
    lda VARTAB+1
    adc #.lobyte(255)
;COMPUTE HIGH OF VARTAB.
    sta VARTAB+1
;COMPUTE NUMBER OF BLOCKS TO MOVE.
    sbc LOWTR+1
    tax
    sec
    lda LOWTR
;COMPUTE OFFSET.
    sbc VARTAB
    tay
;IF VARTAB.LE.LOWTR,
    bcs QDECT1
;DECR DUE TO CARRY, AND
    inx
;DECREMENT STORE SO CARRY WORKS.
    dec INDEX2+1
QDECT1:
    clc
    adc INDEX1
    bcc MLOOP
    dec INDEX1+1
;FOR LATER ADCQ
    clc
MLOOP:
    lda (INDEX1),y
    sta (INDEX2),y
    iny
;BLOCK DONE?
    bne MLOOP
    inc INDEX1+1
    inc INDEX2+1
    dex
;DO ANOTHER BLOCK. ALWAYS.
    bne MLOOP
;RESET ALL VARIABLE INFO SO GARBAGE
NODEL:
    jsr RUNC
;COLLECTION CAUSED BY REASON WILL WORK
;FIX UP THE LINKS
    jsr LNKPRG
;SEE IF ANYTHNG THERE
    lda BUF
    beq MAIN
    clc
    lda VARTAB
;SETUP HIGHTR.
    sta HIGHTR
;ADD LENGTH OF LINE TO INSERT.
    adc COUNT
;THIS GIVES DEST ADDR.
    sta HIGHDS
    ldy VARTAB+1
;SAME FOR HIGH ORDERS.
    sty HIGHTR+1
    bcc NODELC
    iny
NODELC:
    sty HIGHDS+1
    jsr BLTU
.if (BUFPAG) <> 0
;POSITION THE BINARY LINE NUMBER
    LDWD LINNUM
;IN FRONT OF BUF
    STWD BUF-2
.endif
    LDWD STREND
    STWD VARTAB
    ldy COUNT
    dey
STOLOP:
    lda BUF-4,Y
    sta (LOWTR),y
    dey
    bpl STOLOP
;DO CLEAR & SET UP STACK.
FINI:
    jsr RUNC
;AND SET [TXTPTR] TO [TXTTAB]-1.
;FIX UP PROGRAM LINKS
    jsr LNKPRG
    jmp MAIN
;SET [INDEX] TO [TXTTAB].
LNKPRG:
    LDWD TXTTAB
    STWD INDEX
    clc
;
; CHEAD GOES THROUGH PROGRAM STORAGE AND FIXES
; UP ALL THE LINKS. THE END OF EACH LINE IS FOUND
; BY SEARCHING FOR THE ZERO AT THE END.
; THE DOUBLE ZERO LINK IS USED TO DETECT THE END OF THE PROGRAM.
;
CHEAD:
    ldy #.lobyte(1)
;ARRIVED AT DOUBLE ZEROES?
    lda (INDEX),y
    beq LNKRTS
    ldy #.lobyte(4)
;THERE IS AT LEAST ONE BYTE.
CZLOOP:
    iny
    lda (INDEX),y
;NO, CONTINUE SEARCHING.
    bne CZLOOP
;GO ONE BEYOND.
    iny
    tya
    adc INDEX
    tax
    ldy #.lobyte(0)
    sta (INDEX),y
    lda INDEX+1
    adc #.lobyte(0)
    iny
    sta (INDEX),y
    stx INDEX
    sta INDEX+1
;ALWAYS BRANCHES.
    BCCA CHEAD
LNKRTS:
    rts
;
; THIS IS THE LINE INPUT ROUTINE.
; IT READS CHARACTERS INTO BUF USING BACKARROW (UNDERSCORE, OR
; SHIFT O) AS THE DELETE CHARACTER AND @ AS THE 
; LINE DELETE CHARACTER. IF MORE THAN BUFLEN CHARACTERS
; ARE TYPED, NO ECHOING IS DONE UNTIL A BACKARROW OR @ OR CR
; IS TYPED. CONTROL-G WILL BE TYPED FOR EACH EXTRA CHARACTER.
; THE ROUTINE IS ENTERED AT INLIN.
;
.if (REALIO-4) = 0
;NO PROMPT CHARACTER
INLIN:
    ldx #.lobyte(128)
    stx CQPRMP
;GET A LINE ONTO PAGE 2
    jsr CQINLN
    cpx #.lobyte(BUFLEN-1)
;NOT TOO MANY CHARACTERS
    bcs GDBUFS
    ldx #.lobyte(BUFLEN-1)
;PUT A ZERO AT THE END
GDBUFS:
    lda #.lobyte(0)
    sta BUF,X
    txa
    beq NOCHR
LOPBHT:
    lda BUF-1,X
    and #.lobyte(127)
    sta BUF-1,X
    dex
    bne LOPBHT
NOCHR:
    lda #.lobyte(0)
;POINT AT THE BEGINNING
    LDXYI (BUF-1)
    rts
.endif
.if (REALIO <> 4) && (REALIO <> 6)
.if (REALIO-3) <> 0
LINLIN:
.if (REALIO-2) = 0
;ECHO IT.
    jsr OUTDO
.endif
;BACKARROW SO BACKUP PNTR AND
    dex
;GET ANOTHER IF COUNT IS POSITIVE.
    bpl INLINC
INLINN:
.if (REALIO-2) = 0
;PRINT THE @ OR A SECOND BACKARROW
    jsr OUTDO
.endif
;IF THERE WERE TOO MANY.
    jsr CRDO
.endif
INLIN:
    ldx #.lobyte(0)
;GET A CHARACTER.
INLINC:
    jsr INCHR
.if (REALIO-3) <> 0
;IS IT BOB ALBRECHT RINGING THE BELL
    cmp #.lobyte(7)
;FOR SCHOOL KIDS?
    beq GOODCH
.endif
;CARRIAGE RETURN?
    cmp #.lobyte(13)
;YES, FINISH UP.
    beq FININ1
.if (REALIO-3) <> 0
;CHECK FOR FUNNY CHARACTERS.
    cmp #.lobyte(32)
    bcc INLINC
;IS IT TILDA OR DELETE?
    cmp #.lobyte(125)
;BIG BAD ONES TOO.
    bcs INLINC
;LINE DELETE?
    cmp #.lobyte(64)
;YES.
    beq INLINN
;CHARACTER DELETE?
    cmp #.lobyte(95)
;YES.
    beq LINLIN
.endif
GOODCH:
.if (REALIO-3) <> 0
;LEAVE ROOM FOR NULL.
    cpx #.lobyte(BUFLEN-1)
;COMMO ASSURES US NEVER MORE THAN BUFLEN.
    bcs OUTBEL
.endif
    sta BUF,X
    inx
.if (REALIO-2) = 0
    SKIP2
.endif
.if (REALIO-2) <> 0
    bne INLINC
.endif
.if (REALIO-3) <> 0
OUTBEL:
    lda #.lobyte(7)
.if (REALIO) <> 0
;ECHO IT.
    jsr OUTDO
.endif
;CYCLE ALWAYS.
    bne INLINC
.endif
;GO TO FININL FAR, FAR AWAY.
FININ1:
    jmp FININL
.endif
INCHR:
.if REALIO = 6
    jsr WOPR_GETC
.endif
.if (REALIO-3) = 0
;FOR COMMODORE.
    jsr CQINCH
.endif
.if (REALIO-2) = 0
INCHRL:
    lda 64512
.repeat 4
    nop
.endrepeat
    lsr A
    bcc INCHRL
;GET THE CHARACTER.
    lda 64513
.repeat 4
    nop
.endrepeat
    and #.lobyte(127)
.endif
.if (REALIO-1) = 0
;1E5A FOR MOS TECH.
    jsr 7770
.endif
.if (REALIO-4) = 0
;FD0C FOR APPLE COMPUTER.
    jsr CQINCH
    and #.lobyte(127)
.endif
.if (REALIO) = 0
;GET A CHARACTER FROM SIMULATOR
    .error "PDP-10 simulator instruction is not supported"
.endif

.if (REALIO) <> 0
.if (EXTIO) <> 0
;CNT-O HAS NO EFFECT IF NOT FROM TERM.
    ldy CHANNL
    bne INCRTS
.endif
;SUPPRESS OUTPUT CHARACTER (^W).
    cmp #.lobyte(CONTW)
;NO, RETURN.
    bne INCRTS
    pha
;COMPLEMENT ITS STATE.
    COM CNTWFL
    pla
.endif
;END OF INCHR.
INCRTS:
    rts

;
; ALL "RESERVED" WORDS ARE TRANSLATED INTO SINGLE
; BYTES WITH THE MSB ON. THIS SAVES SPACE AND TIME 
; BY ALLOWING FOR TABLE DISPATCH DURING EXECUTION.
; THEREFORE ALL STATEMENTS APPEAR TOGETHER IN THE
; RESERVED WORD LIST IN THE SAME ORDER THEY
; APPEAR IN STMDSP.
;
;THE AMOUNT TO OFFSET THE LOW BYTE
BUFOFS .set 0
;OF THE TEXT POINTER TO GET TO BUF
;AFTER TXTPTR HAS BEEN SETUP TO POINT INTO BUF
.if (BUFPAG) <> 0
BUFOFS .set (BUF/256)*256
.endif
;SET SOURCE POINTER.
CRUNCH:
    ldx TXTPTR
;SET DESTINATION OFFSET.
    ldy #.lobyte(4)
;ALLOW CRUNCHING.
    sty DORES
KLOOP:
    lda BUFOFS,X
.if (REALIO-3) = 0
;GO LOOK AT SPACES.
    bpl CMPSPC
;PI??
    cmp #.lobyte(PI)
;GO SAVE IT.
    beq STUFFH
;SKIP NO PRINTING.
    inx
;ALWAYS GOES.
    bne KLOOP
.endif
;IS IT A SPACE TO SAVE?
CMPSPC:
    cmp #.lobyte(32)
;YES, GO SAVE IT.
    beq STUFFH
;IF IT'S A QUOTE, THIS WILL
    sta ENDCHR
;STOP LOOP WHEN OTHER QUOTE APPEARS.
;QUOTE SIGN?
    cmp #.lobyte(34)
;YES, DO SPECIAL STRING HANDLING.
    beq STRNG
;TEST FLAG.
    bit DORES
;NO CRUNCH, JUST STORE.
    bvs STUFFH
;A QMARK?
    cmp #.lobyte(63)
    bne KLOOP1
;YES, STUFF A "PRINT" TOKEN.
    lda #.lobyte(PRINTK)
;ALWAYS GO TO STUFFH.
    bne STUFFH
;SKIP NUMERICS.
KLOOP1:
    cmp #.lobyte(48)
    bcc MUSTCR
;":" AND ";" ARE ENTERED STRAIGHTAWAY.
    cmp #.lobyte(60)
    bcc STUFFH
;SAVE BUFFER POINTER.
MUSTCR:
    sty BUFPTR
;LOAD RESLST POINTER.
    ldy #.lobyte(0)
;ALSO CLEAR COUNT.
    sty COUNT
    dey
;SAVE TEXT POINTER FOR LATER USE.
    stx TXTPTR
    dex
RESER:
    iny
RESPUL:
    inx
RESCON:
    lda BUFOFS,X
;PREPARE TO SUBSTARCT.
    sec
;CHARACTERS EQUAL?
    sbc RESLST,Y
;YES, CONTINUE SEARCH.
    beq RESER
;NO BUT MAYBE THE END IS HERE.
    cmp #.lobyte(128)
;NO, TRULY UNEQUAL.
    bne NTHIS
    ora COUNT
;GET BUFFER PNTR.
GETBPT:
    ldy BUFPTR
STUFFH:
    inx
    iny
    sta BUF-5,Y
    lda BUF-5,Y
;NULL IMPLIES END OF LINE.
    beq CRDONE
;PREPARE TO SUBSTARCT.
    sec
;IS IT A ":"?
    sbc #.lobyte(58)
;YES, ALLOW CRUNCHING AGAIN.
    beq COLIS
;IS IT A DATATK?
    cmp #.lobyte(DATATK-58)
;NO, SEE IF IT IS REM TOKEN.
    bne NODATT
;SETUP FLAG.
COLIS:
    sta DORES
;PREP TO SBCQ
NODATT:
    sec
;REM ONLY STOPS ON NULL.
    sbc #.lobyte(REMTK-58)
;NO, CONTINUE CRUNCHING.
    bne KLOOP
;REM STOPS ONLY ON NULL, NOT : OR ".
    sta ENDCHR
STR1:
    lda BUFOFS,X
;YES, END OF LINE, SO DONE.
    beq STUFFH
;END OF GOBBLE?
    cmp ENDCHR
;YES, DONE WITH STRING.
    beq STUFFH
;INCREMENT BUFFER POINTER.
STRNG:
    iny
    sta BUF-5,Y
    inx
;PROCESS NEXT CHARACTER.
    bne STR1
;RESTORE TEXT POINTER.
NTHIS:
    ldx TXTPTR
;INCREMENT RES WORD COUNT.
    inc COUNT
NTHIS1:
    iny
;GET RES CHARACTER.
    lda RESLST-1,Y
;END OF ENTRY?
    bpl NTHIS1
;YES. IS IT THE END?
    lda RESLST,Y
;NO, TRY THE NEXT WORD.
    bne RESCON
;YES, END OF TABLE. GET 1ST CHR.
    lda BUFOFS,X
;STORE IT AWAY (ALWAYS BRANCHES).
    bpl GETBPT
;SO THAT IF THIS IS A DIR STATEMENT
CRDONE:
    sta BUF-3,Y
;ITS END WILL LOOK LIKE END OF PROGRAM.
.if (((BUF+BUFLEN)/256)-((BUF-1)/256)) <> 0
    dec TXTPTR+1
.endif
;MAKE TXTPTR POINT TO
    lda #.lobyte((BUF&255)-1)
;CRUNCHED LINE.
    sta TXTPTR
;RETURN TO CALLER.
LISTRT:
    rts
;
; FNDLIN SEARCHES THE PROGRAM TEXT FOR THE LINE
; WHOSE NUMBER IS PASSED IN "LINNUM".
; THERE ARE TWO POSSIBLE RETURNS:
;
;	1) CARRY SET.
;	   LOWTR POINTS TO THE LINK FIELD IN THE LINE
;	   WHICH IS THE ONE SEARCHED FOR.
;
;	2) CARRY NOT SET.
;	   LINE NOT FOUND. [LOWTR] POINTS TO THE LINE IN THE
;	   PROGRAM GREATER THAN THE ONE SOUGHT AFTER.
;
;LOAD [X,A] WITH [TXTTAB]
FNDLIN:
    LDWX TXTTAB
FNDLNC:
    ldy #.lobyte(1)
;STORE [X,A] INTO LOWTR
    STWX LOWTR
;SEE IF LINK IS 0
    lda (LOWTR),y
    beq FLINRT
    iny
    iny
;COMP HIGH ORDERS OF LINE NUMBERS.
    lda LINNUM+1
    cmp (LOWTR),y
;NO SUCH LINE NUMBER.
    bcc FLNRTS
    beq FNDLO1
    dey
;ALWAYS BRANCH.
    bne AFFRTS
FNDLO1:
    lda LINNUM
    dey
;COMPARE LOW ORDERS.
    cmp (LOWTR),y
;NO SUCH NUMBER.
    bcc FLNRTS
;GO TIT.
    beq FLNRTS
AFFRTS:
    dey
;FETCH LINK.
    lda (LOWTR),y
    tax
    dey
    lda (LOWTR),y
;ALWAYS BRANCHES.
    bcs FNDLNC
;C MAY BE HIGH.
FLINRT:
    clc
;RETURN TO CALLER.
FLNRTS:
    rts
;
; THE "NEW" COMMAND CLEARS THE PROGRAM TEXT AS WELL
; AS VARIABLE SPACE.
;
;MAKE SURE THERE IS A TERMINATOR.
SCRATH:
    bne FLNRTS
;GET A CLEARER.
SCRTCH:
    lda #.lobyte(0)
;SET UP INDEX.
    tay
;CLEAR	FIRST LINK.
    sta (TXTTAB),y
    iny
    sta (TXTTAB),y
    lda TXTTAB
    clc
    adc #.lobyte(2)
;SETUP [VARTAB].
    sta VARTAB
    lda TXTTAB+1
    adc #.lobyte(0)
    sta VARTAB+1
RUNC:
    jsr STXTPT
;SET ZERO FLAG
    lda #.lobyte(0)
;
; THIS CODE IS FOR THE CLEAR COMMAND.
;
;SYNTAX ERROR IF NO TERMINATOR.
CLEAR:
    bne STKRTS
;
; CLEAR INITIALIZES THE VARIABLE AND
; ARRAY SPACE BY RESETING ARYTAB (THE END OF SIMPLE VARIABLE SPACE)
; AND STREND (THE END OF ARRAY STORAGE). IT FALLS INTO "STKINI"
; WHICH RESETS THE STACK. 
;
;FREE UP STRING SPACE.
CLEARC:
    LDWD MEMSIZ
    STWD FRETOP
.if (EXTIO) <> 0
;CLOSE ALL OPEN FILES.
    jsr CQCALL
.endif
;LIBERATE THE
    LDWD VARTAB
;VARIABLES AND
    STWD ARYTAB
;ARRAYS.
    STWD STREND
;RESTORE DATA.
FLOAD:
    jsr RESTOR
;
; STKINI RESETS THE STACK POINTER ELIMINATING
; GOSUB AND FOR CONTEXT. STRING TEMPORARIES ARE FREED
; UP, SUBFLG IS RESET. CONTINUING IS PROHIBITED.
; AND A DUMMY ENTRY IS LEFT AT THE BOTTOM OF THE STACK SO "FNDFOR" WILL ALWAYS
; FIND A NON-"FOR" ENTRY AT THE BOTTOM OF THE STACK.
;
;INITIALIZE STRING TEMPORARIES.
STKINI:
    ldx #.lobyte(TEMPST)
    stx TEMPPT
;SETUP RETURN ADDRESS.
    pla
    tay
    pla
    ldx #.lobyte(STKEND-257)
    txs
    pha
    tya
    pha
    lda #.lobyte(0)
;DISALLOWING CONTINUING
    sta OLDTXT+1
;ALLOW SUBSCRIPTS.
    sta SUBFLG
STKRTS:
    rts

STXTPT:
    clc
    lda TXTTAB
    adc #.lobyte(255)
    sta TXTPTR
    lda TXTTAB+1
    adc #.lobyte(255)
;SETUP TEXT POINTER.
    sta TXTPTR+1
    rts
; THE "LIST" COMMAND.

;IT IS A DIGIT.
LIST:
    bcc GOLST
;IT IS A TERMINATOR.
    beq GOLST
;DASH PRECEDING?
    cmp #.lobyte(MINUTK)
;NO, SO SYNTAX ERROR.
    bne STKRTS
;GET LINE NUMBER INTO NUMLIN.
GOLST:
    jsr LINGET
;FIND LINE .GE. [NUMLIN].
    jsr FNDLIN
;GET LAST CHARACTER.
    jsr CHRGOT
;IF END OF LINE, # IS THE END.
    beq LSTEND
;DASH?
    cmp #.lobyte(MINUTK)
;IF NOT, SYNTAX ERROR.
    bne FLNRTS
;GET NEXT CHAR.
    jsr CHRGET
;GET END #.
    jsr LINGET
;IF NOT TERMINATOR, ERROR.
    bne FLNRTS
LSTEND:
    pla
;GET RID OF "NEWSTT" RTS ADDR.
    pla
;SEE IF IT WAS EXISTENT.
    lda LINNUM
    ora LINNUM+1
;IT WAS TYPED.
    bne LIST4
    lda #.lobyte(255)
    sta LINNUM
;MAKE IT HUGE.
    sta LINNUM+1
LIST4:
    ldy #.lobyte(1)
.if (REALIO-3) = 0
    sty DORES
.endif
;IS LINK ZERO?
    lda (LOWTR),y
;YES, GO TO READY.
    beq GRODY
.if (REALIO) <> 0
;LISTEN FOR CONT-C.
    jsr ISCNTC
.endif
;PRINT CRLF TO START WITH.
    jsr CRDO
    iny
    lda (LOWTR),y
    tax
    iny
;GET LINE NUMBER.
    lda (LOWTR),y
;SEE IF BEYOND LAST.
    cmp LINNUM+1
;GO DETERMINE RELATION.
    bne TSTDUN
;WAS EQUAL SO TEST LOW ORDER.
    cpx LINNUM
;EQUAL, SO LIST IT.
    beq TYPLIN
;IF LINE IS GR THAN LAST, THEN DUNE.
TSTDUN:
    bcs GRODY
TYPLIN:
    sty LSTPNT
;PRINT AS INT WITHOUT LEADING SPACE.
    jsr LINPRT
;ALWAYS PRINT SPACE AFTER NUMBER.
    lda #.lobyte(32)
;GET POINTER TO LINE BACK.
PRIT4:
    ldy LSTPNT
    and #.lobyte(127)
;PRINT CHAR.
PLOOP:
    jsr OUTDO
.if (REALIO-3) = 0
    cmp #.lobyte(34)
    bne PLOOP1
;IF QUOTE, COMPLEMENT FLAG.
    COM DORES
.endif
PLOOP1:
    iny
;IF WE HAVE PRINTED 256 CHARACTERS
    beq GRODY
;THE PROGRAM MUST BE MISFORMATED IN
;MEMORY DUE TO A BAD LOAD OR BAD
;HARDWARE. LET THE GUY RECOVER
;GET NEXT CHAR. IS IT ZERO?
    lda (LOWTR),y
;YES. END OF LINE.
    bne QPLOP
    tay
    lda (LOWTR),y
    tax
    iny
    lda (LOWTR),y
    stx LOWTR
    sta LOWTR+1
;BRANCH IF SOMETHING TO LIST.
    bne LIST4
GRODY:
    jmp READY
;IS IT A TOKEN?
;NO, HEAD FOR PRINTER.
QPLOP:
    bpl PLOOP
.if (REALIO-3) = 0
    cmp #.lobyte(PI)
    beq PLOOP
;INSIDE QUOTE MARKS?
    bit DORES
;YES, JUST TYPE THE CHARACTER.
    bmi PLOOP
.endif
    sec
;GET RID OF SIGN BIT AND ADD 1.
    sbc #.lobyte(127)
;MAKE IT A COUNTER.
    tax
;SAVE POINTER TO LINE.
    sty LSTPNT
;LOOK AT RES'D WORD LIST.
    ldy #.lobyte(255)
;IS THIS THE RES'D WORD?
RESRCH:
    dex
;YES, GO TOSS IT UP..
    beq PRIT3
RESCR1:
    iny
;END OF ENTRY?
    lda RESLST,Y
;NO, CONTINUE PASSING.
    bpl RESCR1
    bmi RESRCH
PRIT3:
    iny
    lda RESLST,Y
;END OF RESERVED WORD.
    bmi PRIT4
;PRINT IT.
    jsr OUTDO
;END OF ENTRY? NO, TYPE REST.
    bne PRIT3
; THE "FOR" STATEMENT.
;
; A "FOR" ENTRY ON THE STACK HAS THE FOLLOWING FORMAT:
;
; LOW ADDRESS
;	TOKEN (FORTK) 1 BYTE
;	A POINTER TO THE LOOP VARIABLE 2 BYTES
;	THE STEP 4+ADDPRC BYTES
;	A BYTE REFLECTING THE SIGN OF THE INCREMENT 1 BYTE
;	THE UPPER VALUE 4+ADDPRC BYTES
;	THE LINE NUMBER OF THE "FOR" STATEMENT 2 BYTES
;	A TEXT POINTER INTO THE "FOR" STATEMENT 2 BYTES
; HIGH ADDRESS
;
; TOTAL 16+2*ADDPRC BYTES.
;

;DON'T RECOGNIZE
FOR:
    lda #.lobyte(128)
;SUBSCRIPTED VARIABLES.
    sta SUBFLG
;READ THE VARIABLE AND ASSIGN IT
    jsr LET
;THE CORRECT INITIAL VALUE AND STORE
;A POINTER TO THE VARIABLE IN VARPNT.
;PNTR IS IN VARPNT, AND FORPNT.
    jsr FNDFOR
;IF NO MATCH, DON'T ELIMINATE ANYTHING.
    bne NOTOL
;MAKE IT ARITHMETICAL.
    txa
;ELIMINATE ALMOST ALL.
    adc #.lobyte(FORSIZ-3)
;NOTE C=1, THEN PLA, PLA.
    tax
;MANIFEST.
    txs
;GET RID OF NEWSTT RETURN ADDRESS
NOTOL:
    pla
;IN CASE THIS IS A TOTALLY NEW ENTRY.
    pla
    lda #.lobyte(8+ADDPRC)
;MAKE SURE 16 BYTES ARE AVAILABLE.
    jsr GETSTK
;GET A COUNT IN [Y] OF THE NUMBER OF
    jsr DATAN
;CHACRACTERS LEFT IN THE "FOR" STATEMENT
;[TXTPTR] IS UNAFFECTED.
;PREP TO ADD.
    clc
;SAVE IT FOR PUSHING.
    tya
    adc TXTPTR
    pha
    lda TXTPTR+1
    adc #.lobyte(0)
    pha
;PUT LINE NUMBER ON STACK.
    PSHWD CURLIN
;"TO" IS NECESSARY.
    SYNCHK TOTK
;VALUE MUST BE A NUMBER.
    jsr CHKNUM
;GET UPPER VALUE INTO FAC.
    jsr FRMNUM
;PACK FAC.
    lda FACSGN
    ora #.lobyte(127)
    and FACHO
;SET PACKED SIGN BIT.
    sta FACHO
    LDWDI LDFONE
    STWD INDEX1
;PUT FAC ONTO STACK, PACKED.
    jmp FORPSH
;PUT 1.0 INTO FAC.
LDFONE:
    LDWDI FONE
    jsr MOVFM
    jsr CHRGOT
;A STEP IS GIVEN?
    cmp #.lobyte(STEPTK)
;NO. ASSUME 1.0.
    bne ONEON
;YES. ADVANCE POINTER.
    jsr CHRGET
;READ THE STEP.
    jsr FRMNUM
;GET SIGN IN ACCA.
ONEON:
    jsr SIGN
;PUSH FAC ONTO STACK (THRU A).
    jsr PUSHF
;PUT PNTR TO VARIABLE ON STACK.
    PSHWD FORPNT
;PUT A FORTK ONTO STACK.
NXTCON:
    lda #.lobyte(FORTK)
    pha
;	BNEA	NEWSTT		;SIMULATE BNE TO NEWSTT. JUST FALL IN.
; NEW STATEMENT FETCHER.
;
; BACK HERE FOR NEW STATEMENT. CHARACTER POINTED TO BY TXTPTR
; IS ":" OR END-OF-LINE. THE ADDRESS OF THIS LOC IS LEFT
; ON THE STACK WHEN A STATEMENT IS EXECUTED SO THAT
; IT CAN MERELY DO A RTS WHEN IT IS DONE.
;
NEWSTT:
.if (REALIO) <> 0
;LISTEN FOR CONTROL-C.
    jsr ISCNTC
.endif
;LOOK AT CURRENT CHARACTER.
    LDWD TXTPTR
.if (BUFPAG) <> 0
;SEE IF IT WAS DIRECT BY CHECK FOR BUF'S PAGE NUMBER
    cpy #.lobyte(BUFPAG)
.endif
    beq DIRCON
;SAVE IN CASE OF RESTART BY INPUT.
    STWD OLDTXT
.if (BUFPAG) <> 0
DIRCON:
.endif
    ldy #.lobyte(0)
.if (BUFPAG) = 0
DIRCON:
.endif
    lda (TXTPTR),y
;NOT NULL -- CHECK WHAT IT IS
    bne MORSTS
;LOOK AT LINK.
    ldy #.lobyte(2)
;IS LINK 0?
    lda (TXTPTR),y
;CLEAR CARRY FOR ENDCON AND MATH THAT FOLLOWS
    clc
;YES - RAN OFF THE END.
    JEQ ENDCON
;PUT LINE NUMBER IN CURLIN.
    iny
    lda (TXTPTR),y
    sta CURLIN
    iny
    lda (TXTPTR),y
    sta CURLIN+1
    tya
    adc TXTPTR
    sta TXTPTR
    bcc GONE
    inc TXTPTR+1
;GET THE STATEMENT TYPE.
GONE:
    jsr CHRGET
    jsr GONE3
    jmp NEWSTT
;IF TERMINATOR, TRY AGAIN.
GONE3:
    beq ISCRTS
;NO NEED TO SET UP CARRY SINCE IT WILL
;BE ON IF NON-NUMERIC AND NUMERICS
;WILL CAUSE A SYNTAX ERROR LIKE THEY SHOULD
;" ON ... GOTO AND GOSUB" COME HERE.
GONE2:
    sbc #.lobyte(ENDTK)
    bcc GLET
    cmp #.lobyte(SCRATK-ENDTK+1)
;SOME RES'D WORD BUT NOT
    bcs SNERRX
;A STATEMENT RES'D WORD.
;MULTIPLY BY TWO.
    asl A
;MAKE AN INDEX.
    tay
    lda STMDSP+1,Y
    pha
    lda STMDSP,Y
;PUT DISP ADDR ONTO STACK.
    pha
    jmp CHRGET
;MUST BE A LET
GLET:
    jmp LET
MORSTS:
    cmp #.lobyte(58)
;IF A ":" CONTINUE STATEMENT
    beq GONE
;NEITHER 0 OR ":" SO SYNTAX ERROR
SNERR1:
    jmp SNERR
SNERRX:
    cmp #.lobyte(GOTK-ENDTK)
    bne SNERR1
;READ IN THE CHARACTER AFTER "GO "
    jsr CHRGET
    SYNCHK TOTK
    jmp GOTO
; RESTORE,STOP,END,CONTINUE,NULL,CLEAR.

RESTOR:
    sec
    lda TXTTAB
    sbc #.lobyte(1)
    ldy TXTTAB+1
    bcs RESFIN
    dey
;READ FINISHES COME TO "RESFIN".
RESFIN:
    STWD DATPTR
ISCRTS:
    rts

.if (REALIO-1) = 0
ISCNTC:
    lda #.lobyte(1)
    bit 5952
    bmi ISCRTS
    ldx #.lobyte(8)
    lda #.lobyte(3)
    cmp #.lobyte(3)
.endif
.if (REALIO-2) = 0
ISCNTC:
    lda 64512
.repeat 4
    nop
.endrepeat
    lsr A
    bcc ISCRTS
;EAT CHAR THAT WAS TYPED
    jsr INCHR
;WAS IT A CONTROL-C??
    cmp #.lobyte(3)
.endif

.if (REALIO-4) = 0
;CHECK THE CHARACTER
ISCNTC:
    lda 49152
    cmp #.lobyte(131)
    beq ISCCAP
    rts
ISCCAP:
    jsr INCHR
    cmp #.lobyte(131)
.endif
;MAKE [C] NONZERO AS A FLAG.
STOP:
    bcs STOPC
END:
    clc
;RETURN IF NOT CONT-C OR
STOPC:
    bne CONTRT
;IF NO TERMINATOR FOR STOP OR END.
;[C]=0 SO WILL NOT PRINT "BREAK".
    LDWD TXTPTR
.if (BUFPAG) <> 0
    ldx CURLIN+1
    inx
.endif
    beq DIRIS
    STWD OLDTXT
STPEND:
    LDWD CURLIN
    STWD OLDLIN
;POP OFF NEWSTT ADDR.
DIRIS:
    pla
    pla
ENDCON:
    LDWDI BRKTXT
.if (REALIO) <> 0
    ldx #.lobyte(0)
    stx CNTWFL
.endif
;CARRY CLEAR SO DON'T PRINT "BREAK".
    bcc GORDY
    jmp ERRFIN
;TYPE "READY".
GORDY:
    jmp READY

.if (REALIO) = 0
;GET RID OF NEWSTT RETURN.
DDT:
    pla
    pla
    .error "PDP-10 simulator instruction is not supported"
    .error "PDP-10 simulator instruction is not supported"
.endif
;MAKE SURE THERE IS A TERMINATOR.
CONT:
    bne CONTRT
;CONTINUE ERROR.
    ldx #.lobyte(ERRCN)
;A STORED TXTPTR OF ZERO IS SETUP
    ldy OLDTXT+1
;BY STKINI AND INDICATES THERE IS
;NOTHING TO CONTINUE.
;"STOP", "END", TYPING CRLF TO 
    JEQ ERROR
;"INPUT" AND  ^C SETUP OLDTXT.
    lda OLDTXT
    STWD TXTPTR
    LDWD OLDLIN
    STWD CURLIN
;RETURN TO CALLER.
CONTRT:
    rts

.if (NULCMD) <> 0
NULL:
    jsr GETBYT
;MAKE SURE THERE IS TERMINATOR.
    bne CONTRT
    inx
;IS THE NUMBER REASONABLE?
    cpx #.lobyte(240)
;"FUNCTION CALL" ERROR.
    bcs FCERR1
;BACK -1
    dex
    stx NULCNT
    rts
FCERR1:
    jmp FCERR
.endif
; LOAD AND SAVE SUBROUTINES.

;KIM CASSETTE I/O
.if (REALIO-1) = 0
;SAVE STACK POINTER
SAVE:
    tsx
    stx INPFLG
    lda #.lobyte(STKEND-256-200)
;SETUP DUMMY STACK FOR KIM MONITOR
    sta 242
;MAKE ID BYTE EQUAL TO FF HEX
    lda #.lobyte(254)
;STORE INTO KIM ID
    sta 6137
;START DUMPING FROM TXTTAB
    LDWD TXTTAB
;SETUP SAL,SAH
    STWD 6133
;STOP AT VARTAB
    LDWD VARTAB
;SETUP EAL,EAH
    STWD 6135
    jmp 6144
;RESORE THE REAL STACK POINTER
RETSAV:
    ldx INPFLG
    txs
;SAY IT WAS DONE
    LDWDI TAPMES
    jmp STROUT
GLOAD:
    DT "LOADED"
    .byte 0
TAPMES:
    DT "SAVED"
    ACRLF
    .byte 0
PATSAV:
    .res 20, 0
;START DUMPING IN AT TXTTAB
LOAD:
    LDWD TXTTAB
;SETUP SAL,SAH
    STWD 6133
    lda #.lobyte(255)
    sta 6137
    LDWDI RTLOAD
;SET UP RETURN ADDRESS FOR LOAD
    STWD 1
;GO READ THE DATA IN
    jmp 6259
;RESET THE STACK
RTLOAD:
    ldx #.lobyte(STKEND-256)
    txs
    LDWDI READY
    STWD 1
;TELL HIM IT WORKED
    LDWDI GLOAD
    jsr STROUT
;GET LAST LOCATION
    LDXY 6125
;ITS ONE TOO BIG
    txa
;DECREMENT [X,Y]
    bne DECVRT
    nop
DECVRT:
    nop
;SETUP NEW VARIABLE LOCATION
    STXY VARTAB
;RELINK THE PROGRAM
    jmp FINI
.endif
.if (REALIO-4) = 0
;CALCLUATE PROGRAM SIZE IN POKER
SAVE:
    sec
    lda VARTAB
    sbc TXTTAB
    sta POKER
    lda VARTAB+1
    sbc TXTTAB+1
    sta POKER+1
    jsr VARTIO
;WRITE PROGRAM SIZE [POKER]
    jsr CQCOUT
    jsr PROGIO
;WRITE PROGRAM.
    jmp CQCOUT

LOAD:
    jsr VARTIO
;READ SIZE OF PROGRAM INTO POKER
    jsr CQCSIN
    clc
;CALCULATE VARTAB FROM SIZE AND
    lda TXTTAB
;TXTTAB
    adc POKER
    sta VARTAB
    lda TXTTAB+1
    adc POKER+1
    sta VARTAB+1
    jsr PROGIO
;READ PROGRAM.
    jsr CQCSIN
    LDWDI TPDONE
    jsr STROUT
    jmp FINI

TPDONE:
    DT "LOADED"
    .byte 0

VARTIO:
    LDWDI POKER
    STWD 60
    lda #.lobyte(POKER+2)
    STWD 62
    rts
PROGIO:
    LDWD TXTTAB
    STWD 60
    LDWD VARTAB
    STWD 62
    rts
.endif
; RUN,GOTO,GOSUB,RETURN.
;IF NO LINE # ARGUMENT.
RUN:
    JEQ RUNC
;CLEAN UP -- RESET THE STACK.
    jsr CLEARC
;MUST REPLACE RTS ADDR.
    jmp RUNC2
;
; A GOSUB ENTRY ON THE STACK HAS THE FOLLOWING FORMAT:
;
; LOW ADDRESS:
;	THE GOSUTK ONE BYTE
;	THE LINE NUMBER OF THE GOSUB STATEMENT TWO BYTES
;	A POINTER INTO THE TEXT OF THE GOSUB TWO BYTES
;
; HIGH ADDRESS.
;
; TOTAL FIVE BYTES.
;
GOSUB:
    lda #.lobyte(3)
;MAKE SURE THERE IS ROOM.
    jsr GETSTK
;PUSH ON THE TEXT POINTER.
    PSHWD TXTPTR
;PUSH ON THE CURRENT LINE NUMBER.
    PSHWD CURLIN
    lda #.lobyte(GOSUTK)
;PUSH ON A GOSUB TOKEN.
    pha
;GET CHARACTER AND SET CODES FOR LINGET.
RUNC2:
    jsr CHRGOT
;USE RTS SCHEME TO "NEWSTT".
    jsr GOTO
    jmp NEWSTT

;PICK UP THE LINE NUMBER IN "LINNUM".
GOTO:
    jsr LINGET
;SKIP TO END OF LINE.
    jsr REMN
    lda CURLIN+1
    cmp LINNUM+1
    bcs LUK4IT
    tya
    sec
    adc TXTPTR
    ldx TXTPTR+1
    bcc LUKALL
    inx
;ALWAYS GOES.
    BCSA LUKALL
LUK4IT:
    LDWX TXTTAB
;[X,A] ARE ALL SET UP.
LUKALL:
    jsr FNDLNC
;GOTO LINE IS NONEXISTANT.
QFOUND:
    bcc USERR
    lda LOWTR
    sbc #.lobyte(1)
    sta TXTPTR
    lda LOWTR+1
    sbc #.lobyte(0)
    sta TXTPTR+1
;PROCESS THE STATEMENT.
GORTS:
    rts
;
; "RETURN" RESTORES THE LINE NUMBER AND TEXT PNTR FROM THE STACK
; AND ELIMINATES ALL THE "FOR" ENTRIES IN FRONT OF THE "GOSUB" ENTRY.
;
;NO TERMINATOR=BLOW HIM UP.
RETURN:
    bne GORTS
    lda #.lobyte(255)
;MAKE SURE THE VARIABLE'S PNTR
    sta FORPNT+1
;NEVER GETS MATCHED.
;GO PAST ALL THE "FOR" ENTRIES.
    jsr FNDFOR
    txs
;RETURN WITHOUT GOSUB?
    cmp #.lobyte(GOSUTK)
    beq RETU1
    ldx #.lobyte(ERRRG)
    SKIP2
;NO MATCH SO "US" ERROR.
USERR:
    ldx #.lobyte(ERRUS)
;YES.
    jmp ERROR
SNERR2:
    jmp SNERR
;REMOVE GOSUTK.
RETU1:
    pla
;GET LINE NUMBER "GOSUB" WAS FROM.
    PULWD CURLIN
;GET TEXT PNTR FROM "GOSUB".
    PULWD TXTPTR
;SKIP TO END OF STATEMENT, 
DATA:
    jsr DATAN
;SINCE WHEN "GOSUB" STUCK THE TEXT  PNTR
;ONTO THE STACK, THE LINE NUMBER ARG
;HADN'T BEEN READ YET.
ADDON:
    tya
    clc
    adc TXTPTR
    sta TXTPTR
    bcc REMRTS
    inc TXTPTR+1
;"NEWSTT" RTS ADDR IS STILL THERE.
REMRTS:
    rts

;"DATA" TERMINATES ON ":" AND NULL.
DATAN:
    ldx #.lobyte(58)
    SKIP2
;THE ONLY TERMINATOR IS NULL.
REMN:
    ldx #.lobyte(0)
;PRESERVE IT.
    stx CHARAC
;THIS MAKES CHARAC=0 AFTER SWAP.
    ldy #.lobyte(0)
    sty ENDCHR
EXCHQT:
    lda ENDCHR
    ldx CHARAC
    sta CHARAC
    stx ENDCHR
REMER:
    lda (TXTPTR),y
;NULL ALWAYS TERMINATES.
    beq REMRTS
;IS IT THE OTHER TERMINATOR?
    cmp ENDCHR
;YES, IT'S FINISHED.
    beq REMRTS
;PROGRESS TO NEXT CHARACTER.
    iny
;IS IT A QUOTE?
    cmp #.lobyte(34)
;NO, JUST CONTINUE.
    bne REMER
;YES, TIME TO TRADE.
    BEQA EXCHQT
; "IF ... THEN" CODE.
;EVALUATE A FORMULA.
IF:
    jsr FRMEVL
;GET CURRENT CHARACTER.
    jsr CHRGOT
;IS TERMINATING CHARACTER A GOTOTK?
    cmp #.lobyte(GOTOTK)
;YES.
    beq OKGOTO
;NO, IT MUST BE "THEN".
    SYNCHK THENTK
;0=FALSE. ALL OTHERS TRUE.
OKGOTO:
    lda FACEXP
;TRUE !
    bne DOCOND
;SKIP REST OF STATEMENT.
REM:
    jsr REMN
;WILL ALWAYS BRANCH.
    BEQA ADDON
;TEST CURRENT CHARACTER.
DOCOND:
    jsr CHRGOT
;IF A NUMBER, GOTO IT.
    bcs DOCO
    jmp GOTO
;INTERPRET NEW STATEMENT.
DOCO:
    jmp GONE3
; "ON ... GO TO ..." CODE.
;GET VALUE IN FACLO.
ONGOTO:
    jsr GETBYT
;SAVE FOR LATER.
    pha
;AN "ON ... GOSUB" PERHAPS?
    cmp #.lobyte(GOSUTK)
;YES.
    beq ONGLOP
;MUST BE "GOTOTK".
SNERR3:
    cmp #.lobyte(GOTOTK)
    bne SNERR2
ONGLOP:
    dec FACLO
;SKIP ANOTHER LINE NUMBER.
    bne ONGLP1
;GET DISPATCH CHARACTER.
    pla
    jmp GONE2
;ADVANCE AND SET CODES.
ONGLP1:
    jsr CHRGET
    jsr LINGET
;IS IT A COMMA?
    cmp #.lobyte(44)
    beq ONGLOP
;REMOVE STACK ENTRY (TOKEN).
    pla
;EITHER END-OF-LINE OR SYNTAX ERROR.
ONGRTS:
    rts
; LINGET -- READ A LINE NUMBER INTO LINNUM
;
; "LINGET" READS A LINE NUMBER FROM THE CURRENT TEXT POSITION.
;
; LINE NUMBERS RANGE FROM 0 TO 64000-1.
;
; THE ANSWER IS RETURNED IN "LINNUM".
; "TXTPTR" IS UPDATED TO POINT TO THE TERMINATING CHARCTER
; AND [A] = THE TERMINATING CHARACTER WITH CONDITION
; CODES SET UP TO REFLECT ITS VALUE.
;
LINGET:
    ldx #.lobyte(0)
;INITIALIZE LINE NUMBER TO ZERO.
    stx LINNUM
    stx LINNUM+1
;IT IS NOT A DIGIT.
MORLIN:
    bcs ONGRTS
;-1 SINCE C=0.
    sbc #.lobyte(48-1)
;SAVE CHARACTER.
    sta CHARAC
    lda LINNUM+1
    sta INDEX
;LINE NUMBER WILL BE .LT. 64000?
    cmp #.lobyte(25)
    bcs SNERR3
    lda LINNUM
;MULTIPLY BY 10.
    asl A
    rol INDEX
    asl A
    rol INDEX
    adc LINNUM
    sta LINNUM
    lda INDEX
    adc LINNUM+1
    sta LINNUM+1
    asl LINNUM
    rol LINNUM+1
    lda LINNUM
;ADD IN DIGIT.
    adc CHARAC
    sta LINNUM
    bcc NXTLGC
    inc LINNUM+1
NXTLGC:
    jsr CHRGET
    jmp MORLIN

; "LET" CODE.
;GET PNTR TO VARIABLE INTO "VARPNT".
LET:
    jsr PTRGET
;PRESERVE POINTER.
    STWD FORPNT
;"=" IS NECESSARY.
    SYNCHK EQULTK
.if (INTPRC) <> 0
;SAVE FOR LATER.
    lda INTFLG
    pha
.endif
;RETAIN THE VARIABLE'S VALUE TYPE.
    lda VALTYP
    pha
;GET VALUE OF FORMULA INTO "FAC".
    jsr FRMEVL
    pla
;CARRY SET FOR STRING, OFF FOR
    rol A
;NUMERIC.
;MAKE SURE "VALTYP" MATCHES CARRY.
    jsr CHKVAL
;AND SET ZERO FLAG FOR NUMERIC.
;IF NUMERIC, COPY IT.
    bne COPSTR
COPNUM:
.if (INTPRC) <> 0
;GET NUMBER TYPE.
    pla
;STORE A FLTING NUMBER.
QINTGR:
    bpl COPFLT
;ROUND INTEGER.
    jsr ROUND
;MAKE 2-BYTE NUMBER.
    jsr AYINT
    ldy #.lobyte(0)
;GET HIGH.
    lda FACMO
;STORE IT.
    sta (FORPNT),y
    iny
;GET LOW.
    lda FACLO
    sta (FORPNT),y
    rts
.endif
;PUT NUMBER @FORPNT.
COPFLT:
    jmp MOVVF

COPSTR:
;IF STRING, NO INTFLG.
.if (INTPRC) <> 0
    pla
.endif
INPCOM:
.if (TIME) <> 0
;TI$?
    ldy FORPNT+1
;ONLY TI$ CAN BE THIS ON ASSIG.
    cpy #.lobyte(ZERO/256)
; WAS NOT TI$.
    bne GETSPT
;WE WONT NEEDIT.
    jsr FREFAC
;LENGTH CORRECT?
    cmp #.lobyte(6)
    bne FCERR2
;YES. DO SETUP.
    ldy #.lobyte(0)
;ZERO FAC TO START WITH.
    sty FACEXP
    sty FACSGN
;SAVE POSOTION.
TIMELP:
    sty FBUFPT
;GET A DIGIT.
    jsr TIMNUM
;WHOLE QTY BY 10.
    jsr MUL10
    inc FBUFPT
    ldy FBUFPT
    jsr TIMNUM
    jsr MOVAF
;IF NUM=0 THEN NO MULT.
    tax
;IF =0, GO TIT.
    beq NOML6
;MULT BY TWO.
    inx
    txa
;ADD IN AND MULT BY 2 GIVES *6.
    jsr FINML6
NOML6:
    ldy FBUFPT
    iny
;DONE ALL SIX?
    cpy #.lobyte(6)
    bne TIMELP
;ONE LAST TIME.
    jsr MUL10
;SHIFT IT OVER TO THE RIGHT.
    jsr QINT
    ldx #.lobyte(2)
;DISALLOW INTERRUPTS.
    sei
TIMEST:
    lda FACMOH,X
    sta CQTIMR,X
    dex
;LOOP 3 TIMES.
    bpl TIMEST
;TURN ON INTS AGAIN.
    cli
    rts
;INDEX SET UP BY FREFAC.
TIMNUM:
    lda (INDEX),y
    jsr QNUM
    bcc GOTNUM
;MUST BE NUMERIC STRING.
FCERR2:
    jmp FCERR
;C IS OFF.
GOTNUM:
    sbc #.lobyte(48-1)
;ADD IN DIGIT TO FAC.
    jmp FINLOG
.endif

;GET PNTR TO DESCRIPTOR.
GETSPT:
    ldy #.lobyte(2)
    lda (FACMO),y
;SEE IF IT POINTS INTO STRING SPACE.
    cmp FRETOP+1
;IF [FRETOP],GT.[2&3,FACMO], DON'T COPY.
    bcc DNTCPY
;IT IS LESS.
    bne QVARIA
    dey
    lda (FACMO),y
;COMPARE LOW ORDERS.
    cmp FRETOP
    bcc DNTCPY
QVARIA:
    ldy FACLO
;IF [VARTAB].GT.[FACMO], DON'T COPY.
    cpy VARTAB+1
    bcc DNTCPY
;IT IS LESS.
    bne COPY
    lda FACMO
;COMPARE LOW ORDERS.
    cmp VARTAB
    bcs COPY
DNTCPY:
    LDWD FACMO
    jmp COPYZC
COPY:
    ldy #.lobyte(0)
    lda (FACMO),y
;GET ROOM TO COPY STRING INTO.
    jsr STRINI
;GET POINTER TO OLD DESCRIPTOR, SO 
    LDWD DSCPNT
;MOVINS CAN FIND STRING.
    STWD STRNG1
;COPY IT.
    jsr MOVINS
;GET POINTER TO OLD DESCRIPTOR.
    LDWDI DSCTMP
;REMEMBER POINTER TO DESCRIPTOR.
COPYZC:
    STWD DSCPNT
;FREE UP THE TEMPORARY WITHOUT
    jsr FRETMS
;FREEING UP ANY STRING SPACE.
    ldy #.lobyte(0)
    lda (DSCPNT),y
    sta (FORPNT),y
;POINT TO STRING PNTR.
    iny
    lda (DSCPNT),y
    sta (FORPNT),y
    iny
    lda (DSCPNT),y
    sta (FORPNT),y
    rts
; PRINT CODE.
.if (EXTIO) <> 0
;DOCMD
PRINTN:
    jsr CMD
;RELEASE CHANNEL.
    jmp IODONE
CMD:
    jsr GETBYT
    beq SAVEIT
;COMMA?
    SYNCHK 44
SAVEIT:
    php
;CHECK AND OPEN OUTPUT CHANNL.
    jsr CQOOUT
;CHANNL TO OUTPUT ON.
    stx CHANNL
;GET STATUS BACK.
    plp
    jmp PRINT
.endif
STRDON:
    jsr STRPRT
;REGET LAST CHARACTER.
NEWCHR:
    jsr CHRGOT
;TERMINATOR SO TYPE CRLF.
PRINT:
    beq CRDO
;HERE AFTER SEEING TAB(X) OR , OR ;
PRINTC:
    beq PRTRTS
;IN WHICH CASE A TERMINATOR DOES NOT
;MEAN TYPE A CRLF BUT JUST RTS.
;TAB FUNCTION?
    cmp #.lobyte(TABTK)
;YES.
    beq TABER
;SPACE FUNCTION?
    cmp #.lobyte(SPCTK)
    clc
    beq TABER
;A COMMA?
    cmp #.lobyte(44)
;YES.
    beq COMPRT
;A SEMICOLON?
    cmp #.lobyte(59)
;YES.
    beq NOTABR
;EVALUATE THE FORMULA.
    jsr FRMEVL
;A STRING?
    bit VALTYP
;YES.
    bmi STRDON
    jsr FOUT
;BUILD DESCRIPTOR.
    jsr STRLIT
.if (REALIO-3) <> 0
;GET THE POINTER.
    ldy #.lobyte(0)
    lda (FACMO),y
    clc
;MAKE SURE LEN+POS.LT.WIDTH.
    adc TRMPOS
;GREATER THAN LINE LENGTH?
    cmp LINWID
;REMEMBER SPACE PRINTED AFTER NUMBER.
;GO TYPE.
    bcc LINCHK
;YES, TYPE CRLF FIRST.
    jsr CRDO
.endif
;PRINT THE NUMBER.
LINCHK:
    jsr STRPRT
;PRINT A SPACE
    jsr OUTSPC
;ALWAYS GOES.
    BNEA NEWCHR
.if (REALIO-4) <> 0
.if (BUFPAG) <> 0
FININL:
    lda #.lobyte(0)
    sta BUF,X
    LDXYI BUF-1
.endif
.if (BUFPAG) = 0
;PUT A ZERO AT END OF BUF.
FININL:
    ldy #.lobyte(0)
    sty BUF,X
;SETUP POINTER.
    ldx #.lobyte(BUF-1)
.endif
.if (EXTIO) <> 0
;NO CRDO IF NOT TERMINAL.
    lda CHANNL
    bne PRTRTS
.endif
.endif
CRDO:
.if (EXTIO) = 0
;MAKE TRMPOS LESS THAN LINE LENGTH.
    lda #.lobyte(13)
    sta TRMPOS
.endif
.if (EXTIO) <> 0
.if (REALIO-3) <> 0
    lda CHANNL
    bne GOCR
    sta TRMPOS
.endif
;X AND Y MUST BE PRESERVED.
GOCR:
    lda #.lobyte(13)
.endif
    jsr OUTDO
    lda #.lobyte(10)
    jsr OUTDO
CRFIN:
.if (EXTIO) <> 0
.if (REALIO-3) <> 0
    lda CHANNL
    bne PRTRTS
.endif
.endif
.if (NULCMD) = 0
.if (REALIO-3) <> 0
    lda #.lobyte(0)
    sta TRMPOS
.endif
    eor #.lobyte(255)
.endif
.if (NULCMD) <> 0
;PRESERVE [ACCX]. SOME NEED IT.
    txa
    pha
;GET NUMBER OF NULLS.
    ldx NULCNT
    beq CLRPOS
    lda #.lobyte(0)
PRTNUL:
    jsr OUTDO
;DONE WITH NULLS?
    dex
    bne PRTNUL
CLRPOS:
    stx TRMPOS
    pla
    tax
.endif
PRTRTS:
    rts

COMPRT:
    lda TRMPOS
;CLMWID BEYOND WHICH THERE ARE
NCMPOS = (((LINLEN/CLMWID)-1)*CLMWID)
.if (REALIO-3) <> 0
;NO MORE COMMA FIELDS.
;SO ALL COMMA DOES IS "CRDO".
    cmp NCMWID

    bcc MORCOM
;TYPE CRLF.
    jsr CRDO
;AND QUIT IF BEYOND LAST FIELD.
    jmp NOTABR
.endif
MORCOM:
    sec
;GET [A] MODULUS CLMWID.
MORCO1:
    sbc #.lobyte(CLMWID)
    bcs MORCO1
;FILL PRINT POS OUT TO EVEN CLMWID SO
    eor #.lobyte(255)
    adc #.lobyte(1)
;PRINT [A] SPACES.
    bne ASPAC

;REMEMBER IF SPC OR TAB FUNCTION.
TABER:
    php
;GET VALUE INTO ACCX.
    jsr GTBYTC
    cmp #.lobyte(41)
    bne SNERR4
    plp
;PRINT [X] SPACES.
    bcc XSPAC
    txa
    sbc TRMPOS
;NEGATIVE, DON'T PRINT ANY.
    bcc NOTABR
ASPAC:
    tax
XSPAC:
    inx
;DECREMENT THE COUNT.
XSPAC2:
    dex
    bne XSPAC1
;REGET LAST CHARACTER.
NOTABR:
    jsr CHRGET
;DON'T CALL CRDO.
    jmp PRINTC
XSPAC1:
    jsr OUTSPC
    BNEA XSPAC2
;
; PRINT THE STRING POINTED TO BY [Y,A] WHICH ENDS WITH A ZERO.
; IF THE STRING IS BELOW DSCTMP IT WILL BE COPIED INTO STRING SPACE.
;
;GET A STRING LITERAL.
STROUT:
    jsr STRLIT
;
; PRINT THE STRING WHOSE DESCRIPTOR IS POINTED TO BY FACMO.
;
;RETURN TEMP POINTER.
STRPRT:
    jsr FREFAC
;PUT COUNT INTO COUNTER.
    tax
    ldy #.lobyte(0)
;MOVE ONE AHEAD.
    inx
STRPR2:
    dex
;ALL DONE.
    beq PRTRTS
;PNTR TO ACT STRNG SET BY FREFAC.
    lda (INDEX),y
    jsr OUTDO
    iny
    cmp #.lobyte(13)
    bne STRPR2
;TYPE REST OF CARRIAGE RETURN.
    jsr CRFIN
;AND ON AND ON.
    jmp STRPR2
;
; OUTDO OUTPUTS THE CHARACTER IN ACCA, USING CNTWFL
; (SUPPRESS OR NOT), TRMPOS (PRINT HEAD POSITION),
; TIMING, ETCQ. NO REGISTERS ARE CHANGED.
;
OUTSPC:
.if (REALIO-3) <> 0
    lda #.lobyte(32)
.endif
.if (REALIO-3) = 0
    lda CHANNL
    beq CRTSKP
    lda #.lobyte(32)
    SKIP2
;COMMODORE'S SKIP CHARACTER.
CRTSKP:
    lda #.lobyte(29)
.endif
    SKIP2
OUTQST:
    lda #.lobyte(63)
OUTDO:
.if (REALIO) <> 0
;SHOULDN'T AFFECT CHANNEL I/O!
    bit CNTWFL
    bmi OUTRTS
.endif
.if (REALIO-3) <> 0
    pha
;IS THIS A PRINTING CHAR?
    cmp #.lobyte(32)
;NO, DON'T INCLUDE IT IN TRMPOS.
    bcc TRYOUT
    lda TRMPOS
;LENGTH = TERMINAL WIDTH?
    cmp LINWID
    bne OUTDO1
;YES, TYPE CRLF
    jsr CRDO
OUTDO1:
.if (EXTIO) <> 0
    lda CHANNL
    bne TRYOUT
.endif
;INCREMENT COUNT.
INCTRM:
    inc TRMPOS
;RESTORE THE A REGISTER
TRYOUT:
    pla
.endif

.if (REALIO-1) = 0
;PRESERVE Y.
    sty KIMY
.endif
;TURN ON B7 FOR APPLE.
.if (REALIO-4) = 0
    ora #.lobyte(128)
.endif
.if (REALIO) <> 0
;OUTPUT THE CHARACTER.
OUTLOC:
    jsr OUTCH
.endif
.if (REALIO-1) = 0
;GET Y BACK.
    ldy KIMY
.endif
.if (REALIO-2) = 0
.repeat 4
    nop
.endrepeat
.endif
;GET [A] BACK FROM APPLE.
.if (REALIO-4) = 0
    and #.lobyte(127)
.endif

.if (REALIO) = 0
;CALL SIMULATOR OUTPUT ROUTINE
    .error "PDP-10 simulator instruction is not supported"
.endif
;SET Z=0.
OUTRTS:
    and #.lobyte(255)
GETRTS:
    rts

; INPUT AND READ CODE.
;
; HERE WHEN THE DATA THAT WAS TYPED IN OR IN "DATA" STATEMENTS
; IS IMPROPERLY FORMATTED. FOR "INPUT" WE START AGAIN.
; FOR "READ" WE GIVE A SYNTAX ERROR AT THE DATA LINE.
;
TRMNOK:
    lda INPFLG
;IF INPUT TRY AGAIN.
    beq TRMNO1
.if (GETCMD) <> 0
    bmi GETDTL
;MAKE IT LOOK DIRECT.
    ldy #.lobyte(255)
;ALWAYS GOES.
    BNEA STCURL
GETDTL:
.endif
;GET DATA LINE NUMBER.
    LDWD DATLIN
;MAKE IT CURRENT LINE.
STCURL:
    STWD CURLIN
SNERR4:
    jmp SNERR
TRMNO1:
.if (EXTIO) <> 0
;IF NOT TERMINAL, GIVE BAD DATA.
    lda CHANNL
    beq DOAGIN
    ldx #.lobyte(ERRBD)
    jmp ERROR
.endif
DOAGIN:
    LDWDI TRYAGN
;PRINT "?REDO FROM START".
    jsr STROUT
;POINT AT START
    LDWD OLDTXT
;OF THIS CURRENT LINE.
    STWD TXTPTR
;GO TO "NEWSTT".
    rts
.if (GETCMD) <> 0
;DIRECT IS NOT OK.
GET:
    jsr ERRDIR
.if (EXTIO) <> 0
;SEE IF "GET#".
    cmp #.lobyte(35)
;NO, JUST GET TTY INPUT.
    bne GETTTY
;MOVE UP TO NEXT BYTE.
    jsr CHRGET
;GET CHANNEL INTO X
    jsr GETBYT
;COMMA?
    SYNCHK 44
;GET CHANNEL OPEN FOR INPUT.
    jsr CQOIN
    stx CHANNL
.endif
;POINT TO 0.
GETTTY:
    LDXYI BUF+1
.if (BUFPAG) <> 0
;TO STUFF AND TO POINT.
    lda #.lobyte(0)
    sta BUF+1
.endif
.if (BUFPAG) = 0
;ZERO IT.
    sty BUF+1
.endif
;TURN ON V-BIT.
    lda #.lobyte(64)
;DO THE GET.
    jsr INPCO1
.if (EXTIO) <> 0
    ldx CHANNL
;RELEASE.
    bne IORELE
.endif
    rts
.endif

.if (EXTIO) <> 0
;GET CHANNEL NUMBER.
INPUTN:
    jsr GETBYT
;A COMMA?
    SYNCHK 44
;GO WHERE COMMODORE CHECKS IN OPEN.
    jsr CQOIN
    stx CHANNL
;DO INPUT TO VARIABLES.
    jsr NOTQTI
;RELEASE CHANNEL.
IODONE:
    lda CHANNL
IORELE:
    jsr CQCCHN
;RESET CHANNEL TO TERMINAL.
    ldx #.lobyte(0)
    stx CHANNL
    rts
.endif
INPUT:
.if (REALIO) <> 0
;BE TALKATIVE.
    lsr CNTWFL
.endif
;A QUOTE?
    cmp #.lobyte(34)
;NO MESSAGE.
    bne NOTQTI
;LITERALIZE THE STRING IN TEXT
    jsr STRTXT
;MUST END WITH SEMICOLON.
    SYNCHK 59
;PRINT IT OUT.
    jsr STRPRT
;USE COMMON ROUTINE SINCE DEF DIRECT
NOTQTI:
    jsr ERRDIR
;GET COMMA.
    lda #.lobyte(44)
    sta BUF-1
;IS ALSO ILLEGAL.
;TYPE "?" AND INPUT A LINE OF TEXT.
GETAGN:
    jsr QINLIN
.if (EXTIO) <> 0
    lda CHANNL
    beq BUFFUL
;GET STATUS BYTE.
    lda CQSTAT
    and #.lobyte(2)
;A-OK.
    beq BUFFUL
;BAD. CLOSE CHANNEL.
    jsr IODONE
;SKIP REST OF INPUT.
    jmp DATA
BUFFUL:
.endif
;ANYTHING INPUT?
    lda BUF
;YES, CONTINUE.
    bne INPCON
.if (EXTIO) <> 0
;BLANK LINE MEANS GET ANOTHER.
    lda CHANNL
;IF NOT TERMINAL.
    bne GETAGN
.endif
;MAKE SURE DONT PRINT BREAK
    clc
;NO, STOP.
    jmp STPEND
QINLIN:
.if (EXTIO) <> 0
    lda CHANNL
    bne GINLIN
.endif
    jsr OUTQST
    jsr OUTSPC
GINLIN:
    jmp INLIN
;GET LAST DATA LOCATION.
READ:
    LDXY DATPTR
;LDAI TYA TO MAKE IT NONZERO.
    .byte 169
.if (BUFPAG) = 0
INPCON:
.endif
    tya
.if (BUFPAG) <> 0
    SKIP2
;SET FLAG THAT THIS IS INPUT
INPCON:
    lda #.lobyte(0)
.endif
;STORE THE FLAG.
INPCO1:
    sta INPFLG
;
; IN THE PROCESSING OF DATA AND READ STATEMENTS:
; ONE POINTER POINTS TO THE DATA (IE, THE NUMBERS BEING FETCHED)
; AND ANOTHER POINTS TO THE LIST OF VARIABLES.
;
; THE POINTER INTO THE DATA ALWAYS STARTS POINTING TO A
; TERMINATOR -- A , : OR END-OF-LINE.
;
; AT THIS POINT TXTPTR POINTS TO LIST OF VARIABLES AND
; [Y,X] POINTS TO DATA OR INPUT LINE.
;
    STXY INPPTR
;READ VARIABLE LIST.
INLOOP:
    jsr PTRGET
;SAVE POINTER FOR "LET" STRING STUFFING.
    STWD FORPNT
;RETURNS PNTR TOP VAR IN VARPNT.
;SAVE TEXT PNTR.
    LDWD TXTPTR
    STWD VARTXT
    LDXY INPPTR
    STXY TXTPTR
;GET IT AND SET Z IF TERM.
    jsr CHRGOT
    bne DATBK1
    bit INPFLG
.if (GETCMD) <> 0
    bvc QDATA
;DON'T WANT INCHR. JUST ONE.
    jsr CZGETL
.if (REALIO-4) = 0
    and #.lobyte(127)
.endif
;MAKE IT FIRST CHARACTER.
    sta BUF
;POINT JUST BEFORE IT.
    LDXYI (BUF-1)
.if (BUFPAG) = 0
    BEQA DATBK
.endif
.if (BUFPAG) <> 0
;GO PROCESS.
    BNEA DATBK
.endif
.endif
;SEARCH FOR ANOTHER DATA STATEMENT.
QDATA:
    bmi DATLOP
.if (EXTIO) <> 0
    lda CHANNL
    bne GETNTH
.endif
    jsr OUTQST
;GET ANOTHER LINE.
GETNTH:
    jsr QINLIN
;SET FOR "CHRGET".
DATBK:
    STXY TXTPTR
DATBK1:
    jsr CHRGET
;GET VALUE TYPE.
    bit VALTYP
;INPUT A NUMBER IF NUMERIC.
    bpl NUMINS
.if (GETCMD) <> 0
;GET?
    bit INPFLG
;NO, GO SET QUOTE.
    bvc SETQUT
    inx
    stx TXTPTR
;ZERO TERMINATORS.
    lda #.lobyte(0)
    sta CHARAC
    BEQA RESETC
.endif
;ASSUME QUOTED STRING.
SETQUT:
    sta CHARAC
;TERMINATORS OK?
    cmp #.lobyte(34)
;YES.
    beq NOWGET
;SET TERMINATORS TO ":" AND
    lda #.lobyte(58)
    sta CHARAC
;COMMA.
    lda #.lobyte(44)
RESETC:
    clc
NOWGET:
    sta ENDCHR
    LDWD TXTPTR
;C IS SET PROPERLY ABOVE.
    adc #.lobyte(0)
    bcc NOWGE1
    iny
;MAKE A STRING DESCRIPTOR FOR THE VALUE
NOWGE1:
    jsr STRLT2
;AND COPY IF NECESSARY.
;SET TEXT POINTER.
    jsr ST2TXT
;DO ASSIGNMENT.
    jsr INPCOM
    jmp STRDN2
NUMINS:
    jsr FIN
.if (INTPRC) = 0
    jsr MOVVF
.endif
.if (INTPRC) <> 0
;SET CODES ON FLAG.
    lda INTFLG
;GO DECIDE ON FLOAT.
    jsr QINTGR
.endif
;READ LAST CHARACTER.
STRDN2:
    jsr CHRGOT
;":" OR EOL IS OK.
    beq TRMOK
;A COMMA?
    cmp #.lobyte(44)
    JNE TRMNOK
TRMOK:
    LDWD TXTPTR
;SAVE FOR MORE READS.
    STWD INPPTR
    LDWD VARTXT
;POINT TO VARIABLE LIST.
    STWD TXTPTR
;LOOK AT LAST VARIABLE LIST CHARACTER.
    jsr CHRGOT
;THAT'S THE END OF THE LIST.
    beq VAREND
;NOT END. CHECK FOR COMMA.
    jsr CHKCOM
    jmp INLOOP
;
; SUBROUTINE TO FIND DATA
; THE SEARCH IS MADE BY USING THE EXECUTION CODE FOR DATA TO
; SKIP OVER STATEMENTS. THE START WORD OF EACH STATEMENT
; IS COMPARED WITH "DATATK". EACH NEW LINE NUMBER
; IS STORED IN "DATLIN" SO THAT IF AN ERROR OCCURS
; WHILE READING DATA THE ERROR MESSAGE CAN GIVE THE LINE
; NUMBER OF THE ILL-FORMATTED DATA.
;
;SKIP SOME TEXT.
DATLOP:
    jsr DATAN
    iny
;END OF LINE?
    tax
;SHO AIN'T.
    bne NOWLIN
;YES = "NO DATA" ERROR.
    ldx #.lobyte(ERROD)
    iny
    lda (TXTPTR),y
    beq ERRGO5
    iny
;GET HIGH BYTE OF LINE NUMBER.
    lda (TXTPTR),y
    sta DATLIN
    iny
;GET LOW BYTE.
    lda (TXTPTR),y
    iny
    sta DATLIN+1
;HOW IS IT?
NOWLIN:
    lda (TXTPTR),y
    tax
;ADD [Y] TO [TXTPTR].
    jsr ADDON
;IS IT A "DATA" STATEMENT.
    cpx #.lobyte(DATATK)
;NOT QUITE RIGHT. KEEP LOOKING.
    bne DATLOP
;THIS IS THE ONE !
    jmp DATBK1
;PUT AWAY A NEW DATA PNTR MAYBE.
VAREND:
    LDWD INPPTR
    ldx INPFLG
    bpl VARY0
    jmp RESFIN
VARY0:
    ldy #.lobyte(0)
;LAST DATA CHR COULD HAVE BEEN
    lda (INPPTR),y
;COMMA OR COLON BUT SHOULD BE NULL.
;IT IS NULL.
    beq INPRTS
.if (EXTIO) <> 0
;IF NOT TERMINAL, NO TYPE.
    lda CHANNL
    bne INPRTS
.endif
    LDWDI EXIGNT
;TYPE "?EXTRA IGNORED"
    jmp STROUT
;DO NEXT STATEMENT.
INPRTS:
    rts
EXIGNT:
    DT "?EXTRA IGNORED"
    ACRLF
    .byte 0
TRYAGN:
    DT "?REDO FROM START"
    ACRLF
    .byte 0
; THE NEXT CODE IS THE "NEXT CODE"
;
; A "FOR" ENTRY ON THE STACK HAS THE FOLLOWING FORMAT:
;
; LOW ADDRESS
;	TOKEN (FORTK) 1 BYTE
;	A POINTER TO THE LOOP VARIABLE 2 BYTES
;	THE STEP 4+ADDPRC BYTES
;	A BYTE REFLECTING THE SIGN OF THE INCREMENT 1 BYTE
;	THE UPPER VALUE (PACKED) 4+ADDPRC BYTES
;	THE LINE NUMBER OF THE "FOR" STATEMENT 2 BYTES
;	A TEXT POINTER INTO THE "FOR" STATEMENT 2 BYTES
; HIGH ADDRESS
;
; TOTAL 16+2*ADDPRC BYTES.
;
NEXT:
    bne GETFOR
;WITHOUT ARG CALL "FNDFOR" WITH
    ldy #.lobyte(0)
;[FORPNT]=0.
    BEQA STXFOR
;GET A POINTER TO LOOP VARIABLE
GETFOR:
    jsr PTRGET
;INTO "FORPNT".
STXFOR:
    STWD FORPNT
;FIND THE MATCHING ENTRY IF ANY.
    jsr FNDFOR
    beq HAVFOR
;"NEXT WITHOUT FOR".
    ldx #.lobyte(ERRNF)
ERRGO5:
    beq ERRGO4
;SETUP STACK. CHOP FIRST.
HAVFOR:
    txs
    txa
    clc
;POINT TO INCREMENT
    adc #.lobyte(4)
;SAVE THIS POINTER TO RESTORE TO [A]
    pha
;POINT TO UPPER LIMIT
    adc #.lobyte(5+ADDPRC)
;SAVE AS INDEX
    sta INDEX2
;RESTORE POINTER TO INCREMENT
    pla
;SET HI ADDR OF THING TO MOVE.
    ldy #.lobyte(1)
;GET QUANTITY INTO THE FAC.
    jsr MOVFM
    tsx
;SET SIGN CORRECTLY.
    lda 257+7+ADDPRC,X
    sta FACSGN
    LDWD FORPNT
;ADD INC TO LOOP VARIABLE.
    jsr FADD
;PACK THE FAC INTO MEMORY.
    jsr MOVVF
    ldy #.lobyte(1)
;COMPARE FAC WITH UPPER VALUE.
    jsr FCOMPN
    tsx
    sec
;SUBTRACT SIGN OF INC FROM SIGN OF
    sbc 257+7+ADDPRC,X
;OF (CURRENT VALUE-FINAL VALUE).
;IF SIGN (FINAL-CURRENT)-SIGN STEP=0
    beq LOOPDN
;THEN LOOP IS DONE.
    lda 2*ADDPRC+12+257,X
;STORE LINE NUMBER OF "FOR" STATEMENT.
    sta CURLIN
    lda 257+13+(2*ADDPRC),X
    sta CURLIN+1
    lda 2*ADDPRC+15+257,X
;STORE TEXT PNTR INTO "FOR" STATEMENT.
    sta TXTPTR
    lda 2*ADDPRC+14+257,X
    sta TXTPTR+1
;PROCESS NEXT STATEMENT.
NEWSGO:
    jmp NEWSTT
LOOPDN:
    txa
;ADDS 16 WITH CARRY.
    adc #.lobyte(2*ADDPRC+15)
    tax
;NEW STACK PNTR.
    txs
    jsr CHRGOT
;COMMA AT END?
    cmp #.lobyte(44)
    bne NEWSGO
    jsr CHRGET
;DO NEXT BUT DON'T ALLOW BLANK VARIABLE
    jsr GETFOR
;PNTR. [VARPNT] IS THE STK PNTR WHICH
;NEVER MATCHES ANY POINTER.
;JSR TO PUT ON DUMMY NEWSTT ADDR.

; FORMULA EVALUATION CODE.
;
; THESE ROUTINES CHECK FOR CERTAIN "VALTYP".
; [C] IS NOT PRESERVED.
;
FRMNUM:
    jsr FRMEVL
CHKNUM:
    clc
    SKIP1
;SET CARRY.
CHKSTR:
    sec
;WILL NOT F UP "VALTYP".
CHKVAL:
    bit VALTYP
    bmi DOCSTR
    bcs CHKERR
CHKOK:
    rts
DOCSTR:
    bcs CHKOK
CHKERR:
    ldx #.lobyte(ERRTM)
ERRGO4:
    jmp ERROR
;
; THE FORMULA EVALUATOR STARTS WITH
; [TXTPTR] POINTING TO THE FIRST CHARACTER OF THE FORMULA.
; AT THE END [TXTPTR] POINTS TO THE TERMINATOR.
; THE RESULT IS LEFT IN THE FAC.
; ON RETURN [A] DOES NOT REFLECT THE TERMINATOR.
;
; THE FORMULA EVALUATOR USES THE OPERATOR LIST (OPTAB)
; TO DETERMINE PRECEDENCE AND DISPATCH ADDRESSES FOR 
; EACH OPERATOR.
; A TEMPORARY RESULT ON THE STACK HAS THE FOLLOWING FORMAT.
;	THE ADDRESS OF THE OPERATOR ROUTINE.
;	THE FLOATING POINT TEMPORARY RESULT.
;	THE PRECEDENCE OF THE OPERATOR.
;
FRMEVL:
    ldx TXTPTR
    bne FRMEV1
    dec TXTPTR+1
FRMEV1:
    dec TXTPTR
;INITIAL DUMMY PRECEDENCE IS 0.
    ldx #.lobyte(0)
    SKIP1
;SAVE LOW PRECEDENCE. (MASK.)
LPOPER:
    pha
    txa
;SAVE HIGH PRECEDENCE.
    pha
    lda #.lobyte(1)
;MAKE SURE THERE IS ROOM FOR
    jsr GETSTK
;RECURSIVE CALLS.
;EVALUATE SOMETHING.
    jsr EVAL
;PREPARE TO BUILD MASK MAYBE.
    CLR OPMASK
;REGET LAST CHARACTER.
TSTOP:
    jsr CHRGOT
;PREP TO SUBTRACT.
LOPREL:
    sec
;IS CURRENT CHARACTER A RELATION?
    sbc #.lobyte(GREATK)
;NO. RELATIONS ALL THROUGH.
    bcc ENDREL
;REALLY RELATIONAL?
    cmp #.lobyte(LESSTK-GREATK+1)
;NO -- JUST BIG.
    bcs ENDREL
;RESET CARRY FOR ZERO ONLY.
    cmp #.lobyte(1)
;0 TO 1, 1 TO 2, 2 TO 4.
    rol A
    eor #.lobyte(1)
;BRING IN THE OLD BITS.
    eor OPMASK
;MAKE SURE THE NEW MASK IS BIGGER.
    cmp OPMASK
;SYNTAX ERROR. BECAUSE TWO OF THE SAME.
    bcc SNERR5
;SAVE MASK.
    sta OPMASK
    jsr CHRGET
;GET THE NEXT CANDIDATE.
    jmp LOPREL
;WERE THERE ANY?
ENDREL:
    ldx OPMASK
;YES, HANDLE AS SPECIAL OP.
    bne FINREL
;NOT AN OPERATOR.
    bcs QOP
    adc #.lobyte(GREATK-PLUSTK)
;NOT AN OPERATOR.
    bcc QOP
;[C]=1.
    adc VALTYP
;ONLY IF [A]=0 AND [VALTYP]=-1 (A STR).
    JEQ CAT
;GET BACK ORIGINAL [A].
    adc #.lobyte(255)
    sta INDEX1
;MULTIPLY BY 2.
    asl A
;BY THREE.
    adc INDEX1
;SET UP FOR LATER.
    tay
;GET PREVIOUS PRECEDENCE.
QPREC:
    pla
;IS OLD PRECEDENCE GREATER OR EQUAL?
    cmp OPTAB,Y
;YES, GO OPERATE.
    bcs QCHNUM
;CAN'T BE STRING HERE.
    jsr CHKNUM
;SAVE OLD PRECEDENCE.
DOPREC:
    pha
;SET A RETURN ADDRESS FOR OP.
NEGPRC:
    jsr DOPRE1
;PULL OFF PREVIOUS PRECEDENCE.
    pla
;GET POINTER TO OP.
    ldy OPPTR
;THAT'S A REAL OPERATOR.
    bpl QPREC1
;DONE ?
    tax
;DONE !
    beq QOPGO
    bne PULSTK
;GET VALUE TYPE INTO "C".
FINREL:
    lsr VALTYP
    txa
;PUT VALTYP INTO LOW ORDER BIT OF MASK.
    rol A
;DECREMENT TEXT POINTER.
    ldx TXTPTR
    bne FINRE2
    dec TXTPTR+1
FINRE2:
    dec TXTPTR
;MAKE [YREG] POINT AT OPERATOR ENTRY.
    ldy #.lobyte(PTDORL-OPTAB)
;SAVE THE OPERATION MASK.
    sta OPMASK
;SAVE IT ALL. BR ALWAYS.
    bne QPREC
;NOTE B7(VALTYP)=0 SO CHKNUM CALL IS OK.
;LAST PRECEDENCE IS GREATER?
QPREC1:
    cmp OPTAB,Y
;YES, GO OPERATE.
    bcs PULSTK
;NO SAVE ARGUMENT AND GET OTHER OPERAND.
    bcc DOPREC
DOPRE1:
    lda OPTAB+2,Y
;DISP ADDR GOES ONTO STACK.
    pha
    lda OPTAB+1,Y
    pha
;SAVE FAC ON STACK UNPACKED.
    jsr PUSHF1
;[ACCA] MAY BE MASK FOR REL.
    lda OPMASK
    jmp LPOPER
;GO TO AN ERROR.
SNERR5:
    jmp SNERR
PUSHF1:
    lda FACSGN
;GET HIGH PRECEDENCE.
    ldx OPTAB,Y
;GET POINTER INTO STACK.
PUSHF:
    tay
    pla
    sta INDEX1
    inc INDEX1
    pla
    sta INDEX1+1
    tya
;STORE FAC ON STACK UNPACKED.
;START WITH SIGN SET UP.
    pha
;PUT ROUNDED FAC ON STACK.
FORPSH:
    jsr ROUND
;ENTRY POINT TO SKIP STORING SIGN.
    lda FACLO
    pha
    lda FACMO
    pha
.if (ADDPRC) <> 0
    lda FACMOH
    pha
.endif
    lda FACHO
    pha
    lda FACEXP
    pha
;RETURN.
    jmp (INDEX1)
QOP:
    ldy #.lobyte(255)
;GET HIGH PRECEDENCE OF LAST OP.
    pla
;DONE !
QOPGO:
    beq QOPRTS
;RELATIONAL OPERATOR?
QCHNUM:
    cmp #.lobyte(100)
;YES, DON'T CHECK OPERAND.
    beq UNPSTK
;MUST BE NUMBER.
    jsr CHKNUM
;SAVE OPERATOR'S POINTER FOR NEXT TIME.
UNPSTK:
    sty OPPTR
;GET MASK FOR REL OP IF IT IS ONE.
PULSTK:
    pla
;SETUP [C] FOR DOREL'S "CHKVAL".
    lsr A
;SAVE FOR "DOCMP".
    sta DOMASK
;UNPACK STACK INTO ARG.
    pla
    sta ARGEXP
    pla
    sta ARGHO
.if (ADDPRC) <> 0
    pla
    sta ARGMOH
.endif
    pla
    sta ARGMO
    pla
    sta ARGLO
    pla
    sta ARGSGN
;GET PROBABLE RESULT SIGN.
    eor FACSGN
;ARITHMETIC SIGN. USED BY
    sta ARISGN
;ADD, SUB, MULT, DIV.
;GET IT AND SET CODES.
QOPRTS:
    lda FACEXP
;RETURN.
UNPRTS:
    rts

;ASSUME VALUE WILL BE NUMERIC.
EVAL:
    CLR VALTYP
;GET A CHARACTER.
EVAL0:
    jsr CHRGET
    bcs EVAL2
;IT IS A NUMBER.
EVAL1:
    jmp FIN
;VARIABLE NAME?
EVAL2:
    jsr ISLETC
;YES.
    bcs ISVAR
.if (REALIO-3) = 0
    cmp #.lobyte(PI)
    bne QDOT
    LDWDI PIVAL
;PUT VALUE IN FOR PI.
    jsr MOVFM
    jmp CHRGET
PIVAL:
    .byte 130
    .byte 73
    .byte 15
    .byte 218
    .byte 161
.endif
;LEADING CHARACTER OF CONSTANT?
QDOT:
    cmp #.lobyte(46)
    beq EVAL1
;NEGATION?
    cmp #.lobyte(MINUTK)
;SHO IS.
    beq DOMIN
    cmp #.lobyte(PLUSTK)
    beq EVAL0
;A QUOTE? A STRING?
    cmp #.lobyte(34)
    bne EVAL3
STRTXT:
    LDWD TXTPTR
;TO INC, ADD C=1.
    adc #.lobyte(0)
    bcc STRTX2
    iny
;YES. GO PROCESS IT.
STRTX2:
    jsr STRLIT
    jmp ST2TXT
;CHECK FOR "NOT" OPERATOR.
EVAL3:
    cmp #.lobyte(NOTTK)
    bne EVAL4
;"NOT" HAS PRECEDENCE 90.
    ldy #.lobyte(NOTTAB-OPTAB)
;GO DO ITS EVALUATION.
    bne GONPRC
;INTEGERIZE.
NOTOP:
    jsr AYINT
;GET THE ARGUMENT.
    lda FACLO
    eor #.lobyte(255)
    tay
    lda FACMO
    eor #.lobyte(255)
;FLOAT [Y,A] AS RESULT IN FAC.
    jmp GIVAYF
;AND RETURN.
;USER-DEFINED FUNCTION?
EVAL4:
    cmp #.lobyte(FNTK)
    JEQ FNDOER
;A FUNCTION NAME?
    cmp #.lobyte(ONEFUN)
;FUNCTIONS ARE THE HIGHEST NUMBERED
    bcc PARCHK
;CHARACTERS SO NO NEED TO CHECK
    jmp ISFUN
;AN UPPER-BOUND.
;ONLY POSSIBILITY LEFT IS
PARCHK:
    jsr CHKOPN
;A FORMULA IN PARENTHESIS.
    jsr FRMEVL
;RECURSIVELY EVALUATE THE FORMULA.
;CHECK FOR A RIGHT PARENTHESE
CHKCLS:
    lda #.lobyte(41)
    SKIP2
CHKOPN:
    lda #.lobyte(40)
    SKIP2
CHKCOM:
    lda #.lobyte(44)
;
; "SYNCHK" LOOKS AT THE CURRENT CHARACTER TO MAKE SURE IT
; IS THE SPECIFIC THING LOADED INTO ACCA JUST BEFORE THE CALL TO
; "SYNCHK". IF NOT, IT CALLS THE "SYNTAX ERROR" ROUTINE.
; OTHERWISE IT GOBBLES THE NEXT CHAR AND RETURNS,
;
; [A]=NEW CHAR AND TXTPTR IS ADVANCED BY "CHRGET".
;
SYNCHR:
    ldy #.lobyte(0)
;CHARACTERS EQUAL?
    cmp (TXTPTR),y
    bne SNERR
CHRGO5:
    jmp CHRGET
;"SYNTAX ERROR"
SNERR:
    ldx #.lobyte(ERRSN)
    jmp ERROR
;A PRECEDENCE BELOW "^".
DOMIN:
    ldy #.lobyte(NEGTAB-OPTAB)
;GET RID OF RTS ADDR.
GONPRC:
    pla
    pla
;EVALUTE FOR NEGATION.
    jmp NEGPRC

;GET A PNTR TO VARIABLE.
ISVAR:
    jsr PTRGET
ISVRET:
    STWD FACMO
.if (TIME|EXTIO) <> 0
;CHECK TIME,TIME$,STATUS.
    LDWD VARNAM
.endif
    ldx VALTYP
;THE STRING IS SET UP.
    beq GOOO
    ldx #.lobyte(0)
    stx FACOV
.if (TIME) <> 0
;AN ARRAY?
    bit FACLO
;YES.
    bpl STRRTS
;TI$?
    cmp #.lobyte(84)
    bne STRRTS
    cpy #.lobyte(73+128)
    bne STRRTS
;YES. PUT TIME IN FACMOH-LO.
    jsr GETTIM
;Y=0.
    sty TENEXP
    dey
    sty FBUFPT
;SIX	DIGITS TO PRINT.
    ldy #.lobyte(6)
    sty DECCNT
    ldy #.lobyte(FDCEND-FOUTBL)
;CONVERT TO ASCII.
    jsr FOUTIM
    jmp TIMSTR
.endif
STRRTS:
    rts
GOOO:
.if (INTPRC) <> 0
    ldx INTFLG
    bpl GOOOOO
    ldy #.lobyte(0)
;FETCH HIGH.
    lda (FACMO),y
    tax
    iny
    lda (FACMO),y
;PUT LOW IN Y.
    tay
;GET HIGH IN A.
    txa
;FLOAT AND RETURN.
    jmp GIVAYF
.endif
GOOOOO:
.if (TIME) <> 0
;AN ARRAY?
    bit FACLO
;YES.
    bpl GOMOVF
    cmp #.lobyte(84)
    bne QSTATV
    cpy #.lobyte(73)
    bne GOMOVF
    jsr GETTIM
;FOR FLOATB.
    tya
;SET EXPONNENT.
    ldx #.lobyte(160)
    jmp FLOATB
GETTIM:
    LDWDI (CQTIMR-2)
;TURN OF INT SYS.
    sei
    jsr MOVFM
;BACK ON.
    cli
;ZERO HIGHEST.
    sty FACHO
    rts
.endif
QSTATV:
.if (EXTIO) <> 0
    cmp #.lobyte(83)
    bne GOMOVF
    cpy #.lobyte(84)
    bne GOMOVF
    lda CQSTAT
    jmp FLOAT
GOMOVF:
.endif
.if (TIME|EXTIO) <> 0
    LDWD FACMO
.endif
;MOVE ACTUAL VALUE IN.
    jmp MOVFM
;AND RETURN.

;MULTIPLY BY TWO.
ISFUN:
    asl A
    pha
    tax
;SET UP FOR SYNCHK.
    jsr CHRGET
;IS IT PAST "LASNUM"?
    cpx #.lobyte(2*LASNUM-256+1)
;NO, MUST BE NORMAL FUNCTION.
    bcc OKNORM
;
; MOST FUNCTIONS TAKE A SINGLE ARGUMENT.
; THE RETURN ADDRESS OF THESE FUNCTIONS IS "CHKNUM"
; WHICH ASCERTAINS THAT [VALTYP]=0  (NUMERIC).
; NORMAL FUNCTIONS THAT RETURN STRING RESULTS
; (E.G., CHR$) MUST POP OFF THAT RETURN ADDR AND
; RETURN DIRECTLY TO "FRMEVL".
;
; THE SO-CALLED "FUNNY" FUNCTIONS CAN TAKE MORE THAN ONE ARGUMENT,
; THE FIRST OF WHICH MUST BE STRING AND THE SECOND OF WHICH
; MUST BE A NUMBER BETWEEN 0 AND 255.
; THE CLOSED PARENTHESIS MUST BE CHECKED AND RETURN IS DIRECTLY
; TO "FRMEVL" WITH THE TEXT PNTR POINTING BEYOND THE ")".
; THE POINTER TO THE DESCRIPTOR OF THE STRING ARGUMENT
; IS STORED ON THE STACK UNDERNEATH THE VALUE OF THE
; INTEGER ARGUMENT.
;
;CHECK FOR AN OPEN PARENTHESE
    jsr CHKOPN
;EAT OPEN PAREN AND FIRST ARG.
    jsr FRMEVL
;TWO ARGS SO COMMA MUST DELIMIT.
    jsr CHKCOM
;MAKE SURE FIRST WAS STRING.
    jsr CHKSTR
;GET FUNCTION NUMBER.
    pla
    tax
;SAVE POINTER AT STRING DESCRIPTOR
    PSHWD FACMO
    txa
;RESAVE FUNCTION NUMBER.
    pha
;THIS MUST BE ON STACK SINCE RECURSIVE.
;[X]=VALUE OF FORMULA.
    jsr GETBYT
;GET FUNCTION NUMBER.
    pla
    tay
    txa
    pha
;DISPATCH TO FUNCTION.
    jmp FINGO
;READ A FORMULA SURROUNDED BY PARENS.
OKNORM:
    jsr PARCHK
;GET DISPATCH FUNCTION.
    pla
    tay
;MODIFY DISPATCH ADDRESS.
FINGO:
    lda FUNDSP-2*ONEFUN+256,Y
    sta JMPER+1
    lda FUNDSP-2*ONEFUN+257,Y
    sta JMPER+2
;DISPATCH!
    jsr JMPER
;STRING FUNCTIONS REMOVE THIS RET ADDR.
;CHECK IT FOR NUMERICNESS AND RETURN.
    jmp CHKNUM

;MUST ALWAYS COMPLEMENT..
OROP:
    ldy #.lobyte(255)
    SKIP2
ANDOP:
    ldy #.lobyte(0)
;OPERATOR.
    sty COUNT
;[FACMO&LO]=INT VALUE AND CHECK SIZE.
    jsr AYINT
;USE DEMORGAN'S LAW ON HIGH
    lda FACMO
    eor COUNT
    sta INTEGR
;AND LOW.
    lda FACLO
    eor COUNT
    sta INTEGR+1
    jsr MOVFA
;[FACMO&LO]=INT OF ARG.
    jsr AYINT
    lda FACLO
    eor COUNT
    and INTEGR+1
;FINISH OUT DEMORGAN.
    eor COUNT
;SAVE HIGH.
    tay
    lda FACMO
    eor COUNT
    and INTEGR
    eor COUNT
;FLOAT [A.Y] AND RET TO USER.
    jmp GIVAYF

;
; TIME TO PERFORM A RELATIONAL OPERATOR.
; [DOMASK] CONTAINS THE BITS AS TO WHICH RELATIONAL
; OPERATOR IT WAS. CARRY BIT ON=STRING COMPARE.
;
;CHECK FOR MATCH.
DOREL:
    jsr CHKVAL
;IT IS A STRING.
    bcs STRCMP
;PACK ARG FOR FCOMP.
    lda ARGSGN
    ora #.lobyte(127)
    and ARGHO
    sta ARGHO
    LDWDI ARGEXP
    jsr FCOMP
    tax
    jmp QCOMP
;RESULT WILL BE NUMERIC.
STRCMP:
    CLR VALTYP
;TURN OFF VALTYP WHICH WAS STRING.
    dec OPMASK
;FREE THE FACLO STRING.
    jsr FREFAC
;SAVE FOR LATER.
    sta DSCTMP
    STXY DSCTMP+1
;GET POINTER TO OTHER STRING.
    LDWD ARGMO
;FREES FIRST DESC POINTER.
    jsr FRETMP
    STXY ARGMO
;COPY COUNT INTO X.
    tax
    sec
;WHICH IS GREATER. IF 0, ALL SET UP.
    sbc DSCTMP
;JUST PUT SIGN OF DIFFERENCE AWAY.
    beq STASGN
    lda #.lobyte(1)
;SIGN IS POSITIVE.
    bcc STASGN
;LENGTH OF FAC IS SHORTER.
    ldx DSCTMP
;GET A MINUS 1 FOR NEGATIVES.
    lda #.lobyte(255)
;KEEP FOR LATER.
STASGN:
    sta FACSGN
;SET POINTER TO FIRST STRING. (ARG.)
    ldy #.lobyte(255)
;TO LOOP PROPERLY.
    inx
NXTCMP:
    iny
;ANY CHARACTERS LEFT TO COMPARE?
    dex
;NOT DONE YET.
    bne GETCMP
;USE SIGN OF LENGTH DIFFERENCE
    ldx FACSGN
;SINCE ALL CHARACTERS ARE THE SAME.
;C IS ALWAYS SET THEN.
QCOMP:
    bmi DOCMP
    clc
;ALWAYS BRANCH.
    bcc DOCMP
;GET NEXT CHAR TO COMPARE.
GETCMP:
    lda (ARGMO),y
;SAME?
    cmp (DSCTMP+1),y
;YEP. TRY FURTHER.
    beq NXTCMP
;SET A POSITIVE DIFFERENCE.
    ldx #.lobyte(255)
;PUT STACK BACK TOGETHER.
    bcs DOCMP
;SET A NEGATIVE DIFFERENCE.
    ldx #.lobyte(1)
;-1 TO 1, 0 TO 2, 1 TO 4.
DOCMP:
    inx
    txa
    rol A
    and DOMASK
    beq GOFLOT
;MAP 0 TO 0. ALL OTHERS TO -1.
    lda #.lobyte(255)
;FLOAT THE ONE-BYTE RESULT INTO FAC.
GOFLOT:
    jmp FLOAT

; DIMENSION AND VARIABLE SEARCHING.
;
; THE "DIM" CODE SETS [DIMFLG] AND THEN FALLS INTO THE VARIABLE SEARCH
; ROUTINE, WHICH LOOKS AT DIMFLG AT THREE DIFFERENT POINTS.
;	1) IF AN ENTRY IS FOUND, "DIMFLG" BEING ON INDICATES
;		A "DOUBLY" DIMENSIONED VARIABLE.
;	2) WHEN A NEW ENTRY IS BEING BUILT "DIMFLG" BEING ON
;		INDICTAES THE INDICES SHOULD BE USED FOR THE
;		SIZE OF EACH INDEX. OTHERWISE THE DEFAULT OF TEN
;		IS USED.
;	3) WHEN THE BUILD ENTRY CODE FINISHES, ONLY IF "DIMFLG" IS OFF
;		WILL INDEXING BE DONE.
;
;MUST BE A COMMA
DIM3:
    jsr CHKCOM
;SET [ACCX] NONZERO.
DIM:
    tax
;[ACCA] MUST BE NONZERO TO WORK RIGHT.
DIM1:
    jsr PTRGT1
;GET LAST CHARACTER.
DIMCON:
    jsr CHRGOT
    bne DIM3
    rts
;
; ROUTINE TO READ THE VARIABLE NAME AT THE CURRENT TEXT POSITION
; AND  PUT A POINTER TO ITS VALUE IN VARPNT. [TXTPTR]
; POINTS TO THE TERMINATING CHARCTER.. NOT THAT EVALUATING SUBSCRIPTS
; IN A VARIABLE NAME CAN CAUSE RECURSIVE CALLS TO "PTRGET" SO AT
; THAT POINT ALL VALUES MUST BE STORED ON THE STACK.
;
;MAKE [ACCX]=0.
PTRGET:
    ldx #.lobyte(0)
;RETRIEVE LAST CHARACTER.
    jsr CHRGOT
;STORE FLAG AWAY.
PTRGT1:
    stx DIMFLG
PTRGT2:
    sta VARNAM
;GET CURRENT CHARACTER
    jsr CHRGOT
;MAYBE WITH FUNCTION BIT OFF.
;CHECK FOR LETTER.
    jsr ISLETC
;MUST HAVE A LETTER.
    bcs PTRGT3
INTERR:
    jmp SNERR
;ASSUME NO SECOND CHARACTER.
PTRGT3:
    ldx #.lobyte(0)
;DEFAULT IS NUMERIC.
    stx VALTYP
.if (INTPRC) <> 0
;ASSUME FLOATING.
    stx INTFLG
.endif
;GET FOLLOWING CHARACTER.
    jsr CHRGET
;CARRY RESET BY CHRGET IF NUMERIC.
    bcc ISSEC
;SET CARRY IF NOT ALPHABETIC.
    jsr ISLETC
;ALLOW ALPHABETICS.
    bcc NOSEC
;IT IS A NUMBER -- SAVE IN ACCX.
ISSEC:
    tax
;LOOK AT NEXT CHARACTER.
EATEM:
    jsr CHRGET
;SKIP NUMERICS.
    bcc EATEM
    jsr ISLETC
;SKIP ALPHABETICS.
    bcs EATEM
;IS IT A STRING?
NOSEC:
    cmp #.lobyte(36)
;IF NOT, [VALTYP]=0.
    bne NOTSTR
;SET [VALTYP]=255 (STRING !).
    lda #.lobyte(255)
    sta VALTYP
.if (INTPRC) <> 0
;ALWAYS GOES.
    BNEA TURNON
;INTEGER VARIABLE?
NOTSTR:
    cmp #.lobyte(37)
;NO.
    bne STRNAM
    lda SUBFLG
    bne INTERR
    lda #.lobyte(128)
;SET FLAG.
    sta INTFLG
;TURN ON BOTH HIGH BITS.
    ora VARNAM
    sta VARNAM
.endif
TURNON:
    txa
;TURN ON MSB OF SECOND CHARACTER.
    ora #.lobyte(128)
    tax
;GET CHARACTER AFTER $.
    jsr CHRGET
.if (INTPRC) = 0
NOTSTR:
.endif
;STORE AWAY SECOND CHARACTER.
STRNAM:
    stx VARNAM+1
    sec
;ADD FLAG WHETHER TO ALLOW ARRAYS.
    ora SUBFLG
;(CHECK FOR "(") WON'T MATCH IF SUBFLG SET. 
    sbc #.lobyte(40)
;IT IS!
    JEQ ISARY
;ALLOW SUBSCRIPTS AGAIN.
    CLR SUBFLG
;PLACE TO START SEARCH.
    lda VARTAB
    ldx VARTAB+1
    ldy #.lobyte(0)
STXFND:
    stx LOWTR+1
LOPFND:
    sta LOWTR
;AT END OF TABLE YET?
    cpx ARYTAB+1
    bne LOPFN
    cmp ARYTAB
;YES. WE COULDN'T FIND IT.
    beq NOTFNS
LOPFN:
    lda VARNAM
;COMPARE HIGH ORDERS.
    cmp (LOWTR),y
;NO COMPARISON.
    bne NOTIT
    lda VARNAM+1
    iny
;AND THE LOW PART?
    cmp (LOWTR),y
;THAT'S IT ! THAT'S IT !
    beq FINPTR
    dey
NOTIT:
    clc
    lda LOWTR
;MAKES NO DIF AMONG TYPES.
    adc #.lobyte(6+ADDPRC)
    bcc LOPFND
    inx
;ALWAYS BRANCHES.
    BNEA STXFND

;
; TEST FOR A LETTER.	/ CARRY OFF= NOT A LETTER.
;			  CARRY ON= A LETTER.
;
ISLETC:
    cmp #.lobyte(65)
;IF LESS THAN "A", RET.
    bcc ISLRTS
    sbc #.lobyte(90+1)
    sec
;RESET CARRY IF [A] .GT. "Z".
    sbc #.lobyte(256-90-1)
;RETURN TO CALLER.
ISLRTS:
    rts

;CHECK WHO'S CALLING.
NOTFNS:
    pla
;RESTORE IT.
    pha
;IS EVAL CALLING?
    cmp #.lobyte(ISVRET-1-(ISVRET-1)/256*256)
;NO, CARRY ON.
    bne NOTEVL
.if (REALIO-3) <> 0
    tsx
    lda 258,X
    cmp #.lobyte(((ISVRET-1)/256))
    bne NOTEVL
.endif
;SET UP PNTR TO SIMULATED ZERO.
LDZR:
    LDWDI ZERO
;FOR STRINGS OR NUMERIC.
    rts
;AND FOR INTEGERS TOO.
NOTEVL:
.if (TIME|EXTIO) <> 0
    LDWD VARNAM
.endif
.if (TIME) <> 0
    cmp #.lobyte(84)
    bne QSTAVR
    cpy #.lobyte(73+128)
    beq LDZR
    cpy #.lobyte(73)
    bne QSTAVR
.endif
.if (EXTIO|TIME) <> 0
GOBADV:
    jmp SNERR
.endif
QSTAVR:
.if (EXTIO) <> 0
    cmp #.lobyte(83)
    bne VAROK
    cpy #.lobyte(84)
    beq GOBADV
.endif
VAROK:
    LDWD ARYTAB
;LOWEST THING TO MOVE.
    STWD LOWTR
;GET HIGHEST ADDR TO MOVE.
    LDWD STREND
    STWD HIGHTR
    clc
    adc #.lobyte(6+ADDPRC)
    bcc NOTEVE
    iny
;PLACE TO STUFF IT.
NOTEVE:
    STWD HIGHDS
;MOVE IT ALL.
    jsr BLTU
;NOTE [Y,A] HAS [HIGHDS] FOR REASON.
;AND SET UP
    LDWD HIGHDS
    iny
;NEW START OF ARRAY TABLE.
    STWD ARYTAB
;GET ADDR OF VARIABLE ENTRY.
    ldy #.lobyte(0)
    lda VARNAM
    sta (LOWTR),y
    iny
    lda VARNAM+1
;STORE NAME OF VARIABLE.
    sta (LOWTR),y
    lda #.lobyte(0)
    iny
    sta (LOWTR),y
    iny
    sta (LOWTR),y
    iny
    sta (LOWTR),y
    iny
;FOURTH ZERO FOR DEF FUNC.
    sta (LOWTR),y
.if (ADDPRC) <> 0
    iny
    sta (LOWTR),y
.endif
FINPTR:
    lda LOWTR
    clc
    adc #.lobyte(2)
    ldy LOWTR+1
    bcc FINNOW
    iny
;THIS IS IT.
FINNOW:
    STWD VARPNT
    rts
; MULTIPLE DIMENSION CODE.
FMAPTR:
    lda COUNT
    asl A
;POINT TO ENTRIES. C CLR'D BY ASL.
    adc #.lobyte(5)
    adc LOWTR
    ldy LOWTR+1
    bcc JSRGM
    iny
JSRGM:
    STWD ARYPNT
    rts

;-32768.
N32768:
    .byte 144,128,0,0

;
; INTIDX READS A FORMULA FROM THE CURRENT POSITION AND
; TURNS IT INTO A POSITIVE INTEGER
; LEAVING THE RESULT IN FACMO&LO. NEGATIVE ARGUMENTS
; ARE NOT ALLOWED.
;
INTIDX:
    jsr CHRGET
;GET A NUMBER
    jsr FRMEVL
POSINT:
    jsr CHKNUM
    lda FACSGN
;IF NEGATIVE, BLOW HIM OUT.
    bmi NONONO
AYINT:
    lda FACEXP
;FAC .GT. 32767?
    cmp #.lobyte(144)
    bcc QINTGO
;GET ADDR OF -32768.
    LDWDI N32768
;SEE IF FAC=[[Y,A]].
    jsr FCOMP
;NO, FAC IS TOO BIG.
NONONO:
    bne FCERR
;GO TO QINT AND SHOVE IT.
QINTGO:
    jmp QINT
;
; FORMAT OF ARRAYS IN CORE.
;
; DESCRIPTOR:
;	LOWBYTE = FIRST CHARACTER.
;	HIGHBYTE = SECOND CHARACTER (200 BIT IS STRING FLAG).
; LENGTH OF ARRAY IN CORE IN BYTES (INCLUDES EVERYTHING).
; NUMBER OF DIMENSIONS.
; FOR EACH DIMENSION STARTING WITH THE FIRST A LIST
; (2 BYTES EACH) OF THE MAX INDICE+1
; THE VALUES
;
ISARY:
    lda DIMFLG
.if (INTPRC) <> 0
    ora INTFLG
.endif
;SAVE [DIMFLG] FOR RECURSION.
    pha
    lda VALTYP
;SAVE [VALTYP] FOR RECURSION.
    pha
;SET NUMBER OF DIMENSIONS TO ZERO.
    ldy #.lobyte(0)
;SAVE NUMBER OF DIMS.
INDLOP:
    tya
    pha
;SAVE LOOKS.
    PSHWD VARNAM
;EVALUATE INDICE INTO FACMO&LO.
    jsr INTIDX
;GET BACK ALL... WE'RE HOME.
    PULWD VARNAM
;(# OF DIMS).
    pla
    tay
    tsx
    lda 258,X
;PUSH DIMFLG AND VALTYP FURTHER.
    pha
    lda 257,X
    pha
;PUT INDICE ONTO STACK.
    lda INDICE
;UNDER DIMFLG AND VALTYP.
    sta 258,X
    lda INDICE+1
    sta 257,X
;INCREMENT # OF DIMS.
    iny
;GET TERMINATING CHARACTER.
    jsr CHRGOT
;A COMMA?
    cmp #.lobyte(44)
;YES.
    beq INDLOP
;SAVE COUNT OF DIMS.
    sty COUNT
;MUST BE CLOSED PAREN.
    jsr CHKCLS
    pla
;GET VALTYP AND
    sta VALTYP
    pla
.if (INTPRC) <> 0
    sta INTFLG
    and #.lobyte(127)
.endif
;DIMFLG OFF STACK.
    sta DIMFLG
;PLACE TO START SEARCH.
    ldx ARYTAB
    lda ARYTAB+1
LOPFDA:
    stx LOWTR
    sta LOWTR+1
;END OF ARRAYS?
    cmp STREND+1
    bne LOPFDV
    cpx STREND
;A FINE THING! NO ARRAY!.
    beq NOTFDD
LOPFDV:
    ldy #.lobyte(0)
    lda (LOWTR),y
    iny
;COMPARE HIGH ORDERS.
    cmp VARNAM
;NO WAY IS IT THIS. GET OUT OF HERE.
    bne NMARY1
    lda VARNAM+1
;LOW ORDERS?
    cmp (LOWTR),y
;WELL, HERE IT IS !!
    beq GOTARY
NMARY1:
    iny
;GET LENGTH.
    lda (LOWTR),y
    clc
    adc LOWTR
    tax
    iny
    lda (LOWTR),y
    adc LOWTR+1
;ALWAYS BRANCHES.
    bcc LOPFDA
;GET BAD SUB ERROR NUMBER.
BSERR:
    ldx #.lobyte(ERRBS)
    SKIP2
;TOO BIG. "FUNCTION CALL" ERROR.
FCERR:
    ldx #.lobyte(ERRFC)
ERRGO3:
    jmp ERROR
;PERHAPS A "RE-DIMENSION" ERROR
GOTARY:
    ldx #.lobyte(ERRDD)
;TEST THE DIMFLG
    lda DIMFLG
    bne ERRGO3
    jsr FMAPTR
;GET NUMBER OF DIMS INPUT.
    lda COUNT
    ldy #.lobyte(4)
;# OF DIMS THE SAME?
    cmp (LOWTR),y
;SAME SO GO GET DEFINITION.
    bne BSERR
    jmp GETDEF

;
; HERE WHEN VARIABLE IS NOT FOUND IN THE ARRAY TABLE.
;
; BUILDING AN ENTRY.
;
;	PUT DOWN THE DESCRIPTOR.
;	SETUP NUMBER OF DIMENSIONS.
;	MAKE SURE THERE IS ROOM FOR THE NEW ENTRY.
;	REMEMBER "VARPNT".
;	TALLY=4.
;	SKIP 2 LOCS FOR LATER FILL IN OF SIZE.
; LOOP: GET AN INDICE
;	PUT DOWN NUMBER+1 AND INCREMENT VARPTR.
;	TALLY=TALLY*NUMBER+1.
;	DECREMENT NUMBER-DIMS.
;	BNE LOOP
;	CALL "REASON" WITH [Y,A] REFLECTING LAST LOC OF VARIABLE.
;	UPDATE STREND.
;	ZERO ALL.
;	MAKE TALLY INCLUDE MAXDIMS AND DESCRIPTOR.
;	PUT DOWN TALLY.
;	IF CALLED BY DIMENSION, RETURN.
;	OTHERWISE INDEX INTO THE VARIABLE AS IF IT
;	 WERE FOUND ON THE INITIAL SEARCH.
;
;FORM ARYPNT.
NOTFDD:
    jsr FMAPTR
    jsr REASON
    lda #.lobyte(0)
    tay
    sta CURTOL+1
.if (ADDPRC) = 0
    ldx #.lobyte(4)
.endif
.if (ADDPRC) <> 0
    ldx #.lobyte(5)
.endif
;THIS CODE ONLY WORKS FOR INTPRC=1
    lda VARNAM
;IF ADDPRC=1.
    sta (LOWTR),y
.if (ADDPRC) <> 0
    bpl NOTFLT
    dex
.endif
NOTFLT:
    iny
    lda VARNAM+1
    sta (LOWTR),y
    bpl STOMLT
    dex
.if (ADDPRC) <> 0
    dex
.endif
STOMLT:
    stx CURTOL
    lda COUNT
.repeat 3
    iny
.endrepeat
;SAVE NUMBER OF DIMENSIONS.
    sta (LOWTR),y
;DEFAULT SIZE.
LOPPTA:
    ldx #.lobyte(11)
    lda #.lobyte(0)
    bit DIMFLG
;NOT IN A DIM STATEMENT.
    bvc NOTDIM
;GET LOW ORDER OF INDICE.
    pla
    clc
    adc #.lobyte(1)
    tax
;GET HIGH PART OF INDICE.
    pla
    adc #.lobyte(0)
NOTDIM:
    iny
;STORE HIGH PART OF INDICE.
    sta (LOWTR),y
    iny
    txa
;STORE LOW ORDER OF INDICE.
    sta (LOWTR),y
;[X,A]=[CURTOL]*[LOWTR,Y]
    jsr UMULT
;SAVE NEW TALLY.
    stx CURTOL
    sta CURTOL+1
    ldy INDEX
;ANY MORE INDICES LEFT?
    dec COUNT
;YES.
    bne LOPPTA
    adc ARYPNT+1
;OVERFLOW.
    bcs OMERR1
;COMPUTE WHERE TO ZERO.
    sta ARYPNT+1
    tay
    txa
    adc ARYPNT
    bcc GREASE
    iny
    beq OMERR1
;GET ROOM.
GREASE:
    jsr REASON
;NEW END OF STORAGE.
    STWD STREND
;STORING [ACCA] IS FASTER THAN CLEAR.
    lda #.lobyte(0)
    inc CURTOL+1
    ldy CURTOL
    beq DECCUR
ZERITA:
    dey
    sta (ARYPNT),y
;NO. CONTINUE.
    bne ZERITA
DECCUR:
    dec ARYPNT+1
    dec CURTOL+1
;DO ANOTHER BLOCK.
    bne ZERITA
;BUMP BACK UP. WILL USE LATER.
    inc ARYPNT+1
    sec
;RESTORE [ACCA].
    lda STREND
;DETERMINE LENGTH.
    sbc LOWTR
    ldy #.lobyte(2)
;LOW.
    sta (LOWTR),y
    lda STREND+1
    iny
    sbc LOWTR+1
;HIGH.
    sta (LOWTR),y
    lda DIMFLG
;BYE.
    bne DIMRTS
    iny
;
; AT THIS POINT [LOWTR,Y] POINTS BEYOND THE SIZE TO THE NUMBER OF
; DIMENSIONS. STRATEGY:
;	NUMDIM=NUMBER OF DIMENSIONS.
;	CURTOL=0.
; INLPNM:GET A NEW INDICE.
;	MAKE SURE INDICE IS NOT TOO BIG.
;	MULTIPLY CURTOL BY CURMAX.
;	ADD INDICE TO CURTOL.
;	NUMDIM=NUMDIM-1.
;	BNE	INLPNM.
;	USE [CURTOL]*4 AS OFFSET.
;
GETDEF:
    lda (LOWTR),y
;SAVE A COUNTER.
    sta COUNT
;ZERO [CURTOL].
    lda #.lobyte(0)
    sta CURTOL
INLPNM:
    sta CURTOL+1
    iny
;GET LOW INDICE.
    pla
    tax
    sta INDICE
;AND THE HIGH PART
    pla
    sta INDICE+1
;COMPARE WITH MAX INDICE.
    cmp (LOWTR),y
    bcc INLPN2
;IF GREATER, "BAD SUBSCRIPT" ERROR.
    bne BSERR7
    iny
    txa
    cmp (LOWTR),y
    bcc INLPN1
BSERR7:
    jmp BSERR
OMERR1:
    jmp OMERR
INLPN2:
    iny
;DON'T MULTIPLY IF CURTOL=0.
INLPN1:
    lda CURTOL+1
    ora CURTOL
;PREPARE TO GET INDICE BACK.
    clc
;GET HIGH PART OF INDICE BACK.
    beq ADDIND
;MULTIPLY [CURTOL] BY [LOWTR,Y,Y+1].
    jsr UMULT
    txa
;ADD IN [INDICE].
    adc INDICE
    tax
    tya
    ldy INDEX1
ADDIND:
    adc INDICE+1
    stx CURTOL
;ANY MORE?
    dec COUNT
;YES.
    bne INLPNM
;FIX ARRAY BUG ****
    sta CURTOL+1
.if (ADDPRC) = 0
    ldx #.lobyte(4)
.endif
.if (ADDPRC) <> 0
;THIS CODE ONLY WORKS FOR INTPRC=1
    ldx #.lobyte(5)
;IF ADDPRC=1.
    lda VARNAM
    bpl NOTFL1
    dex
.endif
NOTFL1:
    lda VARNAM+1
    bpl STOML1
    dex
.if (ADDPRC) <> 0
    dex
.endif
STOML1:
    stx ADDEND
    lda #.lobyte(0)
;ON RTS, A&Y=HI . X=LO.
    jsr UMULTD
    txa
    adc ARYPNT
    sta VARPNT
    tya
    adc ARYPNT+1
    sta VARPNT+1
    tay
    lda VARPNT
;RETURN TO CALLER.
DIMRTS:
    rts
; INTEGER ARITHMETIC ROUTINES.
;TWO BYTE UNSIGNED INTEGER MULTIPLY.
;THIS IS FOR MULTIPLY DIMENSIONED ARRAYS.
; [X,Y]=[X,A]=[CURTOL]*[LOWTR,Y,Y+1].
UMULT:
    sty INDEX
    lda (LOWTR),y
;LOW, THEN HIGH.
    sta ADDEND
    dey
;PUT [LOWTR,Y,Y+1] IN FASTER MEMORY.
    lda (LOWTR),y
UMULTD:
    sta ADDEND+1
    lda #.lobyte(16)
    sta DECCNT
;CLR THE ACCS.
    ldx #.lobyte(0)
;RESULT INITIALLY ZERO.
    ldy #.lobyte(0)
UMULTC:
    txa
;MULTIPLY BY TWO.
    asl A
    tax
    tya
    rol A
    tay
;TWO MUCH !
    bcs OMERR1
    asl CURTOL
    rol CURTOL+1
;NOTHING IN THIS POSITION TO MULTIPLY.
    bcc UMLCNT
    clc
    txa
    adc ADDEND
    tax
    tya
    adc ADDEND+1
    tay
;MAN, JUST TOO MUCH !
    bcs OMERR1
;DONE?
UMLCNT:
    dec DECCNT
;KEEP IT UP.
    bne UMULTC
;YES, ALL DONE.
UMLRTS:
    rts
; FRE FUNCTION AND INTEGER TO FLOATING ROUTINES.
FRE:
    lda VALTYP
    beq NOFREF
    jsr FREFAC
NOFREF:
    jsr GARBA2
    sec
;WE WANT
    lda FRETOP
;[FRETOP]-[STREND].
    sbc STREND
    tay
    lda FRETOP+1
    sbc STREND+1

GIVAYF:
    ldx #.lobyte(0)
    stx VALTYP
    STWD FACHO
;SET EXPONENT TO 2^16.
    ldx #.lobyte(144)
;TURN IT TO A FLOATING PNT #.
    jmp FLOATS

;GET POSITION.
POS:
    ldy TRMPOS
SNGFLT:
    lda #.lobyte(0)
;FLOAT IT.
    BEQA GIVAYF
; SIMPLE-USER-DEFINED-FUNCTION CODE.
;
; NOTE ONLY SINGLE ARGUMENTS ARE ALLOWED TO FUNCTIONS
; AND FUNCTIONS MUST BE OF THE SINGLE LINE FORM:
;	DEF FNA(X)=X^2+X-2
; NO STRINGS CAN BE INVOLVED WITH THESE FUNCTIONS.
;
; IDEA: CREATE A SIMPLE VARIABLE ENTRY
; WHOSE FIRST CHARACTER HAS THE 200 BIT SET.
; THE VALUE WILL BE:
;
;	A TEXT PNTR TO THE FORMULA.
;	A PNTR TO THE ARGUMENT VARIABLE.
;
; FUNCTION NAMES CAN BE LIKE "FNA4".
;
;
; SUBROUTINE TO SEE IF WE ARE IN DIRECT MODE.
; AND COMPLAIN IF SO.
;
;DIR MODE HAS [CURLIN]=0,255
ERRDIR:
    ldx CURLIN+1
;SO NOW, IS RESULT ZERO?
    inx
;YES.
    bne DIMRTS
;INPUT DIRECT ERROR CODE.
    ldx #.lobyte(ERRID)
    SKIP2
;USER DEFINED FUNCTION NEVER DEFINED
ERRGUF:
    ldx #.lobyte(ERRUF)
ERRGO1:
    jmp ERROR

;GET A PNTR TO THE FUNCTION.
DEF:
    jsr GETFNM
    jsr ERRDIR
;MUST HAVE "(".
    jsr CHKOPN
    lda #.lobyte(128)
;PROHIBIT SUBSCRIPTED VARIABLES.
    sta SUBFLG
;GET PNTR TO ARGUMENT.
    jsr PTRGET
;IS IT A NUMBER?
    jsr CHKNUM
;MUST HAVE ")"
    jsr CHKCLS
;MUST HAVE "=".
    SYNCHK EQULTK
;PUT CRAZY BYTE ON.
.if (ADDPRC) <> 0
    pha
.endif
    PSHWD VARPNT
    PSHWD TXTPTR
    jsr DATA
    jmp DEFFIN
;
; SUBROUTINE TO GET A PNTR TO A FUNCTION NAME.
;
;MUST START WITH FN.
GETFNM:
    SYNCHK FNTK
;PUT FUNCTION BIT ON.
    ora #.lobyte(128)
    sta SUBFLG
;GET POINTER TO FUNCTION OR CREATE ANEW.
    jsr PTRGT2
    STWD DEFPNT
;MAKE SURE IT'S NOT A STRING AND RETURN.
    jmp CHKNUM

;GET THE FUNCTION'S NAME.
FNDOER:
    jsr GETFNM
    PSHWD DEFPNT
;EVALUATE PARAMETER.
    jsr PARCHK
    jsr CHKNUM
    PULWD DEFPNT
    ldy #.lobyte(2)
;GET POINTER TO VARIABLE.
    lda (DEFPNT),y
;SAVE VARIABLE POINTER.
    sta VARPNT
    tax
    iny
    lda (DEFPNT),y
    beq ERRGUF
    sta VARPNT+1
;SINCE DEF USES ONLY 4.
.if (ADDPRC) <> 0
    iny
.endif
DEFSTF:
    lda (VARPNT),y
;PUSH IT ALL ON STACK.
    pha
;SINCE WE ARE RECURSING MAYBE.
    dey
    bpl DEFSTF
    ldy VARPNT+1
;PUT CURRENT FAC INTO OUR ARG VARIABLE.
    jsr MOVMF
;SAVE TEXT POINTER.
    PSHWD TXTPTR
;PNTR TO FUNCTION.
    lda (DEFPNT),y
    sta TXTPTR
    iny
    lda (DEFPNT),y
    sta TXTPTR+1
;SAVE VARIABLE POINTER.
    PSHWD VARPNT
;EVALUATE FORMULA AND CHECK NUMERIC.
    jsr FRMNUM
    PULWD DEFPNT
    jsr CHRGOT
;IT DIDN'T TERMINATE. HUH?
    JNE SNERR
;RESTORE TEXT PNTR.
    PULWD TXTPTR
DEFFIN:
    ldy #.lobyte(0)
;GET OLD ARG VALUE OFF STACK
    pla
;AND PUT IT BACK IN VARIABLE.
    sta (DEFPNT),y
    pla
    iny
    sta (DEFPNT),y
    pla
    iny
    sta (DEFPNT),y
    pla
    iny
    sta (DEFPNT),y
.if (ADDPRC) <> 0
    pla
    iny
    sta (DEFPNT),y
.endif
DEFRTS:
    rts
; STRING FUNCTIONS.
;
; THE STR$ FUNCTION TAKES A NUMBER AND GIVES A STRING
; WITH THE CHARACTERS THE OUTPUT OF THE NUMBER
; WOULD HAVE GIVEN.
;
;ARG HAS TO BE NUMERIC.
STR:
    jsr CHKNUM
    ldy #.lobyte(0)
;DO ITS OUTPUT.
    jsr FOUTC
    pla
    pla
TIMSTR:
    LDWDI LOFBUF
;SCAN IT AND TURN IT INTO A STRING.
    BEQA STRLIT
;
; "STRINI" GET STRING SPACE FOR THE CREATION OF A STRING AND
; CREATES A DESCRIPTOR FOR IT IN "DSCTMP".
;
;GET FACMO TO STORE IN DSCPNT.
STRINI:
    LDXY FACMO
;RETAIN THE DESCRIPTOR POINTER.
    STXY DSCPNT
;GET STRING SPACE.
STRSPA:
    jsr GETSPA
;SAVE LOCATION.
    STXY DSCTMP+1
;SAVE LENGTH.
    sta DSCTMP
;ALL DONE.
    rts
;
; "STRLT2" TAKES THE STRING LITERAL WHOSE FIRST CHARACTER
; IS POINTED TO BY [Y,A] AND BUILDS A DESCRIPTOR FOR IT.
; THE DESCRIPTOR IS INITIALLY BUILT IN "DSCTMP", BUT "PUTNEW"
; TRANSFERS IT INTO A TEMPORARY AND LEAVES A POINTER
; AT THE TEMPORARY IN FACMO&LO. THE CHARACTERS OTHER THAN
; ZERO THAT TERMINATE THE STRING SHOULD BE SET UP IN "CHARAC"
; AND "ENDCHR". IF THE TERMINATOR IS A QUOTE, THE QUOTE IS SKIPPED
; OVER. LEADING QUOTES SHOULD BE SKIPPED BEFORE JSR. ON RETURN
; THE CHARACTER AFTER THE STRING LITERAL IS POINTED TO
; BY [STRNG2].
;
;ASSUME STRING ENDS ON QUOTE.
STRLIT:
    ldx #.lobyte(34)
    stx CHARAC
    stx ENDCHR
;SAVE POINTER TO STRING.
STRLT2:
    STWD STRNG1
;IN CASE NO STRCPY.
    STWD DSCTMP+1
;INITIALIZE CHARACTER COUNT.
    ldy #.lobyte(255)
STRGET:
    iny
;GET CHARACTER.
    lda (STRNG1),y
;IF ZERO.
    beq STRFI1
;THIS TERMINATOR?
    cmp CHARAC
;YES.
    beq STRFIN
    cmp ENDCHR
;LOOK FURTHER.
    bne STRGET
;QUOTE?
STRFIN:
    cmp #.lobyte(34)
    beq STRFI2
;NO, BACK UP.
STRFI1:
    clc
;RETAIN COUNT.
STRFI2:
    sty DSCTMP
    tya
;WISHING TO SET [TXTPTR].
    adc STRNG1
    sta STRNG2
    ldx STRNG1+1
    bcc STRST2
    inx
STRST2:
    stx STRNG2+1
;IF PAGE 0, COPY SINCE IT IS EITHER
    lda STRNG1+1
;A STRING CONSTANT IN BUF OR A STR$
;RESULT IN LOFBUF
.if (BUFPAG) <> 0
    beq STRCP
    cmp #.lobyte(BUFPAG)
.endif
    bne PUTNEW
STRCP:
    tya
    jsr STRINI
    LDXY STRNG1
;MOVE STRING.
    jsr MOVSTR
;
; SOME STRING FUNCTION IS RETURNING A RESULT IN DSCTMP.
; SETUP A TEMP DESCRIPTOR WITH DSCTMP IN IT.
; PUT A POINTER TO THE DESCRIPTOR IN FACMO&LO AND FLAG THE
; RESULT AS TYPE STRING.
;
;POINTER TO FIRST FREE TEMP.
PUTNEW:
    ldx TEMPPT
    cpx #.lobyte(TEMPST+STRSIZ*NUMTMP)
    bne PUTNW1
;STRING TEMPORARY ERROR.
    ldx #.lobyte(ERRST)
;GO TELL HIM.
ERRGO2:
    jmp ERROR
PUTNW1:
    lda DSCTMP
    sta 0,X
    lda DSCTMP+1
    sta 1,X
    lda DSCTMP+2
    sta 2,X
    ldy #.lobyte(0)
    STXY FACMO
    sty FACOV
    dey
;TYPE IS "STRING".
    sty VALTYP
;SET POINTER TO LAST-USED TEMP.
    stx LASTPT
    inx
    inx
;POINT FURTHER.
    inx
;SAVE POINTER TO NEXT TEMP IF ANY.
    stx TEMPPT
;ALL DONE.
    rts

;
; GETSPA - GET SPACE FOR CHARACTER STRING.
; MAY FORCE GARBAGE COLLECTION.
;
; # OF CHARACTERS (BYTES) IN ACCA.
; RETURNS WITH POINTER IN [Y,X]. OTHERWISE (IF CAN'T GET
; SPACE) BLOWS OFF TO "OUT OF STRING SPACE" TYPE ERROR.
; ALSO PRESERVES [ACCA] AND SETS [FRESPC]=[Y,X]=PNTR AT SPACE.
;
;SIGNAL NO GARBAGE COLLECTION YET.
GETSPA:
    lsr GARBFL
;SAVE FOR LATER.
TRYAG2:
    pha
    eor #.lobyte(255)
;ADD ONE TO COMPLETE NEGATION.
    sec
    adc FRETOP
    ldy FRETOP+1
    bcs TRYAG3
    dey
;COMPARE HIGH ORDERS.
TRYAG3:
    cpy STREND+1
;MAKE ROOM FOR MORE.
    bcc GARBAG
;SAVE NEW FRETOP.
    bne STRFRE
;COMPARE LOW ORDERS.
    cmp STREND
;CLEAN UP.
    bcc GARBAG
;SAVE NEW [FRETOP].
STRFRE:
    STWD FRETOP
;PUT IT THERE OLD MAN.
    STWD FRESPC
;PRESERVE A IN X.
    tax
;GET COUNT BACK IN ACCA.
    pla
;ALL DONE.
    rts
;"OUT OF STRING SPACE"
GARBAG:
    ldx #.lobyte(ERROM)
    lda GARBFL
    bmi ERRGO2
    jsr GARBA2
    lda #.lobyte(128)
    sta GARBFL
;GET BACK STRING LENGTH.
    pla
;ALWAYS BRANCHES.
    bne TRYAG2
;START FROM TOP DOWN.
GARBA2:
.if (REALIO|DISKO) = 0
;TYPE "BELL".
    lda #.lobyte(7)
    jsr OUTDO
.endif
    ldx MEMSIZ
    lda MEMSIZ+1
;LIKE SO.
FNDVAR:
    stx FRETOP
    sta FRETOP+1
    ldy #.lobyte(0)
    sty GRBPNT+1
;BOTH BYTES SET TO ZERO (FIX BUG)
    sty GRBPNT
    LDWX STREND
    STWX GRBTOP
    LDWXI TEMPST
    STWX INDEX1
;DONE WITH TEMPS?
TVAR:
    cmp TEMPPT
;YEP.
    beq SVARS
    jsr DVAR
;LOOP.
    beq TVAR
SVARS:
    lda #.lobyte(6+ADDPRC)
    sta FOUR6
;GET START OF SIMPLE VARIABLES.
    LDWX VARTAB
    STWX INDEX1
;DONE WITH SIMPLE VARIABLES?
SVAR:
    cpx ARYTAB+1
;NO.
    bne SVARGO
    cmp ARYTAB
;YEP.
    beq ARYVAR
;DO IT , AGAIN.
SVARGO:
    jsr DVARS
;LOOP.
    beq SVAR
;SAVE FOR ADDITION.
ARYVAR:
    STWX ARYPNT
    lda #.lobyte(STRSIZ)
    sta FOUR6
;GET THE POINTER TO VARIABLE.
ARYVA2:
    LDWX ARYPNT
;DONE WITH ARRAYS?
ARYVA3:
    cpx STREND+1
;NO.
    bne ARYVGO
    cmp STREND
;YES, GO FINISH UP.
    JEQ GRBPAS
ARYVGO:
    STWX INDEX1
    ldy #.lobyte(1-ADDPRC)
.if (ADDPRC) <> 0
    lda (INDEX1),y
    tax
    iny
.endif
    lda (INDEX1),y
    php
    iny
    lda (INDEX1),y
    adc ARYPNT
;FORM POINTER TO NEXT ARRAY VAR.
    sta ARYPNT
    iny
    lda (INDEX1),y
    adc ARYPNT+1
    sta ARYPNT+1
    plp
    bpl ARYVA2
.if (ADDPRC) <> 0
    txa
    bmi ARYVA2
.endif
    iny
    lda (INDEX1),y
;RESET INDEX Y.
    ldy #.lobyte(0)
    asl A
;CARRY IS OFF AND OFF AFTER ADD.
    adc #.lobyte(5)
    adc INDEX1
    sta INDEX1
    bcc ARYGET
    inc INDEX1+1
ARYGET:
    ldx INDEX1+1
;END OF THE ARRAY?
ARYSTR:
    cpx ARYPNT+1
    bne GOGO
    cmp ARYPNT
;YES.
    beq ARYVA3
GOGO:
    jsr DVAR
;CYCLE.
    beq ARYSTR
DVARS:
.if (INTPRC) <> 0
    lda (INDEX1),y
    bmi DVARTS
.endif
    iny
    lda (INDEX1),y
    bpl DVARTS
    iny
;IS LENGTH=0?
DVAR:
    lda (INDEX1),y
;YES, RETURN.
    beq DVARTS
    iny
;GET LOW(ADR).
    lda (INDEX1),y
    tax
    iny
    lda (INDEX1),y
;COMPARE HIGHS.
    cmp FRETOP+1
;IF THIS STRING'S PNTR .GE. [FRETOP]
    bcc DVAR2
;NO NEED TO MESS WITH IT FURTHER.
    bne DVARTS
;COMPARE LOWS.
    cpx FRETOP
    bcs DVARTS
DVAR2:
    cmp GRBTOP+1
;IF THIS STRING IS BELOW PREVIOUS,
    bcc DVARTS
;FORGET IT.
    bne DVAR3
;COMPARE LOW ORDERS.
    cpx GRBTOP
;[X,A] .LE. [GRBTOP].
    bcc DVARTS
DVAR3:
    stx GRBTOP
    sta GRBTOP+1
    LDWX INDEX1
    STWX GRBPNT
    lda FOUR6
    sta SIZE
DVARTS:
    lda FOUR6
    clc
    adc INDEX1
    sta INDEX1
    bcc GRBRTS
    inc INDEX1+1
GRBRTS:
    ldx INDEX1+1
    ldy #.lobyte(0)
;DONE.
    rts
;
; HERE WHEN MADE ONE COMPLETE PASS THROUGH STRING VARIABLES.
;
;VARIABLE POINTER.
GRBPAS:
    lda GRBPNT+1
    ora GRBPNT
;ALL DONE.
    beq GRBRTS
    lda SIZE
;LEAVES C OFF.
    and #.lobyte(4)
    lsr A
    tay
    sta SIZE
    lda (GRBPNT),y
;NOTE: GRBTOP=LOWTR SO NO NEED TO SET LOWTR.
    adc LOWTR
    sta HIGHTR
    lda LOWTR+1
    adc #.lobyte(0)
    sta HIGHTR+1
    LDWX FRETOP
;WHERE IT ALL GOES.
    STWX HIGHDS
    jsr BLTUC
    ldy SIZE
    iny
;GET POSITION OF START OF RESULT.
    lda HIGHDS
    sta (GRBPNT),y
    tax
    inc HIGHDS+1
    lda HIGHDS+1
    iny
;CHANGE ADDR OF STRING IN VAR.
    sta (GRBPNT),y
;GO TO FNDVAR WITH SOMETHING FOR
    jmp FNDVAR
;[FRETOP].
;
; THE FOLLOWING ROUTINE CONCATENATES TWO STRINGS.
; THE FAC CONTAINS THE FIRST ONE AT THIS POINT.
; [TXTPTR] POINTS TO THE + SIGN.
;
;PSH HIGH ORDER ONTO STACK.
CAT:
    lda FACLO
    pha
;AND THE LOW.
    lda FACMO
    pha
;CAN COME BACK HERE SINCE
    jsr EVAL
;OPERATOR IS KNOWN.
;RESULT MUST BE STRING.
    jsr CHKSTR
    pla
;GET HIGH ORDER OF OLD DESC.
    sta STRNG1
    pla
    sta STRNG1+1
    ldy #.lobyte(0)
;GET LENGTH OF OLD STRING.
    lda (STRNG1),y
    clc
    adc (FACMO),y
;RESULT IS LESS THAN 256.
    bcc SIZEOK
;ERROR "LONG STRING".
    ldx #.lobyte(ERRLS)
    jmp ERROR
;INITIALIZE STRING.
SIZEOK:
    jsr STRINI
;MOVE IT.
    jsr MOVINS
;GET POINTER TO SECOND.
    LDWD DSCPNT
;FREE IT.
    jsr FRETMP
    jsr MOVDO
    LDWD STRNG1
    jsr FRETMP
    jsr PUTNEW
;"CAT" REENTERS FORM EVAL AT TSTOP.
    jmp TSTOP

;GET ADDR OF STRING.
MOVINS:
    ldy #.lobyte(0)
    lda (STRNG1),y
    pha
    iny
    lda (STRNG1),y
    tax
    iny
    lda (STRNG1),y
    tay
    pla
MOVSTR:
    STXY INDEX
MOVDO:
    tay
    beq MVDONE
    pha
MOVLP:
    dey
    lda (INDEX),y
    sta (FRESPC),y
QMOVE:
    tya
    bne MOVLP
    pla
MVDONE:
    clc
    adc FRESPC
    sta FRESPC
    bcc MVSTRT
    inc FRESPC+1
MVSTRT:
    rts
;
; "FRETMP" IS PASSED A STRING DESCRIPTOR PNTR IN [Y,A].
; A CHECK IS MADE TO SEE IF THE STRING DESCRIPTOR POINTS TO THE LAST
; TEMPORARY DESCRIPTOR ALLOCATED BY PUTNEW.
; IF SO, THE TEMPORARY IS FREED UP BY THE UPDATING OF [TEMPPT].
; IF A TEMP IS FREED UP, A FURTHER CHECK SEES IF THE STRING DATA THAT
; THAT STRING TEMP PNT'D TO IS THE LOWEST PART OF STRING SPACE IN USE.
; IF SO, [FRETOP] IS UPDATED TO REFLECT THE FACT THE FACT THAT THE SPACE
; IS NO LONGER IN USE.
; THE ADDR OF THE ACTUAL STRING IS RETURNED IN [Y,X] AND
; ITS LENGTH IN ACCA.
;
;MAKE SURE ITS A STRING.
FRESTR:
    jsr CHKSTR
;FREE UP STR PNT'D TO BY FAC.
FREFAC:
    LDWD FACMO
;GET LENGTH FOR LATER.
FRETMP:
    STWD INDEX
;FREE UP THE TEMPORARY DESC.
    jsr FRETMS
;SAVE CODES.
    php
;PREP TO GET STUFF.
    ldy #.lobyte(0)
;GET COUNT AND
    lda (INDEX),y
;SAVE IT.
    pha
    iny
    lda (INDEX),y
;SAVE LOW ORDER.
    tax
    iny
    lda (INDEX),y
;SAVE HIGH ORDER.
    tay
    pla
;RETURN STATUS.
    plp
    bne FRETRT
;STRING IS LAST ONE IN?
    cpy FRETOP+1
    bne FRETRT
    cpx FRETOP
    bne FRETRT
    pha
    clc
    adc FRETOP
    sta FRETOP
    bcc FREPLA
    inc FRETOP+1
;GET COUNT BACK.
FREPLA:
    pla
;SAVE FOR LATER USE.
FRETRT:
    STXY INDEX
    rts
;LAST ENTRY TO TEMP? 
FRETMS:
    cpy LASTPT+1
    bne FRERTS
    cmp LASTPT
    bne FRERTS
    sta TEMPPT
;POINT TO LAST ONE.
    sbc #.lobyte(STRSIZ)
;UPDATE TEMP PNTR.
    sta LASTPT
;ALSO CLEARS ZFLG SO WE DO REST OF FRETMP.
    ldy #.lobyte(0)
;ALL DONE.
FRERTS:
    rts
;
; CHR$(#) CREATES A STRING WHICH CONTAINS AS ITS ONLY
; CHARACTER THE ASCII EQUIVALENT OF THE INTEGER ARGUMENT (#)
; WHICH MUST BE .LT. 255.
;
;GET INTEGER IN RANGE.
CHR:
    jsr CONINT
    txa
    pha
;ONE-CHARACTER STRING.
    lda #.lobyte(1)
;GET SPACE FOR STRING.
    jsr STRSPA
    pla
    ldy #.lobyte(0)
    sta (DSCTMP+1),y
;GET RID OF "CHKNUM" RETURN ADDR.
    pla
    pla
;SETUP FAC TO POINT TO DESC.
RLZRET:
    jmp PUTNEW
;
; THE FOLLOWING IS THE LEFT$($,#) FUNCTION.
; IT TAKES THE LEFTMOST # CHARACTERS OF THE STRING.
; IF # .GT. THE LEN OF THE STRING, IT RETURNS THE WHOLE STRING.
;
;TEST PARAMETERS.
LEFT:
    jsr PREAM
    cmp (DSCPNT),y
    tya
RLEFT:
    bcc RLEFT1
    lda (DSCPNT),y
;PUT LENGTH INTO X.
    tax
;ZERO A, THE OFFSET.
    tya
;SAVE OFFSET.
RLEFT1:
    pha
RLEFT2:
    txa
;SAVE LENGTH.
RLEFT3:
    pha
;GET SPACE.
    jsr STRSPA
    LDWD DSCPNT
    jsr FRETMP
    pla
    tay
    pla
    clc
;COMPUTE WHERE TO COPY.
    adc INDEX
    sta INDEX
    bcc PULMOR
    inc INDEX+1
PULMOR:
    tya
;GO MOVE IT.
    jsr MOVDO
    jmp PUTNEW
RIGHT:
    jsr PREAM
;[LENGTH DES'D]-[LENGTH]-1.
    clc
    sbc (DSCPNT),y
;NEGATE.
    eor #.lobyte(255)
    jmp RLEFT
;
; MID ($,#) RETURNS STRING WITH CHARS FROM # POSITION
; ONWARD. IF # .GT. LEN ($) THEN RETURN NULL STRING.
; MID ($,#,#) RETURNS STRING WITH CHARACTERS FROM
; # POSITION FOR #2 CHARACTERS. IF #2 GOES PAST END OF STRING
; RETURN AS MUCH AS POSSIBLE.
;
;DEFAULT.
MID:
    lda #.lobyte(255)
;SAVE FOR LATER COMPARE.
    sta FACLO
;GET CURRENT CHARACTER.
    jsr CHRGOT
;IS IT A RIGHT PAREN )?
    cmp #.lobyte(41)
;NO THIRD PARAM.
    beq MID2
;MUST HAVE COMMA.
    jsr CHKCOM
;GET THE LENGTH INTO "FACLO".
    jsr GETBYT
;CHECK IT OUT.
MID2:
    jsr PREAM
;THERE IS NO POSTION 0
    beq GOFUC
;COMPUTE OFFSET.
    dex
    txa
;PRSERVE AWHILE.
    pha
    clc
    ldx #.lobyte(0)
;GET LENGTH OF WHAT'S LEFT.
    sbc (DSCPNT),y
;GIVE NULL STRING.
    bcs RLEFT2
;IN SUB C WAS 0 SO JUST COMPLEMENT.
    eor #.lobyte(255)
;GREATER THAN WHAT'S DESIRED?
    cmp FACLO
;NO, COPY THAT MUCH.
    bcc RLEFT3
;GET LENGTH OF WHAT'S DESIRED.
    lda FACLO
;COPY IT.
    bcs RLEFT3

;
; USED BY RIGHT$, LEFT$, MID$ FOR PARAMETER CHECKING AND SETUP.
;
;PARAM LIST SHOULD END.
PREAM:
    jsr CHKCLS
;GET THE RETURN ADDRESS INTO
    pla
;[JMPER+1,Y]
    tay
    pla
    sta JMPER+1
;GET RID OF FINGO'S JSR RET ADDR.
    pla
    pla
;GET LENGTH.
    pla
    tax
    PULWD DSCPNT
;PUT RETURN ADDRESS BACK ON
    lda JMPER+1
    pha
    tya
    pha
    ldy #.lobyte(0)
    txa
    rts
;
; THE FUNCTION LEN($) RETURNS THE LENGTH OF THE STRING
; PASSED AS AN ARGUMENT.
;
LEN:
    jsr LEN1
    jmp SNGFLT
;FREE UP STRING.
LEN1:
    jsr FRESTR
    ldx #.lobyte(0)
;FORCE NUMERIC.
    stx VALTYP
;SET CODES ON LENGTH.
    tay
;DONE.
    rts
;
; THE FOLLOWING IS THE ASC($) FUNCTION. IT RETURNS
; AN INTEGER WHICH IS THE DECIMAL ASCII EQUIVALENT.
;
ASC:
    jsr LEN1
;NULL STRING, BAD ARG.
    beq GOFUC
    ldy #.lobyte(0)
;GET CHARACTER.
    lda (INDEX1),y
    tay
    jmp SNGFLT
;YES.
GOFUC:
    jmp FCERR

GTBYTC:
    jsr CHRGET
;READ FORMULA INTO FAC.
GETBYT:
    jsr FRMNUM
;CONVERT THE FAC TO A SINGLE BYTE INT.
CONINT:
    jsr POSINT
    ldx FACMO
;RESULT MUST BE .LE. 255.
    bne GOFUC
    ldx FACLO
;SET CONDITION CODES ON TERMINATOR.
CHRGO2:
    jmp CHRGOT
;
; THE "VAL" FUNCTION TAKES A STRING AND TURNS IT INTO
; A NUMBER BY INTERPRETING THE ASCII DIGITS ETCQ
; EXCEPT FOR THE PROBLEM THAT A TERMINATOR MUST BE SUPPLIED
; BY REPLACING THE CHARACTER BEYOND THE STRING, VAL IS MERELY
; A CALL TO FLOATING POINT INPUT ("FIN").
;
;DO SETUP. SET RESULT=NUMERIC.
VAL:
    jsr LEN1
;ZERO THE FAC ON A NULL STRING
    JEQ ZEROFC
    LDXY TXTPTR
;SAVE FOR LATER.
    STXY STRNG2
    ldx INDEX1
    stx TXTPTR
    clc
    adc INDEX1
    sta INDEX2
    ldx INDEX1+1
    stx TXTPTR+1
;NO CARRY, NO INC.
    bcc VAL2
    inx
VAL2:
    stx INDEX2+1
    ldy #.lobyte(0)
;PRESERVE CHARACTER.
    lda (INDEX2),y
    pha
;SET A TERMINATOR.
    lda #.lobyte(0)
    sta (INDEX2),y
;GET CHARACTER PNT'D TO AND SET FLAGS.
    jsr CHRGOT
    jsr FIN
;GET PRES'D CHARACTER.
    pla
    ldy #.lobyte(0)
;STUFF IT BACK.
    sta (INDEX2),y
ST2TXT:
    LDXY STRNG2
    STXY TXTPTR
;ALL DONE WITH STRINGS.
VALRTS:
    rts
; PEEK, POKE, AND FNWAIT.

;GET ADDRESS.
GETNUM:
    jsr FRMNUM
;GET THAT LOCATION.
    jsr GETADR
;CHECK FOR A COMMA.
COMBYT:
    jsr CHKCOM
;GET SOMETHING TO STORE AND RETURN.
    jmp GETBYT
;EXAMINE SIGN.
GETADR:
    lda FACSGN
;FUNCTION CALL ERROR.
    bmi GOFUC
;EXAMINE EXPONENT.
    lda FACEXP
    cmp #.lobyte(145)
;FUNCTION CALL ERROR.
    bcs GOFUC
;INTEGERIZE IT.
    jsr QINT
    LDWD FACMO
    sty POKER
    sta POKER+1
;IT'S DONE !.
    rts

PEEK:
    PSHWD POKER
    jsr GETADR
    ldy #.lobyte(0)
.if (REALIO-3) = 0
;IF WITHIN BASIC,
    cmp #.lobyte(ROMLOC/256)
    bcc GETCON
    cmp #.lobyte(LASTWR/256)
;GIVE HIM ZERO FOR AN ANSWER.
    bcc DOSGFL
.endif
;GET THAT BYTE.
GETCON:
    lda (POKER),y
    tay
DOSGFL:
    PULWD POKER
;FLOAT IT.
    jmp SNGFLT

POKE:
    jsr GETNUM
    txa
    ldy #.lobyte(0)
;STORE VALUE AWAY.
    sta (POKER),y
;SCANNED  EVERYTHING.
    rts

; THE WAIT LOCATION,MASK1,MASK2 STATEMENT WAITS UNTIL THE CONTENTS
; OF LOCATION IS NONZERO WHEN XORED WITH MASK2
; AND THEN ANDED WITH MASK1. IF MASK2 IS NOT PRESENT, IT
; IS ASSUMED TO BE ZERO.

FNWAIT:
    jsr GETNUM
    stx ANDMSK
    ldx #.lobyte(0)
    jsr CHRGOT
    beq ZSTORDO
;GET MASK2.
    jsr COMBYT
STORDO:
    stx EORMSK
    ldy #.lobyte(0)
WAITER:
    lda (POKER),y
    eor EORMSK
    and ANDMSK
    beq WAITER
;GOT A NONZERO.
ZERRTS:
    rts

; FLOATING POINT MATH PACKAGE CONFIGURATION.

;!!!! ALERT !!!!
;THROUGHOUT THE MATH PACKAGE.
; Original documentation:
; THE FLOATING POINT FORMAT IS AS FOLLOWS:
; 
; THE SIGN IS THE FIRST BIT OF THE MANTISSA.
; THE MANTISSA IS 24 BITS LONG.
; THE BINARY POINT IS TO THE LEFT OF THE MSB.
; NUMBER = MANTISSA * 2 ^ EXPONENT.
; THE MANTISSA IS POSITIVE WITH A ONE ASSUMED TO BE WHERE THE SIGN BIT IS.
; THE SIGN OF THE EXPONENT IS THE FIRST BIT OF THE EXPONENT.
; THE EXPONENT IS STORED IN EXCESS 200, I.E. WITH A BIAS OF +200.
; SO, THE EXPONENT IS A SIGNED 8-BIT NUMBER WITH 200 ADDED TO IT.
; AN EXPONENT OF ZERO MEANS THE NUMBER IS ZERO.
; THE OTHER BYTES MAY NOT BE ASSUMED TO BE ZERO.
; TO KEEP THE SAME NUMBER IN THE FAC WHILE SHIFTING,
; 	TO SHIFT RIGHT, EXP:=EXP+1
; 	TO SHIFT LEFT,	EXP:=EXP-1
; 
; IN MEMORY THE NUMBER LOOKS LIKE THIS:
; 	[THE EXPONENT AS A SIGNED NUMBER +200]
; 	[THE SIGN BIT IN 7, BITS 2-8 OF MANTISSA ARE IN BITS 6-0].
; 		(REMEMBER BIT 1 OF MANTISSA IS ALWAYS A ONE.)
; 	[BITS 9-16 OF THE MANTISSA]
; 	[BITS 17-24] OF THE MANTISSA]
; 
; ARITHMETIC ROUTINE CALLING CONVENTIONS:
; 
; FOR ONE ARGUMENT FUNCTIONS:
; 	THE ARGUMENT IS IN THE FAC.
; 	THE RESULT IS LEFT IN THE FAC.
; FOR TWO ARGUMENT OPERATIONS:
; 	THE FIRST ARGUMENT IS IN ARG (ARGEXP,HO,MO,LO AND ARGSGN).
; 	THE SECOND ARGUMENT IS IN THE FAC.
; 	THE RESULT IS LEFT IN THE FAC.
; 
; THE "T" ENTRY POINTS TO THE TWO-ARGUMENT OPERATIONS HAVE BOTH ARGUMENTS
; SETUP IN THE RESPECTIVE REGISTERS. BEFORE CALLING ARG MAY HAVE BEEN
; POPPED OFF THE STACK AND INTO ARG, FOR EXAMPLE.
; THE OTHER ENTRY POINT ASSUMES [Y,A] POINTS TO THE ARGUMENT
; SOMEWHERE IN MEMORY. IT IS UNPACKED INTO ARG BY "CONUPK".
; 
; ON THE STACK, THE SGN IS PUSHED ON FIRST, THE LO,MO,HO AND FINALLY EXP.
; NOTE ALL THINGS ARE KEPT UNPACKED IN ARG, FAC AND ON THE STACK.
; 
; IT IS ONLY WHEN SOMETHING IS STORED AWAY THAT IT IS PACKED TO FOUR
; BYTES. THE UNPACKED FORMAT HAS A SGN BYTE REFLECTING THE SIGN OF THE
; NUMBER (POSITIVE=0, NEGATIVE=-1) A HO,MO AND LO WITH THE HIGH BIT
; OF THE HO TURNED ON. THE EXP IS THE SAME AS STORED FORMAT.
; THIS IS DONE FOR SPEED OF OPERATION.
; %
; FLOATING POINT ADDITION AND SUBTRACTION.
;ENTRY TO ADD 1/2.
FADDH:
    LDWDI FHALF
;UNPACK AND GO ADD IT.
    jmp FADD
;UNPACK ARGUMENT INTO ARG.
FSUB:
    jsr CONUPK
FSUBT:
    lda FACSGN
;COMPLEMENT IT.
    eor #.lobyte(255)
    sta FACSGN
;COMPLEMENT ARISGN.
    eor ARGSGN
    sta ARISGN
;SET CODES ON FACEXP.
    lda FACEXP
;[Y]=ARGEXP..
    jmp FADDT
.if (REALIO-3) <> 0
ZSTORDO = STORDO
.endif
.if (REALIO-3) = 0
ZSTORD:
    lda POKER
    cmp #.lobyte(102)
    bne STORDO
    lda POKER+1
    sbc #.lobyte(25)
    bne STORDO
    sta POKER
    tay
    lda #.lobyte(128)
    sta POKER+1
MRCHKR:
    ldx #.lobyte(10)
.if 0
MRCHR:
    lda 24576,X
.endif
.if 1
MRCHR:
    lda SINCON+30,X
.endif
    and #.lobyte(63)
    sta (POKER),y
    iny
    bne PKINC
    inc POKER+1
PKINC:
    dex
    bne MRCHR
    dec ANDMSK
    bne MRCHKR
    rts
.if 1
.endif
.endif
;DO A LONG SHIFT.
FADD5:
    jsr SHIFTR
;CONTINUE WITH ADDITION.
    bcc FADD4
FADD:
    jsr CONUPK
;IF FAC=0, RESULT IS IN ARG.
FADDT:
    JEQ MOVFA
    ldx FACOV
    stx OLDOV
;DEFAULT IS SHIFT ARGUMENT.
    ldx #.lobyte(ARGEXP)
;IF ARG=0, FAC IS RESULT.
    lda ARGEXP
;ALSO COPY ACCA INTO ACCY.
FADDC:
    tay
;RETURN.
    beq ZERRTS
    sec
    sbc FACEXP
;NO SHIFTING.
    beq FADD4
;BR IF ARGEXP.LT.FACEXP.
    bcc FADDA
;RESULTING EXPONENT.
    sty FACEXP
;SINCE ARG IS BIGGER, IT'S
    ldy ARGSGN
;SIGN IS SIGN OF RESULT.
    sty FACSGN
;SHIFT A NEGATIVE NUMBER OF PLACES.
    eor #.lobyte(255)
;COMPLETE NEGATION. W/ C=1.
    adc #.lobyte(0)
;ZERO OLDOV.
    ldy #.lobyte(0)
    sty OLDOV
;SHIFT THE FAC INSTEAD.
    ldx #.lobyte(FAC)
    bne FADD1
FADDA:
    ldy #.lobyte(0)
    sty FACOV
;FOR SPEED AND NECESSITY.  GETS
FADD1:
    cmp #.lobyte(256-7)
;MOST LIKELY CASE TO SHIFTR FASTEST
;AND ALLOWS SHIFTING OF NEG NUMS
;BY "QINT".
;SHIFT BIG.
    bmi FADD5
    tay
;SET FACOV.
    lda FACOV
;GETS 0 IN MOST SIG BIT.
    lsr 1,X
;DO THE ROLLING.
    jsr ROLSHF
;GET RESULTING SIGN.
FADD4:
    bit ARISGN
;IF POSITIVE, ADD.
    bpl FADD2
;CARRY IS CLEAR.
FADD3:
    ldy #.lobyte(FACEXP)
;FAC IS BIGGER.
    cpx #.lobyte(ARGEXP)
    beq SUBIT
;ARG IS BIGGER.
    ldy #.lobyte(ARGEXP)
SUBIT:
    sec
    eor #.lobyte(255)
    adc OLDOV
    sta FACOV
    lda 3+ADDPRC,Y
    sbc 3+ADDPRC,X
    sta FACLO
    lda 2+ADDPRC,Y
    sbc 2+ADDPRC,X
    sta FACMO
.if (ADDPRC) <> 0
    lda 2,Y
    sbc 2,X
    sta FACMOH
.endif
    lda 1,Y
    sbc 1,X
    sta FACHO
;HERE IF SIGNS DIFFER. IF CARRY,
FADFLT:
    bcs NORMAL
;FAC IS SET OK.
;NEGATE [FAC].
    jsr NEGFAC
NORMAL:
    ldy #.lobyte(0)
    tya
    clc
NORM3:
    ldx FACHO
    bne NORM1
;SHIFT 8 BITS AT A TIME FOR SPEED.
    ldx FACHO+1
    stx FACHO
.if (ADDPRC) <> 0
    ldx FACMOH+1
    stx FACMOH
.endif
    ldx FACMO+1
    stx FACMO
    ldx FACOV
    stx FACLO
    sty FACOV
    adc #.lobyte(8)
    cmp #.lobyte(8*ADDPRC+24)
    bne NORM3
;NOT NEED BY NORMAL BUT BY OTHERS.
ZEROFC:
    lda #.lobyte(0)
;NUMBER MUST BE ZERO.
ZEROF1:
    sta FACEXP
;MAKE SIGN POSITIVE.
ZEROML:
    sta FACSGN
;ALL DONE.
    rts
FADD2:
    adc OLDOV
    sta FACOV
    lda FACLO
    adc ARGLO
    sta FACLO
    lda FACMO
    adc ARGMO
    sta FACMO
.if (ADDPRC) <> 0
    lda FACMOH
    adc ARGMOH
    sta FACMOH
.endif
    lda FACHO
    adc ARGHO
    sta FACHO
;GO ROUND IF SIGNS SAME.
    jmp SQUEEZ

;DECREMENT SHIFT COUNT.
NORM2:
    adc #.lobyte(1)
;SHIFT ALL LEFT ONE BIT.
    asl FACOV
    rol FACLO
    rol FACMO
.if (ADDPRC) <> 0
    rol FACMOH
.endif
    rol FACHO
;IF MSB=0 SHIFT AGAIN.
NORM1:
    bpl NORM2
    sec
    sbc FACEXP
    bcs ZEROFC
    eor #.lobyte(255)
;COMPLEMENT.
    adc #.lobyte(1)
    sta FACEXP
;BITS TO SHIFT?
SQUEEZ:
    bcc RNDRTS
RNDSHF:
    inc FACEXP
    beq OVERR
    BASIC_ROR {FACHO}
.if (ADDPRC) <> 0
    BASIC_ROR {FACMOH}
.endif
    BASIC_ROR {FACMO}
    BASIC_ROR {FACLO}
    BASIC_ROR {FACOV}
;ALL DONE ADDING.
RNDRTS:
    rts

;COMPLEMENT FAC	 ENTIRELY.
NEGFAC:
    COM FACSGN
;COMPLEMENT JUST THE NUMBER.
NEGFCH:
    COM FACHO
.if (ADDPRC) <> 0
    COM FACMOH
.endif
    COM FACMO
    COM FACLO
    COM FACOV
    inc FACOV
    bne INCFRT
INCFAC:
    inc FACLO
    bne INCFRT
    inc FACMO
;IF NO CARRY, RETURN.
    bne INCFRT
.if (ADDPRC) <> 0
    inc FACMOH
    bne INCFRT
.endif
;CARRY INCREMENT.
    inc FACHO
INCFRT:
    rts

OVERR:
    ldx #.lobyte(ERROV)
;TELL USER.
    jmp ERROR
;
; "SHIFTR" SHIFTS [X+1:X+3] [-ACCA]  BITS RIGHT.
; SHIFTS BYTES TO START WITH IF POSSIBLE.
;
;ENTRY POINT FOR MULTIPLIER.
MULSHF:
    ldx #.lobyte(RESHO-1)
;SHIFT BYTES FIRST.
SHFTR2:
    ldy 3+ADDPRC,X
    sty FACOV
.if (ADDPRC) <> 0
    ldy 3,X
    sty 4,X
.endif
;GET MO.
    ldy 2,X
;STORE LO.
    sty 3,X
;GET HO.
    ldy 1,X
;STORE MO.
    sty 2,X
    ldy BITS
;STORE HO.
    sty 1,X
SHIFTR:
    adc #.lobyte(8)
    bmi SHFTR2
    beq SHFTR2
;C CAN BE EITHER 1,0 AND IT WORKS.
    sbc #.lobyte(8)
    tay
    lda FACOV
;EQUIV TO BEQ HERE.
    bcs SHFTRT
.if (RORSW) <> 0
SHFTR3:
    asl 1,X
    bcc SHFTR4
    inc 1,X
SHFTR4:
    BASIC_ROR {1,X}
;YES, TWO OF THEM.
    BASIC_ROR {1,X}
.endif
.if (RORSW) = 0
SHFTR3:
    pha
    lda 1,X
    and #.lobyte(128)
    lsr 1,X
    ora 1,X
    sta 1,X
    SKIP1
.endif
ROLSHF:
.if (RORSW) <> 0
    BASIC_ROR {2,X}
    BASIC_ROR {3,X}
;ONE MO TIME.
.if (ADDPRC) <> 0
    BASIC_ROR {4,X}
.endif
.endif
.if (RORSW) = 0
    pha
    lda #.lobyte(0)
    bcc SHFTR5
    lda #.lobyte(128)
SHFTR5:
    lsr 2,X
    ora 2,X
    sta 2,X
    lda #.lobyte(0)
    bcc SHFTR6
    lda #.lobyte(128)
SHFTR6:
    lsr 3,X
    ora 3,X
    sta 3,X
.if (ADDPRC) <> 0
    lda #.lobyte(0)
    bcc SHFT6A
    lda #.lobyte(128)
SHFT6A:
    lsr 4,X
    ora 4,X
    sta 4,X
.endif
.endif
;ROTATE ARGUMENT 1 BIT RIGHT.
.if (RORSW) <> 0
    BASIC_ROR {A}
.endif
.if (RORSW) = 0
    pla
    php
    lsr A
    plp
    bcc SHFTR7
    ora #.lobyte(128)
.endif
SHFTR7:
    iny
;$$$ ( MOST EXPENSIVE ! )
    bne SHFTR3
;CLEAR OUTPUT OF FACOV.
SHFTRT:
    clc
    rts
; NATURAL LOG FUNCTION.
;
; CALCULATION IS BY:
; LN(F*2^N)=(N+LOG2(F))*LN(2)
; AN APPROXIMATION POLYNOMIAL IS USED TO CALCULATE LOG2(F).
;  CONSTANTS USED BY LOG:
; 1.0
FONE:
    .byte 129
    .byte 0
    .byte 0
    .byte 0
.if (ADDPRC) <> 0
    .byte 0
.endif
.if (ADDPRC) = 0
; DEGREE-1
LOGCN2:
    .byte 2
; 0.59897437
    .byte 128
    .byte 25
    .byte 86
    .byte 98
; 0.96147080
    .byte 128
    .byte 118
    .byte 34
    .byte 243
; 2.88539129
    .byte 130
    .byte 56
    .byte 170
    .byte 64
.endif

.if (ADDPRC) <> 0
;DEGREE-1
LOGCN2:
    .byte 3
;.43425594188
    .byte 127
    .byte 94
    .byte 86
    .byte 203
    .byte 121
; .57658454134
    .byte 128
    .byte 19
    .byte 155
    .byte 11
    .byte 100
; .96180075921
    .byte 128
    .byte 118
    .byte 56
    .byte 147
    .byte 22
; 2.8853900728
    .byte 130
    .byte 56
    .byte 170
    .byte 59
    .byte 32
.endif
; SQR(0.5)
SQRHLF:
    .byte 128
    .byte 53
    .byte 4
    .byte 243
.if (ADDPRC) <> 0
    .byte 52
.endif
; SQR(2.0)
SQRTWO:
    .byte 129
    .byte 53
    .byte 4
    .byte 243
.if (ADDPRC) <> 0
    .byte 52
.endif
; -1/2
NEGHLF:
    .byte 128
    .byte 128
    .byte 0
    .byte 0
.if (ADDPRC) <> 0
    .byte 0
.endif
; LN(2)
LOG2:
    .byte 128
    .byte 49
    .byte 114
.if (ADDPRC) = 0
    .byte 24
.endif
.if (ADDPRC) <> 0
    .byte 23
    .byte 248
.endif

;IS IT POSITIVE?
LOG:
    jsr SIGN
    beq LOGERR
    bpl LOG1
;CAN'T TOLERATE NEG OR ZERO.
LOGERR:
    jmp FCERR
;GET EXPONENT INTO ACCA.
LOG1:
    lda FACEXP
;REMOVE BIAS. (CARRY IS OFF)
    sbc #.lobyte(127)
;SAVE AWHILE.
    pha
    lda #.lobyte(128)
;RESULT IS FAC IN RANGE [0.5,1].
    sta FACEXP
;GET POINTER TO SQR(0.5).
    LDWDI SQRHLF

; CALCULATE (F-SQR(.5))/(F+SQR(.5))

;ADD TO FAC.
    jsr FADD
;GET SQR(2.).
    LDWDI SQRTWO
    jsr FDIV
    LDWDI FONE
    jsr FSUB
    LDWDI LOGCN2
;EVALUATE APPROXIMATION POLYNOMIAL.
    jsr POLYX
;ADD IN LAST CONSTANT.
    LDWDI NEGHLF
    jsr FADD
;GET EXPONENT BACK.
    pla
;ADD IT IN.
    jsr FINLOG
;MULTIPLY RESULT BY LOG(2.0).
MULLN2:
    LDWDI LOG2
;	JMP	FMULT		;MULTIPLY TOGETHER.
; FLOATING MULTIPLICATION AND DIVISION.
;MULTIPLICATION		FAC:=ARG*FAC.
;UNPACK THE CONSTANT INTO ARG FOR USE.
FMULT:
    jsr CONUPK
;IF FAC=0, RETURN. FAC IS SET.
FMULTT:
    JEQ MULTRT
;FIX UP THE EXPONENTS.
    jsr MULDIV
;TO CLEAR RESULT.
    lda #.lobyte(0)
    sta RESHO
.if (ADDPRC) <> 0
    sta RESMOH
.endif
    sta RESMO
    sta RESLO
    lda FACOV
    jsr MLTPLY
;MLTPLY ARG BY FACLO.
    lda FACLO
    jsr MLTPLY
;MLTPLY ARG BY FACMO.
    lda FACMO
    jsr MLTPLY
.if (ADDPRC) <> 0
    lda FACMOH
    jsr MLTPLY
.endif
;MLTPLY ARG BY FACHO.
    lda FACHO
    jsr MLTPL1
;MOVE RESULT INTO FAC,
    jmp MOVFR
;NORMALIZE RESULT, AND RETURN.
;SHIFT RESULT RIGHT 1 BYTE.
MLTPLY:
    JEQ MULSHF
MLTPL1:
    lsr A
    ora #.lobyte(128)
MLTPL2:
    tay
;IT MULT BIT=0, JUST SHIFT.
    bcc MLTPL3
    clc
    lda RESLO
    adc ARGLO
    sta RESLO
    lda RESMO
    adc ARGMO
    sta RESMO
.if (ADDPRC) <> 0
    lda RESMOH
    adc ARGMOH
    sta RESMOH
.endif
    lda RESHO
    adc ARGHO
    sta RESHO
MLTPL3:
    BASIC_ROR {RESHO}
.if (ADDPRC) <> 0
    BASIC_ROR {RESMOH}
.endif
    BASIC_ROR {RESMO}
    BASIC_ROR {RESLO}
;SAVE FOR ROUNDING.
    BASIC_ROR {FACOV}
    tya
;CLEAR MSB SO WE GET A CLOSER TO 0.
    lsr A
;SLOW AS A TURTLE !
    bne MLTPL2
MULTRT:
    rts

;ROUTINE TO UNPACK MEMORY INTO ARG.
CONUPK:
    STWD INDEX1
    ldy #.lobyte(3+ADDPRC)
    lda (INDEX1),y
    sta ARGLO
    dey
    lda (INDEX1),y
    sta ARGMO
    dey
.if (ADDPRC) <> 0
    lda (INDEX1),y
    sta ARGMOH
    dey
.endif
    lda (INDEX1),y
    sta ARGSGN
    eor FACSGN
    sta ARISGN
    lda ARGSGN
    ora #.lobyte(128)
    sta ARGHO
    dey
    lda (INDEX1),y
    sta ARGEXP
;SET CODES OF FACEXP.
    lda FACEXP
    rts

;CHECK SPECIAL CASES AND ADD EXPONENTS FOR FMULT, FDIV.
;EXP OF ARG=0?
MULDIV:
    lda ARGEXP
;SO WE GET ZERO EXPONENT.
MLDEXP:
    beq ZEREMV
    clc
;RESULT IS IN ACCA.
    adc FACEXP
;FIND [C] XOR [N].
    bcc TRYOFF
;OVERFLOW IF BITS MATCH.
    bmi GOOVER
    clc
    SKIP2
;UNDERFLOW.
TRYOFF:
    bpl ZEREMV
;ADD BIAS.
    adc #.lobyte(128)
    sta FACEXP
;ZERO THE REST OF IT.
    JEQ ZEROML
    lda ARISGN
;ARISGN IS RESULT'S SIGN.
    sta FACSGN
;DONE.
    rts
;GET SIGN.
MLDVEX:
    lda FACSGN
;COMPLEMENT IT.
    eor #.lobyte(255)
    bmi GOOVER
;GET ADDR OFF STACK.
ZEREMV:
    pla
    pla
;UNDERFLOW.
    jmp ZEROFC
;OVERFLOW.
GOOVER:
    jmp OVERR

;MULTIPLY FAC BY 10.
;COPY FAC INTO ARG.
MUL10:
    jsr MOVAF
    tax
;IF [FAC]=0, GOT ANSWER.
    beq MUL10R
    clc
;AUGMENT EXP BY 2.
    adc #.lobyte(2)
;OVERFLOW.
    bcs GOOVER
FINML6:
    ldx #.lobyte(0)
;SIGNS ARE SAME.
    stx ARISGN
;ADD TOGETHER.
    jsr FADDC
;MULTIPLY BY TWO.
    inc FACEXP
;OVERFLOW.
    beq GOOVER
MUL10R:
    rts

; DIVIDE FAC BY 10.
TENZC:
    .byte 132
    .byte 32
    .byte 0
    .byte 0
.if (ADDPRC) <> 0
    .byte 0
.endif
;MOVE FAC TO ARG.
DIV10:
    jsr MOVAF
;POINT TO CONSTANT OF 10.0
    LDWDI TENZC
;SIGNS ARE BOTH POSITIVE.
    ldx #.lobyte(0)
FDIVF:
    stx ARISGN
;PUT IT INTO FAC.
    jsr MOVFM
;SKIP OVER NEXT TWO BYTES.
    jmp FDIVT
;UNPACK CONSTANT.
FDIV:
    jsr CONUPK
;CAN'T DIVIDE BY ZERO !
FDIVT:
    beq DV0ERR
;(NOT ENOUGH ROOM TO STORE RESULT.)
;TAKE FACOV INTO ACCT IN FAC.
    jsr ROUND
;NEGATE FACEXP.
    lda #.lobyte(0)
    sec
    sbc FACEXP
    sta FACEXP
;FIX UP EXPONENTS.
    jsr MULDIV
;SCALE IT RIGHT.
    inc FACEXP
;OVERFLOW.
    beq GOOVER
;SETUP PROCEDURE.
    ldx #.lobyte(256-3-ADDPRC)
    lda #.lobyte(1)
;THIS IS THE BEST CODE IN THE WHOLE PILE.
DIVIDE:
;SEE WHAT RELATION HOLDS.
    ldy ARGHO
    cpy FACHO
;[C]=0,1. N(C=0)=0.
    bne SAVQUO
.if (ADDPRC) <> 0
    ldy ARGMOH
    cpy FACMOH
    bne SAVQUO
.endif
    ldy ARGMO
    cpy FACMO
    bne SAVQUO
    ldy ARGLO
    cpy FACLO
SAVQUO:
    php
;SAVE RESULT.
    rol A
;IF NOT DONE, CONTINUE.
    bcc QSHFT
    inx
    sta RESLO,X
    beq LD100
;NOTE THIS REQ 1 MO RAM THEN NECESS.
    bpl DIVNRM
    lda #.lobyte(1)
;RETURN CONDITION CODES.
QSHFT:
    plp
;FAC .LE. ARG.
    bcs DIVSUB
;SHIFT ARG ONE PLACE LEFT.
SHFARG:
    asl ARGLO
    rol ARGMO
.if (ADDPRC) <> 0
    rol ARGMOH
.endif
    rol ARGHO
;SAVE A RESULT OF ONE FOR THIS POSITION
    bcs SAVQUO
;AND DIVIDE.
;IF MSB ON, GO DECIDE WHETHER TO SUB.
    bmi DIVIDE
    bpl SAVQUO
;NOTICE C MUST BE ON HERE.
DIVSUB:
    tay
    lda ARGLO
    sbc FACLO
    sta ARGLO
    lda ARGMO
    sbc FACMO
    sta ARGMO
.if (ADDPRC) <> 0
    lda ARGMOH
    sbc FACMOH
    sta ARGMOH
.endif
    lda ARGHO
    sbc FACHO
    sta ARGHO
    tya
    jmp SHFARG
;ONLY WANT TWO MORE BITS.
LD100:
    lda #.lobyte(64)
;ALWAYS BRANCHES.
    bne QSHFT
;GET LAST TWO BITS INTO MSB AND B6.
DIVNRM:
.repeat 6
    asl A
.endrepeat
    sta FACOV
;TO GET GARBAGE OFF STACK.
    plp
;MOVE RESULT INTO FAC, THEN
    jmp MOVFR
;NORMALIZE RESULT AND RETURN.
DV0ERR:
    ldx #.lobyte(ERRDV0)
    jmp ERROR
; FLOATING POINT MOVEMENT ROUTINES.
;MOVE RESULT TO FAC.
MOVFR:
    lda RESHO
    sta FACHO
.if (ADDPRC) <> 0
    lda RESMOH
    sta FACMOH
.endif
    lda RESMO
    sta FACMO
;MOVE LO AND SGN.
    lda RESLO
    sta FACLO
;ALL DONE.
    jmp NORMAL

;MOVE MEMORY INTO FAC (UNPACKED).
MOVFM:
    STWD INDEX1
    ldy #.lobyte(3+ADDPRC)
    lda (INDEX1),y
    sta FACLO
    dey
    lda (INDEX1),y
    sta FACMO
    dey
.if (ADDPRC) <> 0
    lda (INDEX1),y
    sta FACMOH
    dey
.endif
    lda (INDEX1),y
    sta FACSGN
    ora #.lobyte(128)
    sta FACHO
    dey
    lda (INDEX1),y
;LEAVE SWITCHES SET ON EXP.
    sta FACEXP
    sty FACOV
    rts

;MOVE NUMBER FROM FAC TO MEMORY.
MOV2F:
    ldx #.lobyte(TEMPF2)
    SKIP2
MOV1F:
    ldx #.lobyte(TEMPF1)
MOVML:
    ldy #.lobyte(0)
;ALWAYS BRANCHES.
    beq MOVMF
MOVVF:
    LDXY FORPNT
MOVMF:
    jsr ROUND
    STXY INDEX1
    ldy #.lobyte(3+ADDPRC)
    lda FACLO
    sta (INDEX),y
    dey
    lda FACMO
    sta (INDEX),y
    dey
.if (ADDPRC) <> 0
    lda FACMOH
    sta (INDEX),y
    dey
.endif
;INCLUDE SIGN IN HO.
    lda FACSGN
    ora #.lobyte(127)
    and FACHO
    sta (INDEX),y
    dey
    lda FACEXP
    sta (INDEX),y
;ZERO IT SINCE ROUNDED.
    sty FACOV
;[Y]=0.
    rts

;MOVE ARG INTO FAC.
MOVFA:
    lda ARGSGN
MOVFA1:
    sta FACSGN
    ldx #.lobyte(4+ADDPRC)
MOVFAL:
    lda ARGEXP-1,X
    sta FACEXP-1,X
    dex
    bne MOVFAL
    stx FACOV
    rts

;MOVE FAC INTO ARG.
MOVAF:
    jsr ROUND
MOVEF:
    ldx #.lobyte(5+ADDPRC)
MOVAFL:
    lda FACEXP-1,X
    sta ARGEXP-1,X
    dex
    bne MOVAFL
;ZERO IT SINCE ROUNDED.
    stx FACOV
MOVRTS:
    rts

;ZERO?
ROUND:
    lda FACEXP
;YES. DONE ROUNDING.
    beq MOVRTS
;ROUND?
    asl FACOV
;NO. MSB OFF.
    bcc MOVRTS
;YES, ADD ONE TO LSB(FAC).
INCRND:
    jsr INCFAC
;NO CARRY MEANS DONE.
    bne MOVRTS
;SQUEEZ MSB IN AND RTS.
    jmp RNDSHF
;NOTE [C]=1 SINCE INCFAC DOESNT TOUCH C.
; SIGN, SGN, FLOAT, NEG, ABS.

;PUT SIGN OF FAC IN ACCA.
SIGN:
    lda FACEXP
;IF NUMBER IS ZERO, SO IS RESULT.
    beq SIGNRT
FCSIGN:
    lda FACSGN
FCOMPS:
    rol A
;ASSUME NEGATIVE.
    lda #.lobyte(255)
    bcs SIGNRT
;GET +1.
    lda #.lobyte(1)
SIGNRT:
    rts

;SGN FUNCTION.
SGN:
    jsr SIGN

;FLOAT THE SIGNED INTEGER IN ACCA.
;PUT [ACCA] IN HIGH ORDER.
FLOAT:
    sta FACHO
    lda #.lobyte(0)
    sta FACHO+1
;GET THE EXPONENT.
    ldx #.lobyte(136)

;FLOAT THE SIGNED NUMBER IN FAC.
FLOATS:
    lda FACHO
    eor #.lobyte(255)
;GET COMP OF SIGN IN CARRY.
    rol A
;ZERO [ACCA] BUT NOT CARRY.
FLOATC:
    lda #.lobyte(0)
    sta FACLO
.if (ADDPRC) <> 0
    sta FACMO
.endif
FLOATB:
    stx FACEXP
    sta FACOV
    sta FACSGN
    jmp FADFLT

;ABSOLUTE VALUE OF FAC.
ABS:
    lsr FACSGN
    rts

; COMPARE TWO NUMBERS.
;A=1 IF ARG .LT. FAC.
;A=0 IF ARG=FAC.
;A=-1 IF ARG .GT. FAC.
FCOMP:
    sta INDEX2
FCOMPN:
    sty INDEX2+1
    ldy #.lobyte(0)
;HAS ARGEXP.
    lda (INDEX2),y
;BUMP PNTR UP.
    iny
;SAVE A IN X AND RESET CODES.
    tax
    beq SIGN
    lda (INDEX2),y
;SIGNS THE SAME.
    eor FACSGN
;SIGNS DIFFER SO RESULT IS
    bmi FCSIGN
;SIGN OF FAC AGAIN.
FOUTCP:
    cpx FACEXP
    bne FCOMPC
    lda (INDEX2),y
    ora #.lobyte(128)
    cmp FACHO
    bne FCOMPC
    iny
.if (ADDPRC) <> 0
    lda (INDEX2),y
    cmp FACMOH
    bne FCOMPC
    iny
.endif
    lda (INDEX2),y
    cmp FACMO
    bne FCOMPC
    iny
    lda #.lobyte(127)
    cmp FACOV
    lda (INDEX2),y
;GET ZERO IF EQUAL.
    sbc FACLO
    beq QINTRT
FCOMPC:
    lda FACSGN
    bcc FCOMPD
    eor #.lobyte(255)
;A PART OF SIGN SETS ACCA UP.
FCOMPD:
    jmp FCOMPS

; GREATEST INTEGER FUNCTION.
;QUICK GREATEST INTEGER FUNCTION.
;LEAVES INT(FAC) IN FACHO&MO&LO SIGNED.
;ASSUMES FAC .LT. 2^23 = 8388608
QINT:
    lda FACEXP
;IF ZERO, GOT IT.
    beq CLRFAC
    sec
;GET NUMBER OF PLACES TO SHIFT.
    sbc #.lobyte(8*ADDPRC+152)
    bit FACSGN
    bpl QISHFT
    tax
    lda #.lobyte(255)
;PUT 377 IN WHEN SHFTR SHIFTS BYTES.
    sta BITS
;TRULY NEGATE QUANTITY IN FAC.
    jsr NEGFCH
    txa
QISHFT:
    ldx #.lobyte(FAC)
    cmp #.lobyte(256-7)
;IF NUMBER OF PLACES .GE. 7
    bpl QINT1
;SHIFT 1 PLACE AT A TIME.
;START SHIFTING BYTES, THEN BITS.
    jsr SHIFTR
;ZERO BITS SINCE ADDER WANTS ZERO.
    sty BITS
QINTRT:
    rts
;PUT COUNT IN COUNTER.
QINT1:
    tay
    lda FACSGN
;GET SIGN BIT.
    and #.lobyte(128)
;SAVE FIRST SHIFTED BYTE.
    lsr FACHO
    ora FACHO
    sta FACHO
;SHIFT THE REST.
    jsr ROLSHF
;ZERO [BITS].
    sty BITS
    rts

;GREATEST INTEGER FUNCTION.
INT:
    lda FACEXP
    cmp #.lobyte(8*ADDPRC+152)
;FORGET IT.
    bcs INTRTS
    jsr QINT
;CLR OVERFLOW BYTE.
    sty FACOV
    lda FACSGN
;MAKE FAC LOOK POSITIVE.
    sty FACSGN
;GET COMPLEMENT OF SIGN IN CARRY.
    eor #.lobyte(128)
    rol A
    lda #.lobyte(8*ADDPRC+152)
    sta FACEXP
    lda FACLO
    sta INTEGR
    jmp FADFLT
;MAKE IT REALLY ZERO.
CLRFAC:
    sta FACHO
.if (ADDPRC) <> 0
    sta FACMOH
.endif
    sta FACMO
    sta FACLO
    tay
INTRTS:
    rts
; FLOATING POINT INPUT ROUTINE.
;NUMBER INPUT IS LEFT IN FAC.
;AT ENTRY [TXTPTR] POINTS TO THE FIRST CHARACTER IN A TEXT BUFFER.
;THE FIRST CHARACTER IS ALSO IN ACCA. FIN PACKS THE DIGITS
;INTO THE FAC AS AN INTEGER AND KEEPS TRACK OF WHERE THE
;DECIMAL POINT IS. [DPTFLG] TELL WHETHER A DP HAS BEEN
;SEEN. [DECCNT] IS THE NUMBER OF DIGITS AFTER THE DP.
;AT THE END [DECCNT] AND THE EXPONENT ARE USED TO
;DETERMINE HOW MANY TIMES TO MULTIPLY OR DIVIDE BY TEN
;TO GET THE CORRECT NUMBER.
;ZERO FACSGN&SGNFLG.
FIN:
    ldy #.lobyte(0)
;ZERO EXP AND HO (AND MOH).
    ldx #.lobyte(9+ADDPRC)
;ZERO MO AND LO.
FINZLP:
    sty DECCNT,X
;ZERO TENEXP AND EXPSGN
    dex
;ZERO DECCNT, DPTFLG.
    bpl FINZLP
;FLAGS STILL SET FROM CHRGET.
    bcc FINDGQ
;A NEGATIVE SIGN?
    cmp #.lobyte(45)
;NO, TRY PLUS SIGN.
    bne QPLUS
;IT'S NEGATIVE. (X=377).
    stx SGNFLG
;ALWAYS BRANCHES.
    beq FINC
;PLUS SIGN?
QPLUS:
    cmp #.lobyte(43)
;YES, SKIP IT.
    bne FIN1
FINC:
    jsr CHRGET
FINDGQ:
    bcc FINDIG
;THE DP?
FIN1:
    cmp #.lobyte(46)
;NO KIDDING.
    beq FINDP
;EXPONENT FOLLOWS.
    cmp #.lobyte(69)
;NO.
    bne FINE
;HERE TO CHECK FOR SIGN OF EXP.
;YES. GET ANOTHER.
    jsr CHRGET
;IT IS A DIGIT. (EASIER THAN
    bcc FNEDG1
;BACKING UP POINTER.)
;MINUS?
    cmp #.lobyte(MINUTK)
;NEGATE.
    beq FINEC1
;MINUS SIGN?
    cmp #.lobyte(45)
    beq FINEC1
;PLUS?
    cmp #.lobyte(PLUSTK)
    beq FINEC
;PLUS SIGN?
    cmp #.lobyte(43)
    beq FINEC
    bne FINEC2
;TURN IT ON.
FINEC1:
    BASIC_ROR {EXPSGN}
;GET ANOTHER.
FINEC:
    jsr CHRGET
;IT IS A DIGIT.
FNEDG1:
    bcc FINEDG
FINEC2:
    bit EXPSGN
    bpl FINE
    lda #.lobyte(0)
    sec
    sbc TENEXP
    jmp FINE1
FINDP:
    BASIC_ROR {DPTFLG}
    bit DPTFLG
    bvc FINC
FINE:
    lda TENEXP
FINE1:
    sec
;GET NUMBER OF PLACES TO SHIFT.
    sbc DECCNT
    sta TENEXP
;NEGATE?
    beq FINQNG
;POSITIVE SO MULTIPLY.
    bpl FINMUL
FINDIV:
    jsr DIV10
;DONE?
    inc TENEXP
;NO.
    bne FINDIV
;YES.
    beq FINQNG
FINMUL:
    jsr MUL10
;DONE?
    dec TENEXP
;NO
    bne FINMUL
FINQNG:
    lda SGNFLG
;IF POSITIVE, RETURN.
    bmi NEGXQS
    rts
;OTHERWISE, NEGATE AND RETURN.
NEGXQS:
    jmp NEGOP

FINDIG:
    pha
    bit DPTFLG
    bpl FINDG1
    inc DECCNT
FINDG1:
    jsr MUL10
;GET IT BACK.
    pla
    sec
    sbc #.lobyte(48)
;ADD IT IN.
    jsr FINLOG
    jmp FINC

FINLOG:
    pha
;SAVE FAC FOR LATER.
    jsr MOVAF
    pla
;FLOAT THE VALUE IN ACCA.
    jsr FLOAT
    lda ARGSGN
    eor FACSGN
;RESULTANT SIGN.
    sta ARISGN
;SET SIGNS ON THING TO ADD.
    ldx FACEXP
;ADD TOGETHER AND RETURN.
    jmp FADDT

;HERE PACK IN THE NEXT DIGIT OF THE EXPONENT.
;MULTIPLY THE OLD EXP BY 10 AND ADD IN THE NEXT
;DIGIT. NOTE: EXP OVERFLOW IS NOT CHECKED FOR.
;GET EXP SO FAR.
FINEDG:
    lda TENEXP
;WILL RESULT BE .GE. 100?
    cmp #.lobyte(10)
    bcc MLEX10
;GET 100.
    lda #.lobyte(100)
    bit EXPSGN
;IF NEG EXP, NO CHK FOR OVERR.
    bmi MLEXMI
    jmp OVERR
;MULT BY 2 TWICE
MLEX10:
    asl A
    asl A
;POSSIBLE SHIFT OUT OF HIGH.
    clc
;LIKE MULTIPLYING BY FIVE.
    adc TENEXP
;AND NOW BY TEN.
    asl A
    clc
    ldy #.lobyte(0)
    adc (TXTPTR),y
    sec
    sbc #.lobyte(48)
;SAVE RESULT.
MLEXMI:
    sta TENEXP
    jmp FINEC
; FLOATING POINT OUTPUT ROUTINE.

.if (ADDPRC) = 0
; 99999.9499
NZ0999:
    .byte 145
    .byte 67
    .byte 79
    .byte 248
; 999999.499
NZ9999:
    .byte 148
    .byte 116
    .byte 35
    .byte 247
; 10^6.
NZMIL:
    .byte 148
    .byte 116
    .byte 36
    .byte 0
.endif
.if (ADDPRC) <> 0
; 99999999.9499
NZ0999:
    .byte 155
    .byte 62
    .byte 188
    .byte 31
    .byte 253
; 999999999.499
NZ9999:
    .byte 158
    .byte 110
    .byte 107
    .byte 39
    .byte 253
; 10^9
NZMIL:
    .byte 158
    .byte 110
    .byte 107
    .byte 40
    .byte 0
.endif
;ENTRY TO LINPRT.
INPRT:
    LDWDI INTXT
    jsr STROU2
    lda CURLIN+1
    ldx CURLIN
LINPRT:
    STWX FACHO
;EXPONENT OF 16.
    ldx #.lobyte(144)
;NUMBER IS POSITIVE.
    sec
    jsr FLOATC
    jsr FOUT
;PRINT AND RETURN.
STROU2:
    jmp STROUT

FOUT:
    ldy #.lobyte(1)
;PRINT SPACE IF POSITIVE.
FOUTC:
    lda #.lobyte(32)
    bit FACSGN
    bpl FOUT1
    lda #.lobyte(45)
;STORE THE CHARACTER.
FOUT1:
    sta FBUFFR-1,Y
;MAKE FAC POS FOR QINT.
    sta FACSGN
;SAVE FOR LATER.
    sty FBUFPT
    iny
;GET ZERO TO TYPE IF FAC=0.
    lda #.lobyte(48)
    ldx FACEXP
    JEQ FOUT19
    lda #.lobyte(0)
;IS NUMBER .LT. 1.0 ?
    cpx #.lobyte(128)
;NO.
    beq FOUT37
    bcs FOUT7
;MULTIPLY BY 10^6.
FOUT37:
    LDWDI NZMIL
    jsr FMULT
    lda #.lobyte(256-3*ADDPRC-6)
;SAVE COUNT OR ZERO IT.
FOUT7:
    sta DECCNT
FOUT4:
    LDWDI NZ9999
;IS NUMBER .GT. 999999.499 ?
    jsr FCOMP
;OR 999999999.499?
    beq BIGGES
;YES. MAKE IT SMALLER.
    bpl FOUT9
FOUT3:
    LDWDI NZ0999
;IS NUMBER .GT. 99999.9499 ?
    jsr FCOMP
; OR 99999999.9499?
    beq FOUT38
;YES. DONE MULTIPLYING.
    bpl FOUT5
;MAKE IT BIGGER.
FOUT38:
    jsr MUL10
    dec DECCNT
;SEE IF THAT DOES IT.
    bne FOUT3
;THIS ALWAYS GOES.
;MAKE IT SMALLER.
FOUT9:
    jsr DIV10
    inc DECCNT
;SEE IF THAT DOES IT.
    bne FOUT4
;THIS ALWAYS GOES.

;ADD A HALF TO ROUND UP.
FOUT5:
    jsr FADDH
BIGGES:
    jsr QINT
;DECIMAL POINT COUNT.
    ldx #.lobyte(1)
    lda DECCNT
    clc
;SHOULD NUMBER BE PRINTED IN E NOTATION?
    adc #.lobyte(3*ADDPRC+7)
;IE, IS NUMBER .LT. .01 ?
;YES.
    bmi FOUTPI
;IS IT .GT. 999999 (999999999)?
    cmp #.lobyte(3*ADDPRC+8)
;YES. USE E NOTATION.
    bcs FOUT6
;NUMBER OF PLACES BEFORE DECIMAL POINT.
    adc #.lobyte(255)
;PUT INTO ACCX.
    tax
;NO E NOTATION.
    lda #.lobyte(2)
FOUTPI:
    sec
;EFFECTIVELY ADD 5 TO ORIG EXP.
FOUT6:
    sbc #.lobyte(2)
;THAT IS THE EXPONENT TO PRINT.
    sta TENEXP
;NUMBER OF DECIMAL PLACES.
    stx DECCNT
    txa
    beq FOUT39
;SOME PLACES BEFORE DEC PNT.
    bpl FOUT8
;GET POINTER TO OUTPUT.
FOUT39:
    ldy FBUFPT
;PUT IN "."
    lda #.lobyte(46)
    iny
    sta FBUFFR-1,Y
    txa
    beq FOUT16
;GET THE ENSUING ZERO.
    lda #.lobyte(48)
    iny
    sta FBUFFR-1,Y
;SAVE FOR LATER.
FOUT16:
    sty FBUFPT
FOUT8:
    ldy #.lobyte(0)
;FIRST PASS THRU, ACCX HAS MSB SET.
FOUTIM:
    ldx #.lobyte(128)
FOUT2:
    lda FACLO
    clc
    adc FOUTBL+2+ADDPRC,Y
    sta FACLO
    lda FACMO
    adc FOUTBL+1+ADDPRC,Y
    sta FACMO
.if (ADDPRC) <> 0
    lda FACMOH
    adc FOUTBL+1,Y
    sta FACMOH
.endif
    lda FACHO
    adc FOUTBL,Y
    sta FACHO
;IT WAS DONE YET ANOTHER TIME.
    inx
    bcs FOUT41
    bpl FOUT2
    bmi FOUT40
FOUT41:
    bmi FOUT2
FOUT40:
    txa
;CAN USE ACCA AS IS.
    bcc FOUTYP
;FIND 11.-[A].
    eor #.lobyte(255)
;C IS STILL ON TO COMPLETE NEGATION.
    adc #.lobyte(10)
;AND WILL ALWAYS BE ON AFTER.
;GET A CHARACTER TO PRINT.
FOUTYP:
    adc #.lobyte(48-1)
;BUMP POINTER UP.
.repeat 3+ADDPRC
    iny
.endrepeat
    sty FDECPT
    ldy FBUFPT
;POINT TO PLACE TO STORE OUTPUT.
    iny
    tax
;GET RID OF MSB.
    and #.lobyte(127)
    sta FBUFFR-1,Y
    dec DECCNT
;NOT TIME FOR DP YET.
    bne STXBUF
    lda #.lobyte(46)
    iny
;STORE DP.
    sta FBUFFR-1,Y
;STORE PNTR FOR LATER.
STXBUF:
    sty FBUFPT
    ldy FDECPT
;COMPLEMENT ACCX
FOUTCM:
    txa
;COMPLEMENT ACCA.
    eor #.lobyte(255)
;SAVE ONLY MSB.
    and #.lobyte(128)
    tax
    cpy #.lobyte(FDCEND-FOUTBL)
.if (TIME) <> 0
    beq FOULDY
    cpy #.lobyte(TIMEND-FOUTBL)
.endif
;CONTINUE WITH OUTPUT.
    bne FOUT2
;GET BACK OUTPUT PNTR.
FOULDY:
    ldy FBUFPT
;REMOVE TRAILING ZEROES.
FOUT11:
    lda FBUFFR-1,Y
    dey
    cmp #.lobyte(48)
    beq FOUT11
    cmp #.lobyte(46)
;RUN INTO DP. STOP.
    beq FOUT12
;SOMETHING ELSE. SAVE IT.
    iny
FOUT12:
    lda #.lobyte(43)
    ldx TENEXP
;NO EXPONENT TO OUTPUT.
    beq FOUT17
    bpl FOUT14
    lda #.lobyte(0)
    sec
    sbc TENEXP
    tax
;EXPONENT IS NEGATIVE.
    lda #.lobyte(45)
;STORE SIGN OF EXP
FOUT14:
    sta FBUFFR-1+2,Y
    lda #.lobyte(69)
;STORE THE "E" CHARACTER.
    sta FBUFFR-1+1,Y
    txa
    ldx #.lobyte(48-1)
    sec
;MOVE CLOSER TO OUTPUT VALUE.
FOUT15:
    inx
;SUBTRACT 10.
    sbc #.lobyte(10)
;NOT NEGATIVE YET.
    bcs FOUT15
;GET SECOND OUTPUT CHARACTER.
    adc #.lobyte(48+10)
;STORE HIGH DIGIT.
    sta FBUFFR-1+4,Y
    txa
;STORE	LOW DIGIT.
    sta FBUFFR-1+3,Y
;PUT IN TERMINATOR.
    lda #.lobyte(0)
    sta FBUFFR-1+5,Y
;RETURN. (ALWAYS BRANCHES).
    BEQA FOUT20
;STORE THE CHARACTER.
FOUT19:
    sta FBUFFR-1,Y
;A TERMINATOR.
FOUT17:
    lda #.lobyte(0)
    sta FBUFFR-1+1,Y
FOUT20:
    LDWDI FBUFFR
;ALL DONE.
FPWRRT:
    rts
;1/2
FHALF:
    .byte 128
    .byte 0
ZERO:
    .byte 0
    .byte 0
.if (ADDPRC) <> 0
    .byte 0
.endif

;POWER OF TEN TABLE
.if (ADDPRC) = 0
;-100000
FOUTBL:
    .byte 254
    .byte 121
    .byte 96
;10000
    .byte 0
    .byte 39
    .byte 16
;-1000
    .byte 255
    .byte 252
    .byte 24
;100
    .byte 0
    .byte 0
    .byte 100
;-10
    .byte 255
    .byte 255
    .byte 246
;1
    .byte 0
    .byte 0
    .byte 1
.endif

.if (ADDPRC) <> 0
;-100,000,000
FOUTBL:
    .byte 250
    .byte 10
    .byte 31
    .byte 0
;10,000,000
    .byte 0
    .byte 152
    .byte 150
    .byte 128
;-1,000,000
    .byte 255
    .byte 240
    .byte 189
    .byte 192
;100,000
    .byte 0
    .byte 1
    .byte 134
    .byte 160
;-10,000
    .byte 255
    .byte 255
    .byte 216
    .byte 240
;1000
    .byte 0
    .byte 0
    .byte 3
    .byte 232
;-100
    .byte 255
    .byte 255
    .byte 255
    .byte 156
;10
    .byte 0
    .byte 0
    .byte 0
    .byte 10
;-1
    .byte 255
    .byte 255
    .byte 255
    .byte 255
.endif
FDCEND:
.if (TIME) <> 0
; -2160000 FOR TIME CONVERTER.
    .byte 255
    .byte 223
    .byte 10
    .byte 128
; 216000
    .byte 0
    .byte 3
    .byte 75
    .byte 192
; -36000
    .byte 255
    .byte 255
    .byte 115
    .byte 96
; 3600
    .byte 0
    .byte 0
    .byte 14
    .byte 16
; -600
    .byte 255
    .byte 255
    .byte 253
    .byte 168
; 60
    .byte 0
    .byte 0
    .byte 0
    .byte 60
TIMEND:
.endif

; EXPONENTIATION AND SQUARE ROOT FUNCTION.
;SQUARE ROOT FUNCTION --- SQR(A)
;USE SQR(X)=X^.5
;MOVE FAC INTO ARG.
SQR:
    jsr MOVAF
    LDWDI FHALF
;PUT MEMORY INTO FAC.
    jsr MOVFM
;LAST THING FETCHED IS FACEXP. INTO ACCX.
;	JMP	FPWRT		;FALL INTO FPWRT.

;EXPONENTIATION ---  X^Y.
;N.B.  0^0=1
;FIRST CHECK IF Y=0. IF SO, THE RESULT IS 1.
;NEXT CHECK IF X=0. IF SO THE RESULT IS 0.
;THEN CHECK IF X.GT.0. IF NOT CHECK THAT Y IS AN INTEGER.
;IF SO, NEGATE X, SO THAT LOG DOESN'T GIVE FCERR.
;IF X IS NEGATIVE AND Y IS ODD, NEGATE THE RESULT
;RETURNED BY EXP.
;TO COMPUTE THE RESULT USE X^Y=EXP((Y*LOG(X)).
;IF FAC=0, JUST EXPONENTIATE THAT.
FPWRT:
    beq EXP
;IS X=0?
    lda ARGEXP
    bne FPWRT1
;ZERO FAC.
    jmp ZEROF1
;SAVE FOR LATER IN A TEMP.
FPWRT1:
    LDXYI TEMPF3
    jsr MOVMF
;Y=0 ALREADY. GOOD IN CASE NO ONE CALLS INT.
    lda ARGSGN
;NO PROBLEMS IF X.GT.0.
    bpl FPWR1
;INTEGERIZE THE FAC.
    jsr INT
;GET ADDR OF COMPERAND.
    LDWDI TEMPF3
;EQUAL?
    jsr FCOMP
;LEAVE X NEG. LOG WILL BLOW HIM OUT.
    bne FPWR1
;A=-1 AND Y IS IRRELEVANT.
;NEGATE X. MAKE POSITIVE.
    tya
;GET EVENNESS.
    ldy INTEGR
;ALTERNATE ENTRY POINT.
FPWR1:
    jsr MOVFA1
    tya
;SAVE EVENNESS FOR LATER.
    pha
;FIND LOG.
    jsr LOG
;MULTIPLY FAC TIMES LOG(X).
    LDWDI TEMPF3
    jsr FMULT
;EXPONENTIATE THE FAC.
    jsr EXP
    pla
;IS IT EVEN?
    lsr A
;YES. OR X.GT.0.
    bcc NEGRTS
;NEGATE THE NUMBER IN FAC.
NEGOP:
    lda FACEXP
    beq NEGRTS
    COM FACSGN
NEGRTS:
    rts

; EXPONENTIATION FUNCTION.
;FIRST SAVE THE ORIGINAL ARGUMENT AND MULTIPLY THE FAC BY
;LOG2(E). THE RESULT IS USED TO DETERMINE IF OVERFLOW
;WILL OCCUR SINCE EXP(X)=2^(X*LOG2(E)) WHERE
;LOG2(E)=LOG(E) BASE 2. THEN SAVE THE INTEGER PART OF
;THIS TO SCALE THE ANSWER AT THE END. SINCE
;2^Y=2^INT(Y)*2^(Y-INT(Y)) AND 2^INT(Y) IS EASY TO COMPUTE.
;NOW COMPUTE 2^(X*LOG2(E)-INT(X*LOG2(E)) BY
;P(LN(2)*(INT(X*LOG2(E))+1)-X) WHERE P IS AN APPROXIMATION
;POLYNOMIAL. THE RESULT IS THEN SCALED BY THE POWER OF 2
;PREVIOUSLY SAVED.

;LOG(E) BASE 2.
LOGEB2:
    .byte 129
    .byte 56
    .byte 170
    .byte 59
.if (ADDPRC) <> 0
    .byte 41
.endif

.if (ADDPRC) = 0
; degree -1.
EXPCON:
    .byte 6
; .00021702255
    .byte 116
    .byte 99
    .byte 144
    .byte 140
; .0012439688
    .byte 119
    .byte 35
    .byte 12
    .byte 171
; .0096788410
    .byte 122
    .byte 30
    .byte 148
    .byte 0
; .055483342
    .byte 124
    .byte 99
    .byte 66
    .byte 128
; .24022984
    .byte 126
    .byte 117
    .byte 254
    .byte 208
; .69314698
    .byte 128
    .byte 49
    .byte 114
    .byte 21
; 1.0
    .byte 129
    .byte 0
    .byte 0
    .byte 0
.endif


.if (ADDPRC) <> 0
;DEGREE-1
EXPCON:
    .byte 7
; .000021498763697
    .byte 113
    .byte 52
    .byte 88
    .byte 62
    .byte 86
; .00014352314036
    .byte 116
    .byte 22
    .byte 126
    .byte 179
    .byte 27
; .0013422634824
    .byte 119
    .byte 47
    .byte 238
    .byte 227
    .byte 133
; .0096140170119
    .byte 122
    .byte 29
    .byte 132
    .byte 28
    .byte 42
; .055505126860
    .byte 124
    .byte 99
    .byte 89
    .byte 88
    .byte 10
; .24022638462
    .byte 126
    .byte 117
    .byte 253
    .byte 231
    .byte 198
; .69314718608
    .byte 128
    .byte 49
    .byte 114
    .byte 24
    .byte 16
; 1.0
    .byte 129
    .byte 0
    .byte 0
    .byte 0
    .byte 0
.endif

EXP:
;MULTIPLY BY LOG(E) BASE 2.
    LDWDI LOGEB2
    jsr FMULT
    lda FACOV
    adc #.lobyte(80)
    bcc STOLD
    jsr INCRND
STOLD:
    sta OLDOV
;TO SAVE IN ARG WITHOUT ROUND.
    jsr MOVEF
    lda FACEXP
;IF ABS(FAC) .GE. 128, TOO BIG.
    cmp #.lobyte(136)
    bcc EXP1
;OVERFLOW OR OVERFLOW.
GOMLDV:
    jsr MLDVEX
EXP1:
    jsr INT
;GET LOW PART.
    lda INTEGR
    clc
    adc #.lobyte(129)
;OVERFLOW OR OVERFLOW !!
    beq GOMLDV
    sec
;SUBTRACT 1.
    sbc #.lobyte(1)
;SAVE A WHILE.
    pha
;PREP TO SWAP FAC AND ARG.
    ldx #.lobyte(4+ADDPRC)
SWAPLP:
    lda ARGEXP,X
    ldy FACEXP,X
    sta FACEXP,X
    sty ARGEXP,X
    dex
    bpl SWAPLP
    lda OLDOV
    sta FACOV
    jsr FSUBT
;NEGATE FAC.
    jsr NEGOP
    LDWDI EXPCON
    jsr POLY
;MULTIPLY BY POSITIVE 1.0.
    CLR ARISGN
;GET SCALE FACTOR.
    pla
;MODIFY FACEXP AND CHECK FOR OVERFLOW.
    jsr MLDEXP
;HAS TO DO JSR DUE TO PULAS IN MULDIV.
    rts


; POLYNOMIAL EVALUATOR AND THE RANDOM NUMBER GENERATOR.
;EVALUATE P(X^2)*X
;POINTER TO DEGREE IS IN [Y,A].
;THE CONSTANTS FOLLOW THE DEGREE.
;FOR X=FAC, COMPUTE:
; C0*X+C1*X^3+C2*X^5+C3*X^7+...+C(N)*X^(2*N+1)
;RETAIN POLYNOMIAL POINTER FOR LATER.
POLYX:
    STWD POLYPT
;SAVE FAC IN FACTMP.
    jsr MOV1F
    lda #.lobyte(TEMPF1)
;COMPUTE X^2.
    jsr FMULT
;COMPUTE P(X^2).
    jsr POLY1
    LDWDI TEMPF1
;MULTIPLY BY FAC AGAIN.
    jmp FMULT

;POLYNOMIAL EVALUATOR.
;POINTER TO DEGREE IS IN [Y,A].
;COMPUTE:
; C0+C1*X+C2*X^2+C3*X^3+C4*X^4+...+C(N-1)*X^(N-1)+C(N)*X^N.
POLY:
    STWD POLYPT
;SAVE FAC.
POLY1:
    jsr MOV2F
    lda (POLYPT),y
    sta DEGREE
    ldy POLYPT
    iny
    tya
    bne POLY3
    inc POLYPT+1
POLY3:
    sta POLYPT
    ldy POLYPT+1
POLY2:
    jsr FMULT
;GET CURRENT POINTER.
    LDWD POLYPT
    clc
    adc #.lobyte(4+ADDPRC)
    bcc POLY4
    iny
POLY4:
    STWD POLYPT
;ADD IN CONSTANT.
    jsr FADD
;MULTIPLY THE ORIGINAL FAC.
    LDWDI TEMPF2
;DONE?
    dec DEGREE
    bne POLY2
;YES.
RANDRT:
    rts

;PSUEDO-RANDOM NUMBER GENERATOR.
;IF ARG=0, THE LAST RANDOM NUMBER GENERATED IS RETURNED.
;IF ARG .LT. 0, A NEW SEQUENCE OF RANDOM NUMBERS IS
;STARTED USING THE ARGUMENT.
;   TO FORM THE NEXT RANDOM NUMBER IN THE SEQUENCE,
;MULTIPLY THE PREVIOUS RANDOM NUMBER BY A RANDOM CONSTANT
;AND ADD IN ANOTHER RANDOM CONSTANT. THE THEN HO
;AND LO BYTES ARE SWITCHED, THE EXPONENT IS PUT WHERE
;IT WILL BE SHIFTED IN BY NORMAL, AND THE EXPONENT IN THE FAC
;IS SET TO 200 SO THE RESULT WILL BE LESS THAN 1. THIS
;IS THEN NORMALIZED AND SAVED FOR THE NEXT TIME.
;THE HO AND LOW BYTES WERE SWITCHED SO THERE WILL BE A
;RANDOM CHANCE OF GETTING A NUMBER LESS THAN OR GREATER
;THAN .5 .

RMULZC:
    .byte 152
    .byte 53
    .byte 68
    .byte 122
RADDZC:
    .byte 104
    .byte 40
    .byte 177
    .byte 70

;GET SIGN INTO ACCX.
RND:
    jsr SIGN
.if (REALIO-3) <> 0
;GET INTO ACCX, SINCE "MOVFM" USES ACCX.
    tax
.endif
;START NEW SEQUENCE IF NEGATIVE.
    bmi RND1
.if (REALIO-3) = 0
    bne QSETNR
;TIMERS ARE AT 9044(L0),45(HI),48(LO),49(HI) HEX.
;FIRST TWO ARE ALWAYS FREE RUNNING.
;SECOND PAIR IS NOT. LO IS FREER THAN HI THEN.
;SO ORDER IN FAC IS 44,48,45,49.
    lda CQHTIM
    sta FACHO
    lda CQHTIM+4
    sta FACMOH
    lda CQHTIM+1
    sta FACMO
    lda CQHTIM+5
    sta FACLO
    jmp STRNEX
.endif
;GET LAST ONE INTO FAC.
QSETNR:
    LDWDI RNDX
    jsr MOVFM
.if (REALIO-3) <> 0
;FAC WAS ZERO?
    txa
;RESTORE LAST ONE.
    beq RANDRT
.endif
;MULTIPLY BY RANDOM CONSTANT.
    LDWDI RMULZC
    jsr FMULT
    LDWDI RADDZC
;ADD RANDOM CONSTANT.
    jsr FADD
RND1:
    ldx FACLO
    lda FACHO
    sta FACLO
;REVERSE HO AND LO.
    stx FACHO
.if (REALIO-3) = 0
    ldx FACMOH
    lda FACMO
    sta FACMOH
    stx FACMO
.endif
;MAKE NUMBER POSITIVE.
STRNEX:
    CLR FACSGN
;PUT EXP WHERE IT WILL
    lda FACEXP
;BE SHIFTED IN BY NORMAL.
    sta FACOV
    lda #.lobyte(128)
;MAKE RESULT BETWEEN 0 AND 1.
    sta FACEXP
;NORMALIZE.
    jsr NORMAL
    LDXYI RNDX
;PUT NEW ONE INTO MEMORY.
GMOVMF:
    jmp MOVMF

; SINE, COSINE AND TANGENT FUNCTIONS.
.if (KIMROM) = 0
;COSINE FUNCTION.
;USE COS(X)=SIN(X+PI/2)
;PNTR TO PI/2.
COS:
    LDWDI PI2
;ADD IT IN.
    jsr FADD
;FALL INTO SIN.


;SINE FUNCTION.
;USE IDENTITIES TO GET FAC IN QUADRANTS I OR IV.
;THE FAC IS DIVIDED BY 2*PI AND THE INTEGER PART IS IGNORED
;BECAUSE SIN(X+2*PI)=SIN(X). THEN THE ARGUMENT CAN BE COMPARED
;WITH PI/2 BY COMPARING THE RESULT OF THE DIVISION
;WITH PI/2/(2*PI)=1/4.
;IDENTITIES ARE THEN USED TO GET THE RESULT IN QUADRANTS
;I OR IV. AN APPROXIMATION POLYNOMIAL IS THEN USED TO
;COMPUTE SIN(X).
SIN:
    jsr MOVAF
;GET PNTR TO DIVISOR.
    LDWDI TWOPI
;GET SIGN OF RESULT.
    ldx ARGSGN
    jsr FDIVF
;GET RESULT INTO ARG.
    jsr MOVAF
;INTEGERIZE FAC.
    jsr INT
;ALWAYS HAVE THE SAME SIGN.
    CLR ARISGN
;KEEP ONLY THE FRACTIONAL PART.
    jsr FSUBT
;GET PNTR TO 1/4.
    LDWDI FR4
;COMPUTE 1/4-FAC.
    jsr FSUB
;SAVE SIGN FOR LATER.
    lda FACSGN
    pha
;FIRST QUADRANT.
    bpl SIN1
;ADD 1/2 TO FAC.
    jsr FADDH
;SIGN IS NEGATIVE?
    lda FACSGN
    bmi SIN2
;QUADRANTS II AND III COME HERE.
    COM TANSGN
;IF POSITIVE, NEGATE IT.
SIN1:
    jsr NEGOP
;POINTER TO 1/4.
SIN2:
    LDWDI FR4
;ADD IT IN.
    jsr FADD
;GET ORIGINAL QUADRANT.
    pla
    bpl SIN3
;IF NEGATIVE, NEGATE RESULT.
    jsr NEGOP
SIN3:
    LDWDI SINCON
;DO APPROXIMATION POLYNOMIAL.
GPOLYX:
    jmp POLYX


;TANGENT FUNCTION.
;MOVE FAC INTO TEMPORARY.
TAN:
    jsr MOV1F
;REMEMBER WHETHER TO NEGATE.
    CLR TANSGN
;COMPUTE THE SIN.
    jsr SIN
    LDXYI TEMPF3
;PUT SIGN INTO OTHER TEMP.
    jsr GMOVMF
    LDWDI TEMPF1
;PUT THIS MEMORY LOC INTO FAC.
    jsr MOVFM
;START OFF POSITIVE.
    CLR FACSGN
    lda TANSGN
;COMPUTE COSINE.
    jsr COSC
;ADDRESS OF SINE VALUE.
    LDWDI TEMPF3
;DIVIDE SINE BY COSINE AND RETURN.
GFDIV:
    jmp FDIV
COSC:
    pha
    jmp SIN1

;PI/2
PI2:
    .byte 129
    .byte 73
    .byte 15
    .byte 219-ADDPRC
.if (ADDPRC) <> 0
    .byte 162
.endif
;2*PI.
TWOPI:
    .byte 131
    .byte 73
    .byte 15
    .byte 219-ADDPRC
.if (ADDPRC) <> 0
    .byte 162
.endif
;1/4
FR4:
    .byte 127
    .byte 0
    .byte 0
    .byte 0
.if (ADDPRC) <> 0
    .byte 0
.endif
;DEGREE-1.
.if (ADDPRC) = 0
SINCON:
    .byte 4
;39.710899
    .byte 134
    .byte 30
    .byte 215
    .byte 251
;-76.574956
    .byte 135
    .byte 153
    .byte 38
    .byte 101
;81.602231
    .byte 135
    .byte 35
    .byte 52
    .byte 88
;-41.341677
    .byte 134
    .byte 165
    .byte 93
    .byte 225
;6.2831853
    .byte 131
    .byte 73
    .byte 15
    .byte 219
.endif

.if (ADDPRC) <> 0
;DEGREE-1.
SINCON:
    .byte 5
; -14.381383816
    .byte 132
    .byte 230
    .byte 26
    .byte 45
    .byte 27
; 42.07777095
    .byte 134
    .byte 40
    .byte 7
    .byte 251
    .byte 248
; -76.704133676
    .byte 135
    .byte 153
    .byte 104
    .byte 137
    .byte 1
; 81.605223690
    .byte 135
    .byte 35
    .byte 53
    .byte 223
    .byte 225
; -41.34170209
    .byte 134
    .byte 165
    .byte 93
    .byte 231
    .byte 40
; 6.2831853070
    .byte 131
    .byte 73
    .byte 15
    .byte 218
    .byte 162
; 7.2362932E7
    .byte 161
    .byte 84
    .byte 70
    .byte 143
    .byte 19
; 73276.2515
    .byte 143
    .byte 82
    .byte 67
    .byte 137
    .byte 205
.endif
; ARCTANGENT FUNCTION.
;USE IDENTITIES TO GET ARG BETWEEN 0 AND 1 AND THEN USE AN
;APPROXIMATION POLYNOMIAL TO COMPUTE ARCTAN(X).
;WHAT IS SIGN?
ATN:
    lda FACSGN
;(MEANWHILE SAVE FOR LATER.)
    pha
    bpl ATN1
;IF NEGATIVE, NEGATE FAC.
    jsr NEGOP
;USE ARCTAN(X)=-ARCTAN(-X) .
ATN1:
    lda FACEXP
;SAVE THIS TOO FOR LATER.
    pha
;SEE IF FAC .GE. 1.0 .
    cmp #.lobyte(129)
;IT IS LESS THAN 1.
    bcc ATN2
;GET PNTR TO 1.0 .
    LDWDI FONE
;COMPUTE RECIPROCAL.
    jsr FDIV
;USE ARCTAN(X)=PI/2-ARCTAN(1/X) .
;PNTR TO ARCTAN CONSTANTS.
ATN2:
    LDWDI ATNCON
    jsr POLYX
    pla
;WAS ORIGINAL ARGUMENT .LT. 1 ?
    cmp #.lobyte(129)
;YES.
    bcc ATN3
    LDWDI PI2
;SUBTRACT ARCTAGN FROM PI/2.
    jsr FSUB
;WAS ORIGINAL ARGUMENT POSITIVE?
ATN3:
    pla
;YES.
    bpl ATN4
;IF NEGATIVE, NEGATE RESULT.
    jmp NEGOP
;ALL DONE.
ATN4:
    rts

.if (ADDPRC) = 0
;DEGREE-1.
ATNCON:
    .byte 8
;.0028498896
    .byte 120
    .byte 58
    .byte 197
    .byte 55
;-.016068629
    .byte 123
    .byte 131
    .byte 162
    .byte 92
;.042691519
    .byte 124
    .byte 46
    .byte 221
    .byte 77
;-.075042945
    .byte 125
    .byte 153
    .byte 176
    .byte 30
;.10640934
    .byte 125
    .byte 89
    .byte 237
    .byte 36
;-.14203644
    .byte 126
    .byte 145
    .byte 114
    .byte 0
;.19992619
    .byte 126
    .byte 76
    .byte 185
    .byte 115
;.-33333073
    .byte 127
    .byte 170
    .byte 170
    .byte 83
;1.0
    .byte 129
    .byte 0
    .byte 0
    .byte 0
.endif

.if (ADDPRC) <> 0
;DEGREE-1.
ATNCON:
    .byte 11
; -.0006847939119
    .byte 118
    .byte 179
    .byte 131
    .byte 189
    .byte 211
; .004850942156
    .byte 121
    .byte 30
    .byte 244
    .byte 166
    .byte 245
; -.01611170184
    .byte 123
    .byte 131
    .byte 252
    .byte 176
    .byte 16
; .03420963805
    .byte 124
    .byte 12
    .byte 31
    .byte 103
    .byte 202
; -.05427913276
    .byte 124
    .byte 222
    .byte 83
    .byte 203
    .byte 193
; .07245719654
    .byte 125
    .byte 20
    .byte 100
    .byte 112
    .byte 76
; -.08980239538
    .byte 125
    .byte 183
    .byte 234
    .byte 81
    .byte 122
; .1109324134
    .byte 125
    .byte 99
    .byte 48
    .byte 136
    .byte 126
; -.1428398077
    .byte 126
    .byte 146
    .byte 68
    .byte 153
    .byte 58
; .1999991205
    .byte 126
    .byte 76
    .byte 204
    .byte 145
    .byte 199
; -.3333333157
    .byte 127
    .byte 170
    .byte 170
    .byte 170
    .byte 19
; 1.0
    .byte 129
    .byte 0
    .byte 0
    .byte 0
    .byte 0
.endif
.endif
; SYSTEM INITIALIZATION CODE.
;IN ALL NON-MATH-PACKAGE CODE.
; THIS INITIALIZES THE BASIC INTERPRETER FOR THE M6502 AND SHOULD BE
; LOCATED WHERE IT WILL BE WIPED OUT IN RAM IF CODE IS ALL IN RAM.

.if (ROMSW) = 0
;SO ZEROING AT TXTTAB DOESN'T PREVENT
    .res 1, 0
.endif
;RESTARTING INIT
;INCREMENT THE WHOLE TXTPTR.
INITAT:
    inc CHRGET+7
    bne CHZGOT
    inc CHRGET+8
;A LOAD WITH AN EXT ADDR.
CHZGOT:
    lda 60000
;IS IT A ":"?
    cmp #.lobyte(58)
;IT IS .GE. ":"
    bcs CHZRTS
;SKIP SPACES.
    cmp #.lobyte(32)
    beq INITAT
    sec
;ALL CHARS .GT. "9" HAVE RET'D SO
    sbc #.lobyte(48)
    sec
;SEE IF NUMERIC.
    sbc #.lobyte(256-48)
;TURN CARRY ON IF NUMERIC.
;ALSO, SETZ IF NULL.
;RETURN TO CALLER.
CHZRTS:
    rts

;LOADED OR FROM ROM.
    .byte 128
;THE INITIAL RANDOM NUMBER.
    .byte 79
    .byte 199
    .byte 82
.if (ADDPRC) <> 0
    .byte 88
.endif
.if (REALIO-3) <> 0
.if (KIMROM) = 0
TYPAUT:
    LDWDI AUTTXT
    jsr STROUT
.endif
.endif
INIT:
.if (REALIO-3) <> 0
;MAKE IT LOOK DIRECT IN CASE OF
    ldx #.lobyte(255)
;ERROR MESSAGE.
    stx CURLIN+1
.endif
.if (STKEND-511) <> 0
    ldx #.lobyte(STKEND-256)
.endif
    txs
.if (REALIO-3) <> 0
;ALLOW RESTART.
    LDWDI INIT
    STWD START+1
;RTS HERE ON ERRORS.
    STWD RDYJSR+1
    LDWDI AYINT
    STWD ADRAYI
    LDWDI GIVAYF
    STWD ADRGAY
.endif
;JMP INSTRUCTION.
    lda #.lobyte(76)
;MAKE AN INST.
.if (REALIO) = 0
    .error "PDP-10 simulator instruction is not supported"
.endif
.if (REALIO-3) <> 0
    sta START
    sta RDYJSR
.endif
    sta JMPER
.if (ROMSW) <> 0
    sta USRPOK
    LDWDI FCERR
    STWD USRPOK+1
.endif
;THESE MUST BE NON-ZERO SO CHEAD WILL
    lda #.lobyte(LINLEN)
;WORK AFTER MOVING A NEW LINE IN BUF
    sta LINWID
;INTO THE PROGRAM
    lda #.lobyte(NCMPOS)
    sta NCMWID
    ldx #.lobyte(RNDX+4-CHRGET)
MOVCHG:
    lda INITAT-1,X
;MOVE TO RAM.
    sta CHRGET-1,X
    dex
    bne MOVCHG
    lda #.lobyte(STRSIZ)
    sta FOUR6
;SET CONST IN RAM.
    txa
    sta BITS
.if (EXTIO) <> 0
    sta CHANNL
.endif
    sta LASTPT+1
.if (NULCMD) <> 0
    sta NULCNT
.endif
;PUT ZERO AT THE END OF THE STACK
    pha
;SO FNDFOR WILL STOP
.if (REALIO) <> 0
;BE TALKATIVE.
    sta CNTWFL
.endif
.if (BUFPAG) <> 0
;MAKE [X]=1
    inx
;SET PRE-BUF BYTES NON-ZERO FOR CHEAD
    stx BUF-3
    stx BUF-4
.endif
.if (REALIO-3) <> 0
;TYPE A CR.
    jsr CRDO
.endif
    ldx #.lobyte(TEMPST)
;SET UP STRING TEMPORARIES.
    stx TEMPPT
.if REALIO = 6
    LDWDI WOPR_RAM_END
.else
.if (REALIO|LONGI) <> 0
.if (REALIO-3) <> 0
    LDWDI MEMORY
    jsr STROUT
;GET A LINE OF INPUT.
    jsr QINLIN
;READ THIS !
    STXY TXTPTR
;GET THE FIRST CHARACTER.
    jsr CHRGET
.if (KIMROM) = 0
;IS IT AN "A"?
    cmp #.lobyte(65)
;YES TYPE AUTHOR'S NAME.
    beq TYPAUT
.endif
;NULL INPUT?
    tay
;NO.
    bne USEDE9
.endif
.if (REALIO-3) = 0
    ldy #.lobyte(RAMLOC/256)
.endif
.if (REALIO-3) <> 0
.if (ROMSW) = 0
;YES GET PNTR TO LAST WORD.
    LDWDI LASTWR
.endif
.if (ROMSW) <> 0
    LDWDI RAMLOC
.endif
.endif
.if (ROMSW) <> 0
;SET UP START OF PROGRAM LOCATION
    STWD TXTTAB
.endif
    STWD LINNUM
.if (REALIO-3) = 0
    tay
.endif
.if (REALIO-3) <> 0
    ldy #.lobyte(0)
.endif
LOOPMM:
    inc LINNUM
    bne LOOPM1
    inc LINNUM+1
.if (REALIO-3) = 0
    bmi USEDEC
.endif
;PUT RANDOM INFO INTO MEM.
LOOPM1:
    lda #.lobyte(85)
    sta (LINNUM),y
;WAS IT SAVED?
    cmp (LINNUM),y
;NO. THAT IS END OF MEMORY.
    bne USEDEC
;LOOKS LIKE IT. TRY ANOTHER.
    asl A
    sta (LINNUM),y
;WAS IT SAVED?
    cmp (LINNUM),y
.if (REALIO-3) <> 0
;NO. THIS IS THE END.
    bne USEDEC
.endif
.if (REALIO-2) <> 0
    beq LOOPMM
.endif
.if (REALIO-2) = 0
    bne USEDEC
;SEE IF HITTING PAGE 0
    cmp 0
    bne LOOPMM
    lda #.lobyte(76)
    sta 0
    BNEA USEDEC
.endif
.if (REALIO-3) <> 0
;GET CURRENT CHARACTER.
USEDE9:
    jsr CHRGOT
;GET DECIMAL ARGUMENT.
    jsr LINGET
;MAKE SURE A TERMINATOR EXISTS.
    tay
;IT DOES.
    beq USEDEC
;IT DOESN'T.
    jmp SNERR
.endif
;GET SIZE OF MEMORY INPUT.
USEDEC:
    LDWD LINNUM
;HIGHEST ADDRESS.
USEDEF:
.endif
.if (REALIO|LONGI) = 0
;A STRANGE NUMBER.
    LDWDI 16190
.endif
;THIS IS THE SIZE OF MEMORY.
.endif
    STWD MEMSIZ
;TOP OF STRINGS TOO.
    STWD FRETOP
TTYW:
.if REALIO <> 6
.if (REALIO-3) <> 0
.if (REALIO|LONGI) <> 0
    LDWDI TTYWID
    jsr STROUT
;GET LINE OF INPUT.
    jsr QINLIN
;READ THIS !
    STXY TXTPTR
;GET FIRST CHARACTER.
    jsr CHRGET
;TEST ACCA BUT DON'T AFFECT CARRY.
    tay
    beq ASKAGN
;GET ARGUMENT.
    jsr LINGET
    lda LINNUM+1
;WIDTH MUST BE .LT. 256.
    bne TTYW
    lda LINNUM
;WIDTH MUST BE GREATER THAN 16.
    cmp #.lobyte(16)
    bcc TTYW
;THAT IS THE LINE WIDTH.
    sta LINWID
;COMPUTE POSITION BEYOND WHICH
MORCPS:
    sbc #.lobyte(CLMWID)
;THERE ARE NO MORE FIELDS.
    bcs MORCPS
    eor #.lobyte(255)
    sbc #.lobyte(CLMWID-2)
    clc
    adc LINWID
    sta NCMWID
.endif
ASKAGN:
.if (ROMSW) = 0
.if (REALIO|LONGI) <> 0
    LDWDI FNS
    jsr STROUT
    jsr QINLIN
;READ THIS !
    STXY TXTPTR
    jsr CHRGET
;DEFAULT.
    LDXYI INITAT
    cmp #.lobyte(89)
;SAVE ALL FUNCTIONS.
    beq HAVFNS
    cmp #.lobyte(65)
;SAVE ALL BUT ATN.
    beq OKCHAR
    cmp #.lobyte(78)
;BAD INPUT.
    bne ASKAGN
;SAVE NOTHING.
OKCHAR:
    LDXYI FCERR
;GET RID OF ATN FUNCTION.
    STXY ATNFIX
;UNTIL WE KNOW THAT WE SHOULD DEL MORE.
    LDXYI ATN
    cmp #.lobyte(65)
;JUST GET RID OF ATN.
    beq HAVFNS
    LDXYI FCERR
;GET RID OF THE REST.
    STXY COSFIX
    STXY TANFIX
    STXY SINFIX
;AND GET RID OF ALL BACK TO "COS".
    LDXYI COS
HAVFNS:
.endif
.if (REALIO|LONGI) = 0
;GET RID OF ALL UP TO "INITAT".
    LDXYI INITAT-1
.endif
.endif
.endif
.endif ; historical terminal-width / optional-function questions
.if (ROMSW) <> 0
    LDXYI RAMLOC
    STXY TXTTAB
.endif
    ldy #.lobyte(0)
    tya
;SET UP TEXT TABLE.
    sta (TXTTAB),y
    inc TXTTAB
.if (REALIO-3) <> 0
    bne QROOM
    inc TXTTAB+1
.endif
;PREPARE TO USE "REASON".
QROOM:
    LDWD TXTTAB
    jsr REASON
.if (REALIO-3) = 0
    LDWDI FREMES
    jsr STROUT
.endif
.if (REALIO-3) <> 0
    jsr CRDO
.endif
;COMPUTE [MEMSIZ]-[VARTAB].
    lda MEMSIZ
    sec
    sbc TXTTAB
    tax
    lda MEMSIZ+1
    sbc TXTTAB+1
;TYPE THIS VALUE.
    jsr LINPRT
;MORE BULLSHIT.
    LDWDI WORDS
    jsr STROUT
;SET UP EVERYTHING ELSE.
    jsr SCRTCH
.if (REALIO-3) = 0
    jmp READY
.endif
.if (REALIO-3) <> 0
    LDWDI STROUT
    STWD RDYJSR+1
    LDWDI READY
    STWD START+1
    jmp (START+1)

.if (ROMSW) = 0
FNS:
    DT "WANT SIN-COS-TAN-ATN"
    .byte 0
.endif
.if (KIMROM) = 0
AUTTXT:
    ACRLF
;ANOTHER LINE FEED.
    .byte 12
    DT "WRITTEN "
    DT "BY WEILAND & GATES"
    ACRLF
    .byte 0
.endif
MEMORY:
    DT "MEMORY SIZE"
    .byte 0
TTYWID:
.if (KIMROM) = 0
    DT "TERMINAL "
.endif
    DT "WIDTH"
    .byte 0
.endif
WORDS:
    DT " BYTES FREE"
.if (REALIO-3) <> 0
    ACRLF
    ACRLF
.endif
.if (REALIO-3) = 0
    .byte 13
    .byte 0
FREMES:
.endif
.if (REALIO) = 0
    DT "SIMULATED BASIC FOR THE 6502 V1.1"
.endif
.if (REALIO-1) = 0
    DT "KIM BASIC V1.1"
.endif
.if (REALIO-2) = 0
    DT "OSI 6502 BASIC VERSION 1.1"
.endif
.if (REALIO-3) = 0
    DT "### COMMODORE BASIC ###"
    .byte 13
    .byte 13
.endif
.if (REALIO-4) = 0
    DT "APPLE BASIC V1.1"
.endif
.if (REALIO-5) = 0
    DT "STM BASIC V1.1"
.endif
.if REALIO = 6
    DT "WHOPPING BASIC V1.1"
.endif
.if (REALIO-3) <> 0
    ACRLF
    DT "COPYRIGHT 1978 MICROSOFT"
    ACRLF
.endif
    .byte 0
LASTWR:
;SPACE FOR TEMP STACK.
    .res 100, 0
.if (REALIO) = 0
TSTACK:
    .res 13600, 0
.endif

.if 1
.endif
.ifndef START
START = 0
.endif

.if REALIO = 6
.include "imnotwopr.inc"
.endif
